  0x07,0x07,0x07,0x07,0x07,0x07,0x07,0x07,
  0x07,0x69,0x69,0x69,0x69,0x69,0x00,0x03,
  0x07,0x69,0x69,0x69,0x69,0x69,0x00,0xA3,
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  0x07,0x69,0x00,0x11,0xEC,0xFF,0xFF,0xEC,
/* tile 1 */

  0x07,0x07,0x07,0x07,0x07,0x07,0x07,0x07,
  0x03,0x03,0x03,0x03,0x03,0x00,0x69,0x07,
  0xFF,0xEC,0xA3,0xD8,0x11,0x00,0x69,0x07,
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  0xEC,0xEC,0xA3,0xD8,0x11,0x00,0x69,0x07,
/* tile 2 */

  0x07,0x00,0x11,0xEC,0xFF,0xEC,0xEC,0xEC,
  0x07,0x00,0xD8,0xEC,0x00,0x00,0xA3,0xA3,
  0x07,0x00,0x11,0x00,0x37,0x37,0x00,0x11,
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  0x07,0x07,0x07,0x07,0x07,0x07,0x07,0x07,
/* tile 3 */

  0xEC,0xA3,0xD8,0xD8,0xD8,0x11,0x00,0x07,
  0xD8,0xD8,0x00,0x00,0x11,0x11,0x00,0x07,
  0x11,0x00,0x37,0x37,0x00,0x11,0x00,0x07,
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  0x07,0x07,0x07,0x07,0x07,0x07,0x07,0x07,
/* tile 4 */

  0x07,0x07,0x07,0x07,0x07,0x07,0x07,0x07,
  0x07,0x69,0x69,0x69,0x69,0x69,0x69,0x03,
  0x07,0x69,0x69,0x69,0x69,0x69,0x03,0x1F,
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  0x07,0x03,0x1F,0x37,0x37,0x00,0xFF,0x37,
/* tile 5 */

  0x07,0x07,0x07,0x07,0x07,0x07,0x07,0x07,
  0x69,0x69,0x03,0x69,0x69,0x03,0x69,0x07,
  0x03,0x03,0x37,0x03,0x03,0x1F,0x03,0x07,
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  0x00,0xFF,0x37,0x37,0x37,0x1F,0x03,0x07,
/* tile 6 */

  0x07,0x03,0x37,0x37,0x37,0x00,0xFF,0x37,
  0x07,0x03,0x37,0x37,0xFF,0x37,0x37,0x37,
  0x07,0x03,0x1F,0x37,0x03,0x00,0x00,0x00,
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  0x07,0x07,0x07,0x07,0x07,0x07,0x07,0x07,
/* tile 7 */

  0x00,0xFF,0x37,0x37,0x37,0x1F,0x03,0x07,
  0x37,0x37,0x37,0x37,0x37,0x1F,0x03,0x07,
  0x00,0x00,0x37,0x37,0x1F,0x03,0x69,0x07,
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  0x07,0x07,0x07,0x07,0x07,0x07,0x07,0x07,
/* tile 8 */

  0x07,0x07,0x07,0x07,0x07,0x07,0x07,0x07,
  0x07,0x69,0x69,0x69,0x69,0x00,0x00,0x00,
  0x07,0x69,0x69,0x00,0x00,0x00,0x11,0x11,
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  0x07,0x00,0x5A,0x5A,0xA3,0x5A,0x5A,0x5A,
/* tile 9 */

  0x07,0x07,0x07,0x07,0x07,0x07,0x07,0x07,
  0x00,0x00,0x00,0x69,0x00,0x00,0x69,0x07,
  0x00,0x5A,0x11,0x00,0xFF,0x0F,0x00,0x07,
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  0x11,0x00,0x00,0x00,0x00,0x00,0x00,0x07,
/* tile 10 */

  0x07,0x00,0x5A,0x5A,0x5A,0x5A,0x5A,0x5A,
  0x07,0x00,0x11,0x5A,0x5A,0x5A,0x5A,0x5A,
  0x07,0x00,0x00,0x11,0x5A,0x5A,0x5A,0x11,
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  0x07,0x07,0x07,0x07,0x07,0x07,0x07,0x07,
/* tile 11 */

  0x5A,0x11,0x11,0x11,0x00,0x00,0x00,0x07,
  0x11,0x11,0x11,0x00,0x00,0x00,0x00,0x07,
  0x11,0x11,0x11,0x00,0x00,0x00,0x00,0x07,
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  0x07,0x07,0x07,0x07,0x07,0x07,0x07,0x07,
/* tile 12 */

  0x07,0x07,0x07,0x07,0x07,0x07,0x07,0x07,
  0x07,0x69,0x00,0x00,0x00,0x00,0x69,0x00,
  0x07,0x00,0x00,0xFF,0xA3,0x00,0x00,0xFF,
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  0x07,0x69,0x1F,0x37,0x37,0x37,0x03,0x00,
/* tile 13 */

  0x00,0x07,0x07,0x07,0x07,0x07,0x07,0x07,
  0xFF,0x00,0x69,0x69,0x69,0x69,0x69,0x07,
  0x00,0x69,0x69,0x69,0x69,0x69,0x69,0x07,
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  0x00,0x03,0x1F,0x69,0x00,0xAE,0xFF,0x07,
/* tile 14 */

  0x07,0x69,0x69,0x37,0x37,0x03,0x03,0xFF,
  0x07,0x1F,0x37,0x37,0x37,0x00,0x0F,0x37,
  0x07,0x69,0x69,0x37,0x37,0x00,0x0F,0x0F,
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  0x07,0x07,0x07,0x07,0x07,0x07,0x07,0x07,
/* tile 15 */

  0x37,0x0F,0x00,0x00,0xAE,0xFF,0xFF,0x07,
  0x37,0x37,0x0F,0x00,0xFF,0xFF,0xFF,0x07,
  0x37,0x37,0x1F,0x0F,0x5A,0xFF,0xA3,0x07,
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  0x07,0x07,0x07,0x07,0x07,0x07,0x07,0x07,
/* tile 16 */

  0x07,0x07,0x07,0x07,0x07,0x07,0x07,0x00,
  0x07,0x69,0x69,0x69,0x00,0x00,0x00,0xEC,
  0x07,0x69,0x69,0x00,0xEC,0xFF,0x00,0xD8,
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  0x07,0x00,0xEC,0xFF,0x00,0x11,0xD8,0xD8,
/* tile 17 */

  0x00,0x07,0x07,0x07,0x07,0x07,0x07,0x07,
  0xFF,0x00,0x00,0x00,0x69,0x69,0x69,0x07,
  0xEC,0x00,0xEC,0xFF,0x00,0x69,0x69,0x07,
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  0xD8,0x11,0xD8,0x00,0x11,0x69,0x69,0x07,
/* tile 18 */

  0x07,0x00,0xD8,0xEC,0xEC,0x00,0x11,0xD8,
  0x07,0x00,0x00,0xD8,0x11,0xEC,0xEC,0x11,
  0x07,0x69,0x00,0x11,0xD8,0xD8,0xFF,0xEC,
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  0x07,0x07,0x07,0x07,0x00,0x00,0x00,0x00,
/* tile 19 */

  0x11,0xEC,0xEC,0xD8,0x00,0x69,0x69,0x07,
  0x00,0xD8,0xEC,0xEC,0x00,0x69,0x69,0x07,
  0x00,0xD8,0xEC,0xD8,0x00,0x69,0x69,0x07,
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  0x00,0x00,0x00,0x00,0x07,0x07,0x07,0x07,
/* tile 20 */

  0x06,0x06,0x06,0x06,0x06,0x06,0x06,0x06,
  0x06,0x69,0x69,0x69,0x69,0x69,0x11,0x11,
  0x06,0x69,0x69,0x69,0x11,0x11,0xEC,0xFF,
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  0x06,0x00,0xA3,0x00,0x00,0x0F,0x00,0xFF,
/* tile 21 */

  0x06,0x06,0x06,0x06,0x06,0x06,0x06,0x06,
  0x11,0x11,0x69,0x69,0x69,0x69,0x69,0x06,
  0xFF,0xEC,0x11,0x11,0x69,0x69,0x69,0x06,
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  0xFF,0x00,0x0F,0x00,0x00,0xA3,0x00,0x06,
/* tile 22 */

  0x06,0x00,0xA3,0x11,0x00,0x00,0xAE,0xA3,
  0x06,0x00,0xA3,0xFF,0xFF,0xFF,0xFF,0x00,
  0x06,0x69,0x00,0x00,0xEC,0xFF,0xA3,0x00,
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  0x06,0x06,0x06,0x06,0x06,0x06,0x06,0x06,
/* tile 23 */

  0xA3,0xAE,0x00,0x00,0x11,0xA3,0x00,0x06,
  0x00,0xFF,0xFF,0xFF,0xFF,0xA3,0x00,0x06,
  0x00,0xA3,0xFF,0xEC,0x00,0x00,0x69,0x06,
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  0x06,0x06,0x06,0x06,0x06,0x06,0x06,0x06,
