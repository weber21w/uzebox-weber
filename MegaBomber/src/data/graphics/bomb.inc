/* tile 0 */

  0,0,0,0,0,0,0,0,
  0,0,0,0,0,0,0,0,
  0,0,0,0,0,0,1,1,
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  0,1,2,3,5,4,1,4,
/* tile 1 */

  0,0,0,0,0,7,0,0,
  0,0,0,0,7,8,7,0,
  1,0,0,0,7,8,7,0,
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  5,4,4,3,1,1,0,0,
/* tile 2 */

  0,1,2,3,3,3,3,1,
  0,1,2,2,3,3,3,2,
  0,1,2,2,2,2,2,2,
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  0,0,0,0,0,0,1,1,
/* tile 3 */

  4,4,3,1,2,1,0,0,
  1,1,1,2,2,1,0,0,
  2,2,2,2,2,1,0,0,
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  1,0,0,0,0,0,0,0,
/* tile 4 */

  0,0,0,0,0,0,0,0,
  0,0,0,0,0,0,1,1,
  0,0,0,0,1,1,2,2,
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  0,1,3,3,4,4,3,3,
/* tile 5 */

  0,0,0,0,0,0,0x0E,0,
  1,1,0,0,0,0x0E,7,0x0E,
  2,1,1,1,1,0x0E,8,0x0E,
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  1,4,4,3,1,2,1,0,
/* tile 6 */

  0,1,2,3,3,3,3,3,
  0,1,2,2,3,3,3,2,
  0,1,2,2,2,2,2,2,
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  0,0,0,0,0,0,1,1,
/* tile 7 */

  2,1,1,1,2,2,1,0,
  2,2,2,2,2,2,1,0,
  2,2,2,2,2,2,1,0,
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  1,1,0,0,0,0,0,0,
/* tile 8 */

  0,0,0,0,0,1,1,1,
  0,0,0,1,1,2,3,3,
  0,0,1,2,4,5,4,3,
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  1,3,3,3,3,3,3,3,
/* tile 9 */

  1,1,1,0,0,0,1,7,
  2,2,1,1,1,1,9,8,
  3,1,4,4,1,9,10,1,
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  3,2,1,1,1,2,2,1,
/* tile 10 */

  1,2,3,3,3,3,3,3,
  1,2,2,3,3,3,3,2,
  1,2,2,2,2,2,2,2,
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  0,0,0,0,0,1,1,1,
/* tile 11 */

  2,2,2,2,2,2,2,1,
  2,2,2,2,2,2,2,1,
  2,2,2,2,2,2,2,1,
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  1,1,1,0,0,0,0,0,


/*
const char pallet[] PROGMEM = {
254,
1,
73,
146,
163,
237,
255,
30,
47,
102,
93,
14,
0,
12,
}
*/