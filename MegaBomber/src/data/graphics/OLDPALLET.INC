unsigned char pallet[] PROGMEM= {
#define BOMBER_PALLET_ENTRIES 12
254,

1,
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135,
/*
//White Pallet
0x01,//OUTLINE
0xAC,
0x5F,//GLOVE BOOTS
0xFF,//HELMET
0x8A,//OUTSIDE HELMET
0xDC,//BELLY
0x77,//FACE
0x0F,//FACE SURROUND
0x0E,//SMALL SPECK, "SOCKS"
*/

//Black Pallet
0x01,
0b01001001,
0x5F,
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0x0E,
/*0x27,
0x2F,
0x49,
0x92,
0x66,
0xA3,
0xED,
0x1E,
*/

//Red Pallet
0x01,
0b00000101,
0x5F,
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0x0E,
/*0x00,//27,
0x00,//2F,
0x00,//49,
0x00,//92,
0x00,//66,
0xFF,//A3,
0xFF,//ED,
0xFF,//1E,
*/
//Green Pallet

0x01,
0b00101000,
0x5F,
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0x0E,
/*0x27,
0x2F,
0x49,
0x92,
0x66,
0xA3,
0xED,
0x1E,
*/

//Death Pallet?
0x27,
0x2F,
0x49,
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0x1E,

#define POISON_PALLET 44
//Poison Pallet
0b10100100,
0x00,
0x00,
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0x00,

#define BOMB_PALLET 53
0x01,
0x49,
0x92,
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0x5D,

};