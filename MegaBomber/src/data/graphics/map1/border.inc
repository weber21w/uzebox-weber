const char BorderFrames[] PROGMEM ={
//TOP
0,0,0,0,0,0,0,0,0,0,0,0,0,0,0,0,0,0,0,0,0,0,0,0,0,0,0,0,0,0,
0,0,1,2,1,2,1,2,1,2,1,2,1,2,1,2,1,2,1,2,1,2,1,2,1,2,1,2,0,0,//0,0,1,2,3,2,1,2,3,2,1,2,3,2,1,2,3,2,1,2,3,2,1,2,3,2,1,2,0,0,
//LEFT
0,3,
0,5,
0,3,
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0,5,

/*
0,4,
0,6,
0,4,
0,6,
0,4,
0,6,
0,4,
0,6,
0,4,
0,6,
0,4,
0,6,
0,4,
0,6,
0,4,
0,6,
0,4,
0,6,
0,4,
0,6,
0,4,
0,6,
*/


//RIGHT
4,0,
6,0,
4,0,
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6,0,

/*
5,0,
7,0,
5,0,
7,0,
5,0,
7,0,
5,0,
7,0,
5,0,
7,0,
5,0,
7,0,
5,0,
7,0,
5,0,
7,0,
5,0,
7,0,
5,0,
7,0,
5,0,
7,0,
*/
/*
//////TOP
    0,  0,  1,  2,  1,  2,  1,  2,  1,  2,  1,  2,  1,  2,  1,  2,  1,  2,  1,  2,  1,  2,  1,  2,  1,  2,  1,  2,  0,  0, 
    0,  0,  3,  4,  3,  4,  3,  4,  3,  4,  3,  4,  3,  4,  3,  4,  3,  4,  3,  4,  3,  4,  3,  4,  3,  4,  3,  4,  0,  0,

//////LEFT

5,6,
9,10,
13,14,
17,18,
21,22,
25,26,
29,30,
33,34,
5,6,
9,10,
13,14,
17,18,
21,22,
25,26,
29,30,
33,34,
5,6,
9,10,
13,14,
17,18,
21,22,
25,26, 
  




//////RIGHT
7,8,
11,12,
15,16,
19,20,
23,24,
27,28,
31,32,
35,36,
7,8,
11,12,
15,16,
19,20,
23,24,
27,28,
31,32,
35,36,
7,8,
11,12,
15,16,
19,20,
23,24,
27,28, 
*/
255,

};


const char BorderTable[] PROGMEM ={//1 for each level...
0, //START FRAME(IS ABSOLUTE OFFSET INTO FRAME TABLE)
1, //NUM FRAMES(FRAMES MUST BE SEQUENTIAL)
};

const char BorderFrameTimes[] PROGMEM ={
30,30,

};