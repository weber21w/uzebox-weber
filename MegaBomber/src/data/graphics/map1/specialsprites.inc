/* tile 0 */

  0xFE,0xFE,0x52,0xFF,0xFF,0xFF,0xFF,0xFF,
  0xFE,0x52,0xFF,0xFF,0xFF,0xFF,0xFF,0xFF,
  0xFE,0x52,0x52,0x52,0x52,0x52,0xFF,0xFF,
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  0xFE,0xFE,0xFE,0xFE,0xFE,0x52,0xFF,0xA3,
/* tile 1 */

  0xAD,0xAD,0xAD,0xAD,0xAD,0x52,0xFE,0xFE,
  0xAD,0xAD,0xAD,0xAD,0xAD,0xAD,0x52,0xFE,
  0xF5,0xAD,0x52,0x52,0x52,0x52,0x52,0xFE,
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  0xA3,0xAD,0x52,0xFE,0xFE,0xFE,0xFE,0xFE,
/* tile 2 */

  0xFE,0xFE,0xFE,0xFE,0x52,0x52,0x52,0x52,
  0xFE,0x52,0x52,0x52,0xF6,0xF6,0xF6,0xF6,
  0x52,0xFF,0xFF,0xF6,0xF6,0xF6,0xF6,0xF6,
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  0xFF,0xFF,0xFF,0xA3,0xA3,0xFF,0xFF,0xFF,
/* tile 3 */

  0x52,0x52,0x52,0x52,0xFE,0xFE,0xFE,0xFE,
  0xF6,0xF6,0xF6,0xF6,0x52,0x52,0x52,0xFE,
  0xF6,0xF6,0xF6,0xF6,0xF6,0xF6,0xF6,0x52,
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  0xFF,0xFF,0xF6,0xA3,0xA3,0xF5,0xF5,0xF5,
/* tile 4 */

  0xFE,0xFE,0xFE,0xFE,0xFE,0x52,0xA3,0xFF,
  0xFE,0xFE,0xFE,0xFE,0xFE,0x52,0xFF,0xFF,
  0xFE,0xFE,0xFE,0xFE,0xFE,0x52,0xFF,0xFF,
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  0xFE,0x52,0x52,0xFF,0xFF,0xFF,0xFF,0xFF,
/* tile 5 */

  0xFE,0xFE,0xFE,0xFE,0xFE,0xFE,0xFE,0xFE,
  0xFE,0xFE,0xFE,0xFE,0xFE,0xFE,0xFE,0x52,
  0xFE,0xFE,0xFE,0xFE,0xFE,0xFE,0x52,0xFF,
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  0xFE,0xFE,0xFE,0xFE,0x52,0xFF,0xA3,0xFF,
/* tile 6 */

  0xAD,0xA3,0x52,0xFE,0xFE,0xFE,0xFE,0xFE,
  0xAD,0xAD,0x52,0xFE,0xFE,0xFE,0xFE,0xFE,
  0xAD,0xAD,0x52,0xFE,0xFE,0xFE,0xFE,0xFE,
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  0xAD,0xAD,0xAD,0xAD,0xAD,0x52,0x52,0xFE,
/* tile 7 */

  0xFE,0xFE,0xFE,0xFE,0xFE,0xFE,0xFE,0xFE,
  0x52,0xFE,0xFE,0xFE,0xFE,0xFE,0xFE,0xFE,
  0xAD,0x52,0xFE,0xFE,0xFE,0xFE,0xFE,0xFE,
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  0xAD,0xA3,0xAD,0x52,0xFE,0xFE,0xFE,0xFE,
/* tile 8 */

  0xF6,0x52,0x52,0xFE,0xFE,0xFE,0xFE,0xFE,
  0x52,0xFE,0xFE,0xFE,0xFE,0xFE,0xFE,0xFE,
  0x52,0xFE,0xFE,0xFE,0xFE,0xFE,0xFE,0xFE,
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  0xFE,0xFE,0xFE,0xFE,0xFE,0xFE,0xFE,0xFE,
/* tile 9 */

  0xFE,0xFE,0xFE,0xFE,0xFE,0x52,0x52,0xF5,
  0xFE,0xFE,0xFE,0xFE,0xFE,0xFE,0xFE,0x52,
  0xFE,0xFE,0xFE,0xFE,0xFE,0xFE,0xFE,0x52,
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  0xFE,0xFE,0xFE,0xFE,0xFE,0xFE,0xFE,0xFE,