///////////////////////////////////////////////////
///////////////////////////////////////////////////
///////////////////////////////////////////////////
///////////////////////////////////////////////////
/////////////////BORDER////////////////////////////
///////////////////////////////////////////////////
///////////////////////////////////////////////////
///////////////////////////////////////////////////
///////////////////////////////////////////////////

/* tile 0 */

  0xFF,0xFF,0xFF,0xFF,0xFF,0xFF,0xFF,0xFF,
  0xFF,0xFF,0xFF,0xFF,0xFF,0xFF,0xFF,0xFF,
  0xFF,0xFF,0xFF,0xFF,0xFF,0xFF,0xFF,0xFF,
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  0xFF,0xFF,0xFF,0xFF,0xFF,0xFF,0xFF,0xFF,
/* tile 1 */

  0xFF,0xFF,0xFF,0xFF,0xF6,0xF6,0xF6,0xF6,
  0xFF,0xFF,0xFF,0xF6,0xAD,0xAD,0xAD,0xAD,
  0xFF,0xFF,0xFF,0xAD,0xAD,0xAD,0xAD,0xAD,
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  0xAD,0xEA,0xF2,0xF3,0xF3,0xF2,0xF2,0xEA,
/* tile 2 */

  0xFF,0xFF,0xFF,0xFF,0xFF,0xFF,0xFF,0xFF,
  0xF6,0xFF,0xFF,0xFF,0xFF,0xFF,0xFF,0xFF,
  0xAD,0xF6,0xFF,0xFF,0xFF,0xFF,0xFF,0xFF,
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  0xEA,0xA3,0xF5,0xF5,0xF5,0xF5,0xF5,0xAD,
/* tile 3 */

  0xFF,0xFF,0xFF,0xFF,0xFF,0xFF,0xF6,0xAD,
  0xFF,0xFF,0xFF,0xFF,0xFF,0xF6,0xAD,0xF5,
  0xFF,0xFF,0xFF,0xFF,0xFF,0xF6,0xAD,0xF5,
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  0xFF,0xF6,0xAD,0xAD,0xAD,0xF5,0xA3,0xEA,
/* tile 4 */

  0xAD,0xF6,0xFF,0xFF,0xFF,0xFF,0xFF,0xFF,
  0xF5,0xAD,0xF6,0xFF,0xFF,0xFF,0xFF,0xFF,
  0xF5,0xAD,0xF6,0xFF,0xFF,0xFF,0xFF,0xFF,
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  0xEA,0xA3,0xF5,0xAD,0xAD,0xAD,0xF6,0xFF,
/* tile 5 */

  0xF6,0xAD,0xAD,0xAD,0xF5,0xF5,0xA3,0xEA,
  0xF6,0xAD,0xAD,0xAD,0xF5,0xA3,0xEA,0xEA,
  0xF6,0xAD,0xAD,0xAD,0xAD,0xA3,0xEA,0xEA,
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  0xFF,0xFF,0xFF,0xFF,0xF5,0xF5,0xAD,0xEA,
/* tile 6 */

  0xEA,0xA3,0xF5,0xF5,0xAD,0xAD,0xAD,0xF6,
  0xEA,0xEA,0xA3,0xF5,0xAD,0xAD,0xAD,0xF6,
  0xEA,0xF2,0xA3,0xAD,0xAD,0xAD,0xAD,0xF6,
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  0xEA,0xAD,0xF5,0xF5,0xFF,0xFF,0xFF,0xFF,

#define NUMBORDERTILES 7