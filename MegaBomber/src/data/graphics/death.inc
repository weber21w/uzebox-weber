/* tile 0 */

  0,0,0,0,0,1,1,1,
  0,0,0,1,1,2,3,3,
  0,0,1,2,3,3,3,3,
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  0,1,2,4,5,1,5,5,
/* tile 1 */

  0,1,2,4,1,5,1,5,
  0,1,1,1,4,4,4,4,
  1,4,6,4,1,2,2,2,
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  0,0,1,1,2,5,5,5,
/* tile 2 */

  0,0,1,1,1,2,5,5,
  0,1,6,6,6,1,2,5,
  0,1,4,4,6,1,1,2,
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  0,0,0,0,1,1,1,1,
/* tile 3 */

  0,0,0,0,0,1,1,1,
  0,0,0,1,1,2,3,3,
  0,0,1,2,3,3,3,3,
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  0,1,2,4,5,5,1,5,
/* tile 4 */

  0,1,1,1,4,4,4,4,
  1,4,6,4,1,1,1,1,
  1,6,6,6,1,1,2,2,
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  0,0,1,2,4,1,0,0,
/* tile 5 */

  0,0,1,2,1,0,0,0,
  0,1,1,1,6,1,1,0,
  0,1,4,1,2,1,4,1,
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  0,0,0,0,1,1,1,1,
/* tile 6 */

  0,0,0,0,0,1,1,1,
  0,0,0,1,1,2,3,3,
  0,0,1,2,4,4,4,4,
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  0,1,4,1,2,2,4,1,
/* tile 7 */

  1,4,1,2,1,0,0,0,
  1,1,2,1,0,0,0,0,
  0,1,2,4,0,0,0,0,
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  1,2,4,1,0,0,0,0,
/* tile 8 */

  1,2,2,4,0,0,0,0,
  0,1,4,1,0,0,0,0,
  1,1,2,4,1,1,0,0,
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  0,0,0,0,1,1,1,1,
/* tile 9 */

  0,0,0,0,0,0,0,0,
  0,0,0,0,0,0,0,0,
  0,0,0,0,0,0,0,0,
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  0,0,0,0,0,0,0,0,
/* tile 10 */

  0,0,0,0,0,0,0,0,
  0,0,0,0,0,0,0,0,
  0,1,0,0,0,0,0,0,
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  0,1,0,0,0,0,0,0,
/* tile 11 */

  1,4,1,0,0,0,0,0,
  0,1,0,0,0,0,0,0,
  0,0,0,0,0,0,0,0,
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  0,0,0,0,0,0,0,0,

/*
const char pallet[] PROGMEM = {
254,
1,
12,
15,
39,
14,
47,
0,
7,
}
*/