#define FLOOR_START 0
#define FLOOR_END FLOOR_START+3
#define BLOCK_START FLOOR_END+1
#define BLOCK_END BLOCK_START+23
#define WALL_START BLOCK_END+1
#define WALL_END WALL_START+3
#define FIRE_START WALL_END+1
#define FIRE_CENTER FIRE_START+8
#define FIRE_TOP_TIP    FIRE_START+12
#define FIRE_VERT FIRE_START+0
#define FIRE_HORZ FIRE_START+4
#define FIRE_DOWN FIRE_START+0
#define FIRE_LEFT FIRE_START+4
#define FIRE_RIGHT FIRE_START+4
#define FIRE_BOTTOM_TIP FIRE_START+16
#define FIRE_LEFT_TIP   FIRE_START+20
#define FIRE_RIGHT_TIP  FIRE_START+24
#define FIRE_TILES_PER_FRAME 28
#define FIRE_END   FIRE_START+83
#define BOMB_START FIRE_END+1
#define BOMB_END   BOMB_START+11
#define ZERO_OFFSET BOMB_END+1
#define POWERUP_START ZERO_OFFSET+11
#define POWERUP_END POWERUP_START+23
#define NUM_STANDARD_TILES POWER_UP_END

#define NUM_SPECIAL_TILES 44

#define SPECIAL_START POWERUP_END+1
#define SPECIAL_END SPECIAL_START+NUMSPECIALTILES-1
#define SPECIAL_SOLID_START SPECIAL_START+4
#define SPECIAL_SOLID_END SPECIAL_SOLID_START+19
#define SPECIAL_FOREGROUND_START SPECIAL_SOLID_START+18
#define SPECIAL_FOREGROUND_END SPECIAL_FOREGROUND_START+9
#define SPECIAL_OCCLUSION_START SPECIAL_FOREGROUND_END+1
#define SPECIAL_OCCLUSION_END SPECIAL_OCCLUSION_START+7


#define BORDER_START SPECIAL_END+1

#define MENUSTART 1
#define NUMERALSTART 40//82
#define ALPHASTART NUMERALSTART+10
#define CURSORSTART 9
#define BLANKT 0