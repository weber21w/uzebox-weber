///////////////////////////////////////////////////
///////////////////////////////////////////////////
///////////////////////////////////////////////////
///////////////////////////////////////////////////
/////////////////BORDER////////////////////////////
///////////////////////////////////////////////////
///////////////////////////////////////////////////
///////////////////////////////////////////////////
///////////////////////////////////////////////////

/* tile 0 */

  0x09,0x09,0x09,0x09,0x09,0x09,0x09,0x09,
  0x09,0x09,0x09,0x09,0x09,0x09,0x09,0x09,
  0x09,0x09,0x09,0x09,0x09,0x09,0x09,0x09,
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  0x19,0x11,0x19,0x11,0x19,0x11,0x19,0x11,
/* tile 1 */

  0x09,0x09,0x09,0x11,0x09,0x11,0x19,0x11,
  0x09,0x09,0x09,0x09,0x11,0x09,0x11,0x19,
  0x09,0x09,0x09,0x11,0x09,0x11,0x19,0x11,
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  0x09,0x09,0x09,0x09,0x11,0x09,0x11,0x19,
/* tile 2 */

  0x19,0x19,0x19,0x19,0x19,0x19,0x19,0x19,
  0x19,0x19,0x19,0x19,0x19,0x19,0x19,0x19,
  0x19,0x19,0x19,0x19,0x19,0x19,0x19,0x19,
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  0x19,0x19,0x19,0x19,0x01,0x53,0xA3,0x01,
/* tile 3 */

  0x19,0x19,0x19,0x19,0x19,0x19,0x19,0x19,
  0x19,0x19,0x19,0x19,0x19,0x19,0x19,0x19,
  0x19,0x19,0x19,0x19,0x19,0x19,0x19,0x19,
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  0x01,0x01,0x01,0x01,0x01,0x01,0x01,0x01,
/* tile 4 */

  0x19,0x19,0x19,0x19,0x19,0x19,0x19,0x19,
  0x19,0x19,0x19,0x19,0x19,0x19,0x19,0x19,
  0x19,0x19,0x19,0x19,0x19,0x19,0x19,0x19,
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  0x01,0xA3,0x53,0x01,0x19,0x19,0x19,0x19,
/* tile 5 */

  0x11,0x19,0x11,0x09,0x11,0x09,0x09,0x09,
  0x19,0x11,0x09,0x11,0x09,0x09,0x09,0x09,
  0x11,0x19,0x11,0x09,0x11,0x09,0x09,0x09,
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  0x19,0x11,0x09,0x11,0x09,0x09,0x09,0x09,
/* tile 6 */

  0x19,0x19,0x19,0x19,0x01,0x53,0xA3,0x01,
  0x19,0x19,0x19,0x19,0x01,0x53,0xA3,0x01,
  0x19,0x19,0x19,0x19,0x01,0x53,0xA3,0x01,
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  0x19,0x19,0x19,0x19,0x01,0x53,0xA3,0x01,
/* tile 7 */

  0x01,0xA3,0x53,0x01,0x19,0x19,0x19,0x19,
  0x01,0xA3,0x53,0x01,0x19,0x19,0x19,0x19,
  0x01,0xA3,0x53,0x01,0x19,0x19,0x19,0x19,
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  0x01,0xA3,0x53,0x01,0x19,0x19,0x19,0x19,

#define NUMBORDERTILES 8