///////////////////////////////////////////////////
///////////////////////////////////////////////////
///////////////////////////////////////////////////
///////////////////////////////////////////////////
/////////////////SPECIALS//////////////////////////
///////////////////////////////////////////////////
///////////////////////////////////////////////////
///////////////////////////////////////////////////
///////////////////////////////////////////////////

#define SPECIALSTARTTILE NUMMAPTILES+NUMBORDERTILES
///////////////////cracked ice/////////////////////////////////
/* tile 0 */

  0xEA,0xFD,0xF3,0xF3,0xF2,0xF2,0xEA,0xEA,
  0xFD,0xF3,0xF3,0xF2,0xF2,0xEA,0xEA,0xEA,
  0xFD,0xF3,0xF2,0xF2,0xEA,0xEA,0xEA,0xEA,
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  0xEA,0xEA,0xEA,0xEA,0xFF,0xFF,0xFD,0xEA,
/* tile 1 */

  0xEA,0xFD,0xEA,0xF2,0xF3,0xF2,0xFD,0xFD,
  0xEA,0xFD,0xF2,0xF3,0xF2,0xEA,0xFD,0xEA,
  0xEA,0xF2,0xFD,0xFF,0xFD,0xFD,0xEA,0xF2,
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  0xFF,0xEA,0xF2,0xF3,0xF3,0xF2,0xF2,0xEA,
/* tile 2 */

  0xEA,0xEA,0xEA,0xFD,0xF3,0xF2,0xEA,0xFD,
  0xEA,0xEA,0xFD,0xF3,0xF2,0xEA,0xEA,0xEA,
  0xFD,0xFD,0xFF,0xF2,0xEA,0xEA,0xEA,0xFF,
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  0xEA,0xEA,0xFD,0xF3,0xF3,0xF2,0xF2,0xEA,
/* tile 3 */

  0xFF,0xF2,0xF3,0xF3,0xF2,0xF2,0xEA,0xEA,
  0xFF,0xFF,0xFD,0xF2,0xF2,0xEA,0xFF,0xFD,
  0xF3,0xF3,0xF2,0xFD,0xEA,0xFF,0xEA,0xEA,
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  0xEA,0xFD,0xEA,0xEA,0xF2,0xF3,0xFD,0xEA,
/* tile 4 */

  0xEA,0xFD,0xF3,0xF3,0xF2,0xF2,0xEA,0xEA,
  0xFD,0xF3,0xF3,0xF2,0xF2,0xEA,0xEA,0xEA,
  0xFD,0xF3,0xF2,0xF2,0xEA,0xEA,0xE0,0xEA,
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  0xEA,0xE0,0xAD,0xAD,0x52,0x52,0x52,0x52,
/* tile 5 */

  0xEA,0xFD,0xEA,0xF2,0xF3,0xF2,0xFD,0xFD,
  0xEA,0xFD,0xF2,0xF3,0xF2,0xEA,0xFD,0xEA,
  0xEA,0xF2,0xFD,0xFF,0xFD,0xFD,0xEA,0xF2,
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  0x52,0x52,0x52,0x52,0x52,0xE0,0xF2,0xEA,
/* tile 6 */

  0xEA,0xE0,0xAD,0x52,0x52,0x52,0x52,0x52,
  0xEA,0xE0,0x52,0x52,0x52,0x52,0x52,0x52,
  0xFD,0xE0,0x52,0x52,0x52,0x52,0x52,0x52,
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  0xEA,0xEA,0xFD,0xF3,0xF3,0xF2,0xF2,0xEA,
/* tile 7 */

  0x52,0x52,0x52,0x52,0x52,0xE0,0xEA,0xEA,
  0x52,0x52,0x52,0x52,0xE0,0xE0,0xFF,0xFD,
  0x52,0x52,0x52,0x52,0xE0,0xFF,0xEA,0xEA,
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  0xEA,0xFD,0xEA,0xEA,0xF2,0xF3,0xFD,0xEA,

/////////////////////start igloo/////////////////////////////
/////////////
//////////
///////
/////
///
//
//






/* tile 0 */

  0xEA,0xF2,0xF3,0xF3,0xF2,0xF2,0xEA,0xEA,
  0xF2,0xF3,0xF3,0xF2,0xF2,0xEA,0xEA,0xEA,
  0xF3,0xF3,0xF2,0xF2,0xEA,0xEA,0xEA,0xEA,
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  0xEA,0xEA,0xEA,0xEA,0xF2,0xF3,0x52,0xFF,
/* tile 1 */

  0xEA,0xEA,0xEA,0xF2,0xF3,0xF2,0xEA,0xEA,
  0xEA,0xEA,0xF2,0xF3,0xF2,0xEA,0xEA,0xEA,
  0xEA,0xF2,0xF3,0xF2,0xEA,0x52,0x52,0x52,
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  0xA3,0xA3,0x52,0xFF,0xFF,0xFF,0xFF,0xFF,
/* tile 2 */

  0xEA,0xEA,0xEA,0xF2,0xF3,0x52,0xA3,0xA3,
  0xEA,0xEA,0xF2,0xF3,0xF2,0x52,0xFF,0xFF,
  0xEA,0xF2,0xF3,0xF2,0x52,0xFF,0xFF,0xFF,
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  0xEA,0x52,0xFF,0x52,0xF5,0xF5,0xF5,0x52,
/* tile 3 */

  0xEA,0xF2,0xF3,0xF3,0xF2,0xF2,0xEA,0xEA,
  0xF2,0xF3,0xF3,0xF2,0xF2,0xEA,0xEA,0xEA,
  0x52,0x52,0x52,0xF2,0xEA,0xEA,0xEA,0xEA,
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  0xAD,0xAD,0xAD,0xAD,0xAD,0x52,0xA3,0xA3,
/* tile 4 */

  0xEA,0xEA,0xEA,0xF2,0xF3,0xF2,0xEA,0xEA,
  0xEA,0xEA,0xF2,0xF3,0xF2,0xEA,0xEA,0xEA,
  0xEA,0xF2,0xF3,0xF2,0xEA,0xEA,0xEA,0xF2,
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  0xAD,0x52,0xF2,0xF3,0xF3,0xF2,0xF2,0xEA,
/* tile 5 */

  0xA3,0xA3,0x52,0xF3,0xF2,0xF2,0xEA,0xEA,
  0xAD,0xAD,0x52,0xF2,0xF2,0xEA,0xEA,0xEA,
  0xAD,0xAD,0xAD,0x52,0xEA,0xEA,0xEA,0xEA,
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  0x52,0xF5,0xF5,0xF5,0x52,0xAD,0x52,0xEA,
/* tile 6 */

  0xEA,0xF2,0xF3,0x52,0xFF,0xFF,0xA3,0xA3,
  0xF2,0xF3,0xF3,0x52,0xFF,0xFF,0xA3,0xFF,
  0xF3,0xF3,0xF2,0x52,0xFF,0xA3,0xFF,0xF6,
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  0xEA,0xEA,0xEA,0xEA,0xF2,0x52,0xF6,0xF6,
/* tile 7 */

  0xF6,0xA3,0xF6,0xF6,0xF6,0xF6,0xF6,0xF6,
  0xA3,0xA3,0xF6,0xF6,0xF6,0xF6,0xF6,0xF6,
  0xF6,0xA3,0xF6,0xF6,0xF6,0xF6,0xF6,0xF6,
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  0xF6,0xF6,0xA3,0xF6,0xF6,0xF6,0xF6,0x52,
/* tile 8 */

  0xEA,0xEA,0xEA,0xF2,0xF3,0xF2,0x52,0xF6,
  0xEA,0xEA,0xF2,0xF3,0xF2,0xEA,0xEA,0x52,
  0xEA,0xF2,0xF3,0xF2,0xEA,0xEA,0xEA,0xF2,
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  0xEA,0xEA,0xF2,0xF3,0xF3,0xF2,0xF2,0xEA,
/* tile 9 */

  0xF6,0xF6,0xA3,0xF6,0xF6,0xF6,0xF6,0x52,
  0xF6,0xF6,0xA3,0xF6,0xF6,0xF6,0xF6,0x52,
  0x52,0xF6,0xA3,0xF6,0xF6,0xF6,0xF6,0x52,
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  0xEA,0xEA,0xEA,0xEA,0xF2,0xF3,0xF2,0xEA,
/* tile 10 */

  0xF5,0xAD,0xAD,0xAD,0xAD,0xAD,0xA3,0xAD,
  0xF5,0xAD,0xAD,0xAD,0xAD,0xAD,0xA3,0xA3,
  0xF5,0xF5,0xAD,0xAD,0xAD,0xAD,0xA3,0xAD,
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  0x52,0xF5,0xF5,0xAD,0xAD,0xA3,0xAD,0xAD,
/* tile 11 */

  0xA3,0xA3,0xAD,0xAD,0x52,0xF2,0xEA,0xEA,
  0xAD,0xA3,0xAD,0xAD,0x52,0xEA,0xEA,0xEA,
  0xAD,0xAD,0xA3,0xAD,0x52,0xEA,0xEA,0xF2,
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  0xAD,0xAD,0x52,0xF3,0xF3,0xF2,0xF2,0xEA,
/* tile 12 */

  0x52,0xF5,0xF5,0xAD,0xAD,0xA3,0xAD,0xAD,
  0x52,0xF5,0xF5,0xF5,0xAD,0xA3,0xAD,0xAD,
  0x52,0xF5,0xF5,0xF5,0xAD,0xA3,0xAD,0x52,
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  0xEA,0xEA,0xF2,0xF3,0xF3,0xF2,0xF2,0xEA,
/* tile 13 */

  0xAD,0x52,0xF3,0xF3,0xF2,0xF2,0xEA,0xEA,
  0x52,0xF3,0xF3,0xF2,0xF2,0xEA,0xEA,0xEA,
  0xF3,0xF3,0xF2,0xF2,0xEA,0xEA,0xEA,0xEA,
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  0xEA,0xEA,0xEA,0xEA,0xF2,0xF3,0xF2,0xEA,
/* tile 14 */

  0xFF,0xFF,0x52,0xFF,0xFF,0xFF,0xFF,0xFF,
  0xFF,0x52,0xFF,0xFF,0xFF,0xFF,0xFF,0xFF,
  0xFF,0x52,0x52,0x52,0x52,0x52,0xFF,0xFF,
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  0xEA,0xEA,0xEA,0xEA,0xF2,0x52,0xFF,0xA3,
/* tile 15 */

  0xAD,0xAD,0xAD,0xAD,0xAD,0x52,0xAD,0xAD,
  0xAD,0xAD,0xAD,0xAD,0xAD,0xAD,0x52,0xAD,
  0xF5,0xAD,0x52,0x52,0x52,0x52,0x52,0xAD,
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  0xA3,0xAD,0x52,0xF3,0xF3,0xF2,0xF2,0xEA,
/* tile 16 */

  0xEA,0xF2,0xF3,0xF3,0x52,0x52,0x52,0x52,
  0xF2,0x52,0x52,0x52,0xF6,0xF6,0xF6,0xF6,
  0x52,0xFF,0xFF,0xF6,0xF6,0xF6,0xF6,0xF6,
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  0xFF,0xFF,0xFF,0xA3,0xA3,0xFF,0xFF,0xFF,
/* tile 17 */

  0x52,0x52,0x52,0x52,0xF3,0xF2,0xEA,0xEA,
  0xF6,0xF6,0xF6,0xF6,0x52,0x52,0x52,0xEA,
  0xF6,0xF6,0xF6,0xF6,0xF6,0xF6,0xF6,0x52,
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  0xFF,0xFF,0xF6,0xA3,0xA3,0xF5,0xF5,0xF5,
/* tile 18 */

  0xEA,0xEA,0xEA,0xF2,0xF3,0x52,0xA3,0xFF,
  0xEA,0xEA,0xF2,0xF3,0xF2,0x52,0xFF,0xFF,
  0xEA,0xF2,0xF3,0xF2,0xEA,0x52,0xFF,0xFF,
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  0xEA,0x52,0x52,0xFF,0xFF,0xFF,0xFF,0xFF,
/* tile 19 */

  0xEA,0xEA,0xEA,0xF2,0xF3,0xF2,0xEA,0xEA,
  0xEA,0xEA,0xF2,0xF3,0xF2,0xEA,0xEA,0x52,
  0xEA,0xF2,0xF3,0xF2,0xEA,0xEA,0x52,0xFF,
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  0xEA,0xEA,0xF2,0xF3,0x52,0xFF,0xA3,0xFF,
/* tile 20 */

  0xAD,0xA3,0x52,0xF3,0xF2,0xF2,0xEA,0xEA,
  0xAD,0xAD,0x52,0xF2,0xF2,0xEA,0xEA,0xEA,
  0xAD,0xAD,0x52,0xF2,0xEA,0xEA,0xEA,0xEA,
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  0xAD,0xAD,0xAD,0xAD,0xAD,0x52,0x52,0xEA,
/* tile 21 */

  0xEA,0xF2,0xF3,0xF3,0xF2,0xF2,0xEA,0xEA,
  0x52,0xF3,0xF3,0xF2,0xF2,0xEA,0xEA,0xEA,
  0xAD,0x52,0xF2,0xF2,0xEA,0xEA,0xEA,0xEA,
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  0xAD,0xA3,0xAD,0x52,0xF2,0xF3,0xF2,0xEA,
/* tile 22 */

  0xF6,0x52,0x52,0xF3,0xF2,0xF2,0xEA,0xEA,
  0x52,0xF3,0xF3,0xF2,0xF2,0xEA,0xEA,0xEA,
  0x52,0xF3,0xF2,0xF2,0xEA,0xEA,0xEA,0xEA,
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  0xEA,0xEA,0xEA,0xEA,0xF2,0xF3,0xF2,0xEA,
/* tile 23 */

  0xEA,0xEA,0xEA,0xF2,0xF3,0x52,0x52,0xF5,
  0xEA,0xEA,0xF2,0xF3,0xF2,0xEA,0xEA,0x52,
  0xEA,0xF2,0xF3,0xF2,0xEA,0xEA,0xEA,0x52,
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  0xEA,0xEA,0xF2,0xF3,0xF3,0xF2,0xF2,0xEA,
/* tile 24 */

  0xFF,0xFF,0xA3,0xFF,0xFF,0xFF,0xFF,0xFF,
  0xFF,0xA3,0xFF,0xA3,0xFF,0xFF,0xA3,0xA3,
  0xFF,0xA3,0xFF,0xFF,0xA3,0xA3,0xFF,0xFF,
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  0xA3,0xFF,0xFF,0xFF,0xFF,0xA3,0xFF,0xFF,
/* tile 25 */

  0xFF,0xFF,0xF6,0xF6,0xF6,0xA3,0xF5,0xAD,
  0xA3,0xA3,0xFF,0xF6,0xA3,0xF6,0xA3,0xF5,
  0xFF,0xFF,0xA3,0xA3,0xF6,0xF6,0xA3,0xF5,
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  0xFF,0xFF,0xA3,0xFF,0xF6,0xF6,0xF6,0xA3,
/* tile 26 */

  0xA3,0xFF,0xFF,0xFF,0xA3,0xFF,0xA3,0xA3,
  0xFF,0xA3,0xFF,0xFF,0xA3,0xFF,0xFF,0xFF,
  0xFF,0xA3,0xFF,0xA3,0xFF,0xFF,0xFF,0xFF,
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  0xFF,0xFF,0xFF,0xA3,0xFF,0xFF,0xFF,0xFF,
/* tile 27 */

  0xA3,0xA3,0xFF,0xA3,0xF6,0xF6,0xF6,0xA3,
  0xFF,0xFF,0xFF,0xA3,0xF6,0xF6,0xA3,0xF5,
  0xFF,0xFF,0xFF,0xF6,0xA3,0xF6,0xA3,0xF5,
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  0xF6,0xF6,0xF6,0xF5,0xA3,0xAD,0xAD,0xAD,
/* tile 28 */

  0xFF,0xFF,0xFF,0xA3,0xFF,0xFF,0xF6,0xF6,
  0xFF,0xFF,0xA3,0xFF,0xF6,0xF6,0xF6,0xF6,
  0xF6,0xF6,0xA3,0xF6,0xF6,0xF6,0xF6,0xF6,
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  0xF6,0xF6,0xF5,0x52,0x52,0x52,0x52,0x52,
/* tile 29 */

  0xF6,0xF6,0xF5,0xF5,0xA3,0xAD,0xAD,0xAD,
  0xF6,0xF5,0xF5,0xF5,0xAD,0xA3,0xAD,0xAD,
  0xF5,0xF5,0xF5,0xAD,0xAD,0xA3,0xAD,0xAD,
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  0x52,0x52,0x52,0x52,0x52,0xF5,0xF5,0xF5,
/* tile 30 */

  0x52,0xFF,0xFF,0x52,0xFF,0xFF,0xFF,0xFF,
  0xFF,0xFF,0xF6,0x52,0xF6,0xF6,0xFF,0xFF,
  0xFF,0xFF,0xF6,0xF6,0x52,0xF6,0xF6,0xF6,
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  0xF6,0xF6,0xA3,0xF6,0xF6,0xF6,0xF6,0xF6,
/* tile 31 */

  0xAD,0xAD,0xAD,0xAD,0x52,0xAD,0xAD,0x52,
  0xAD,0xAD,0xAD,0xAD,0x52,0xAD,0xAD,0xAD,
  0xAD,0xAD,0xAD,0x52,0xAD,0xAD,0xAD,0xAD,
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  0xAD,0xAD,0xAD,0xAD,0xAD,0xA3,0xAD,0xAD,
/* tile 32 */

  0xEA,0xEA,0xEA,0xF2,0xF3,0xF2,0xEA,0xEA,
  0xEA,0xEA,0xF2,0xF3,0xF2,0xEA,0xEA,0xEA,
  0xEA,0xF2,0xF3,0xF2,0xEA,0xEA,0xEA,0xF2,
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  0xEA,0xEA,0xF2,0xF3,0xF3,0xF2,0xF2,0xEA,
/* tile 33 */

  0xEA,0xF2,0xF3,0xF3,0xF2,0xF2,0xEA,0xEA,
  0xF2,0xF3,0xF3,0xF2,0xF2,0xEA,0xEA,0xEA,
  0xF3,0xF3,0xF2,0xF2,0xEA,0xEA,0xEA,0xEA,
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  0xEA,0xEA,0xEA,0xEA,0xF2,0xF3,0xF2,0xEA,
/* tile 34 */

  0xEA,0x52,0x52,0xF5,0xF5,0xF5,0x52,0xEA,
  0xF2,0x52,0x52,0xF5,0xF5,0xF5,0x52,0xEA,
  0xF3,0x52,0x52,0x52,0x52,0x52,0x52,0xEA,
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  0xEA,0xEA,0xEA,0xEA,0xF2,0xF3,0xF2,0xEA,
/* tile 35 */

  0xEA,0x52,0xF5,0xF5,0xF5,0x52,0x52,0xEA,
  0xEA,0x52,0xF5,0xF5,0xF5,0x52,0x52,0xEA,
  0xEA,0x52,0x52,0x52,0x52,0x52,0x52,0xF2,
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  0xEA,0xEA,0xF2,0xF3,0xF3,0xF2,0xF2,0xEA,