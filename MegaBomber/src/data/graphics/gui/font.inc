/* tile 0 */

  0x00,0x00,0x00,0x00,0x00,0x00,0x00,0x00,
  0x00,0x00,0x00,0x00,0x00,0x00,0x00,0x00,
  0x00,0x00,0x00,0x00,0x00,0x00,0x00,0x00,
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  0x00,0x00,0x00,0x00,0x00,0x00,0x00,0x00,
/* tile 1 */

  0x00,0x00,0xFF,0xFF,0xFF,0x00,0x00,0x00,
  0x00,0x00,0xFF,0xFF,0xFF,0x00,0x00,0x00,
  0x00,0x00,0xFF,0xFF,0xFF,0x00,0x00,0x00,
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  0x00,0x00,0x00,0x00,0x00,0x00,0x00,0x00,
/* tile 2 */

  0x00,0x00,0xFF,0xFF,0xFF,0x00,0x00,0x00,
  0x00,0xFF,0x00,0x00,0xFF,0xFF,0x00,0x00,
  0xFF,0xFF,0x00,0x00,0x00,0xFF,0xFF,0x00,
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  0x00,0x00,0x00,0x00,0x00,0x00,0x00,0x00,
/* tile 3 */

  0x00,0x00,0x00,0xFF,0xFF,0x00,0x00,0x00,
  0x00,0x00,0xFF,0xFF,0xFF,0x00,0x00,0x00,
  0x00,0x00,0x00,0xFF,0xFF,0x00,0x00,0x00,
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  0x00,0x00,0x00,0x00,0x00,0x00,0x00,0x00,
/* tile 4 */

  0x00,0xFF,0xFF,0xFF,0xFF,0xFF,0x00,0x00,
  0xFF,0xFF,0x00,0x00,0x00,0xFF,0xFF,0x00,
  0x00,0x00,0x00,0x00,0xFF,0xFF,0xFF,0x00,
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  0x00,0x00,0x00,0x00,0x00,0x00,0x00,0x00,
/* tile 5 */

  0x00,0xFF,0xFF,0xFF,0xFF,0xFF,0xFF,0x00,
  0x00,0x00,0x00,0x00,0xFF,0xFF,0x00,0x00,
  0x00,0x00,0x00,0xFF,0xFF,0x00,0x00,0x00,
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  0x00,0x00,0x00,0x00,0x00,0x00,0x00,0x00,
/* tile 6 */

  0x00,0x00,0x00,0xFF,0xFF,0xFF,0x00,0x00,
  0x00,0x00,0xFF,0xFF,0xFF,0xFF,0x00,0x00,
  0x00,0xFF,0xFF,0x00,0xFF,0xFF,0x00,0x00,
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  0x00,0x00,0x00,0x00,0x00,0x00,0x00,0x00,
/* tile 7 */

  0xFF,0xFF,0xFF,0xFF,0xFF,0xFF,0x00,0x00,
  0xFF,0xFF,0x00,0x00,0x00,0x00,0x00,0x00,
  0xFF,0xFF,0xFF,0xFF,0xFF,0xFF,0x00,0x00,
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  0x00,0x00,0x00,0x00,0x00,0x00,0x00,0x00,
/* tile 8 */

  0x00,0x00,0xFF,0xFF,0xFF,0xFF,0x00,0x00,
  0x00,0xFF,0xFF,0x00,0x00,0x00,0x00,0x00,
  0xFF,0xFF,0x00,0x00,0x00,0x00,0x00,0x00,
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  0x00,0x00,0x00,0x00,0x00,0x00,0x00,0x00,
/* tile 9 */

  0xFF,0xFF,0xFF,0xFF,0xFF,0xFF,0xFF,0x00,
  0xFF,0xFF,0x00,0x00,0x00,0xFF,0xFF,0x00,
  0x00,0x00,0x00,0x00,0xFF,0xFF,0x00,0x00,
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  0x00,0x00,0x00,0x00,0x00,0x00,0x00,0x00,
/* tile 10 */

  0x00,0xFF,0xFF,0xFF,0xFF,0x00,0x00,0x00,
  0xFF,0xFF,0x00,0x00,0x00,0xFF,0x00,0x00,
  0xFF,0xFF,0xFF,0x00,0x00,0xFF,0x00,0x00,
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  0x00,0x00,0x00,0x00,0x00,0x00,0x00,0x00,
/* tile 11 */

  0x00,0xFF,0xFF,0xFF,0xFF,0xFF,0x00,0x00,
  0xFF,0xFF,0x00,0x00,0x00,0xFF,0xFF,0x00,
  0xFF,0xFF,0x00,0x00,0x00,0xFF,0xFF,0x00,
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  0x00,0x00,0x00,0x00,0x00,0x00,0x00,0x00,
/* tile 12 */

  0x00,0x00,0xFF,0xFF,0xFF,0x00,0x00,0x00,
  0x00,0xFF,0xFF,0x00,0xFF,0xFF,0x00,0x00,
  0xFF,0xFF,0x00,0x00,0x00,0xFF,0xFF,0x00,
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  0x00,0x00,0x00,0x00,0x00,0x00,0x00,0x00,
/* tile 13 */

  0xFF,0xFF,0xFF,0xFF,0xFF,0xFF,0x00,0x00,
  0xFF,0xFF,0x00,0x00,0x00,0xFF,0xFF,0x00,
  0xFF,0xFF,0x00,0x00,0x00,0xFF,0xFF,0x00,
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  0x00,0x00,0x00,0x00,0x00,0x00,0x00,0x00,
/* tile 14 */

  0x00,0x00,0xFF,0xFF,0xFF,0xFF,0x00,0x00,
  0x00,0xFF,0xFF,0x00,0x00,0xFF,0xFF,0x00,
  0xFF,0xFF,0x00,0x00,0x00,0x00,0x00,0x00,
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  0x00,0x00,0x00,0x00,0x00,0x00,0x00,0x00,
/* tile 15 */

  0xFF,0xFF,0xFF,0xFF,0xFF,0x00,0x00,0x00,
  0xFF,0xFF,0x00,0x00,0xFF,0xFF,0x00,0x00,
  0xFF,0xFF,0x00,0x00,0x00,0xFF,0xFF,0x00,
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  0x00,0x00,0x00,0x00,0x00,0x00,0x00,0x00,
/* tile 16 */

  0xFF,0xFF,0xFF,0xFF,0xFF,0xFF,0xFF,0x00,
  0xFF,0xFF,0x00,0x00,0x00,0x00,0x00,0x00,
  0xFF,0xFF,0x00,0x00,0x00,0x00,0x00,0x00,
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  0x00,0x00,0x00,0x00,0x00,0x00,0x00,0x00,
/* tile 17 */

  0xFF,0xFF,0xFF,0xFF,0xFF,0xFF,0xFF,0x00,
  0xFF,0xFF,0x00,0x00,0x00,0x00,0x00,0x00,
  0xFF,0xFF,0x00,0x00,0x00,0x00,0x00,0x00,
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  0x00,0x00,0x00,0x00,0x00,0x00,0x00,0x00,
/* tile 18 */

  0x00,0x00,0xFF,0xFF,0xFF,0xFF,0xFF,0x00,
  0x00,0xFF,0xFF,0x00,0x00,0x00,0x00,0x00,
  0xFF,0xFF,0x00,0x00,0x00,0x00,0x00,0x00,
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  0x00,0x00,0x00,0x00,0x00,0x00,0x00,0x00,
/* tile 19 */

  0xFF,0xFF,0x00,0x00,0x00,0xFF,0xFF,0x00,
  0xFF,0xFF,0x00,0x00,0x00,0xFF,0xFF,0x00,
  0xFF,0xFF,0x00,0x00,0x00,0xFF,0xFF,0x00,
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  0x00,0x00,0x00,0x00,0x00,0x00,0x00,0x00,
/* tile 20 */

  0x00,0xFF,0xFF,0xFF,0xFF,0xFF,0xFF,0x00,
  0x00,0x00,0x00,0xFF,0xFF,0x00,0x00,0x00,
  0x00,0x00,0x00,0xFF,0xFF,0x00,0x00,0x00,
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  0x00,0x00,0x00,0x00,0x00,0x00,0x00,0x00,
/* tile 21 */

  0x00,0x00,0x00,0xFF,0xFF,0xFF,0xFF,0x00,
  0x00,0x00,0x00,0x00,0xFF,0xFF,0x00,0x00,
  0x00,0x00,0x00,0x00,0xFF,0xFF,0x00,0x00,
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  0x00,0x00,0x00,0x00,0x00,0x00,0x00,0x00,
/* tile 22 */

  0xFF,0xFF,0x00,0x00,0x00,0xFF,0xFF,0x00,
  0xFF,0xFF,0x00,0x00,0xFF,0xFF,0x00,0x00,
  0xFF,0xFF,0x00,0xFF,0xFF,0x00,0x00,0x00,
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  0x00,0x00,0x00,0x00,0x00,0x00,0x00,0x00,
/* tile 23 */

  0x00,0xFF,0xFF,0x00,0x00,0x00,0x00,0x00,
  0x00,0xFF,0xFF,0x00,0x00,0x00,0x00,0x00,
  0x00,0xFF,0xFF,0x00,0x00,0x00,0x00,0x00,
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  0x00,0x00,0x00,0x00,0x00,0x00,0x00,0x00,
/* tile 24 */

  0xFF,0xFF,0x00,0x00,0x00,0xFF,0xFF,0x00,
  0xFF,0xFF,0xFF,0x00,0xFF,0xFF,0xFF,0x00,
  0xFF,0xFF,0xFF,0xFF,0xFF,0xFF,0xFF,0x00,
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  0x00,0x00,0x00,0x00,0x00,0x00,0x00,0x00,
/* tile 25 */

  0xFF,0xFF,0x00,0x00,0x00,0xFF,0xFF,0x00,
  0xFF,0xFF,0xFF,0x00,0x00,0xFF,0xFF,0x00,
  0xFF,0xFF,0xFF,0xFF,0x00,0xFF,0xFF,0x00,
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  0x00,0x00,0x00,0x00,0x00,0x00,0x00,0x00,
/* tile 26 */

  0x00,0xFF,0xFF,0xFF,0xFF,0xFF,0x00,0x00,
  0xFF,0xFF,0x00,0x00,0x00,0xFF,0xFF,0x00,
  0xFF,0xFF,0x00,0x00,0x00,0xFF,0xFF,0x00,
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  0x00,0x00,0x00,0x00,0x00,0x00,0x00,0x00,
/* tile 27 */

  0xFF,0xFF,0xFF,0xFF,0xFF,0xFF,0x00,0x00,
  0xFF,0xFF,0x00,0x00,0x00,0xFF,0xFF,0x00,
  0xFF,0xFF,0x00,0x00,0x00,0xFF,0xFF,0x00,
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  0x00,0x00,0x00,0x00,0x00,0x00,0x00,0x00,
/* tile 28 */

  0x00,0xFF,0xFF,0xFF,0xFF,0xFF,0x00,0x00,
  0xFF,0xFF,0x00,0x00,0x00,0xFF,0xFF,0x00,
  0xFF,0xFF,0x00,0x00,0x00,0xFF,0xFF,0x00,
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  0x00,0x00,0x00,0x00,0x00,0x00,0x00,0x00,
/* tile 29 */

  0xFF,0xFF,0xFF,0xFF,0xFF,0xFF,0x00,0x00,
  0xFF,0xFF,0x00,0x00,0x00,0xFF,0xFF,0x00,
  0xFF,0xFF,0x00,0x00,0x00,0xFF,0xFF,0x00,
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  0x00,0x00,0x00,0x00,0x00,0x00,0x00,0x00,
/* tile 30 */

  0x00,0xFF,0xFF,0xFF,0xFF,0x00,0x00,0x00,
  0xFF,0xFF,0x00,0x00,0xFF,0xFF,0x00,0x00,
  0xFF,0xFF,0x00,0x00,0x00,0x00,0x00,0x00,
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  0x00,0x00,0x00,0x00,0x00,0x00,0x00,0x00,
/* tile 31 */

  0xFF,0xFF,0xFF,0xFF,0xFF,0xFF,0x00,0x00,
  0x00,0x00,0xFF,0xFF,0x00,0x00,0x00,0x00,
  0x00,0x00,0xFF,0xFF,0x00,0x00,0x00,0x00,
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  0x00,0x00,0x00,0x00,0x00,0x00,0x00,0x00,
/* tile 32 */

  0xFF,0xFF,0x00,0x00,0x00,0xFF,0xFF,0x00,
  0xFF,0xFF,0x00,0x00,0x00,0xFF,0xFF,0x00,
  0xFF,0xFF,0x00,0x00,0x00,0xFF,0xFF,0x00,
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  0x00,0x00,0x00,0x00,0x00,0x00,0x00,0x00,
/* tile 33 */

  0xFF,0xFF,0x00,0x00,0x00,0xFF,0xFF,0x00,
  0xFF,0xFF,0x00,0x00,0x00,0xFF,0xFF,0x00,
  0xFF,0xFF,0x00,0x00,0x00,0xFF,0xFF,0x00,
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  0x00,0x00,0x00,0x00,0x00,0x00,0x00,0x00,
/* tile 34 */

  0xFF,0xFF,0x00,0x00,0x00,0xFF,0xFF,0x00,
  0xFF,0xFF,0x00,0x00,0x00,0xFF,0xFF,0x00,
  0xFF,0xFF,0x00,0xFF,0x00,0xFF,0xFF,0x00,
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  0x00,0x00,0x00,0x00,0x00,0x00,0x00,0x00,
/* tile 35 */

  0xFF,0xFF,0x00,0x00,0x00,0xFF,0xFF,0x00,
  0xFF,0xFF,0xFF,0x00,0xFF,0xFF,0xFF,0x00,
  0x00,0xFF,0xFF,0xFF,0xFF,0xFF,0x00,0x00,
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  0x00,0x00,0x00,0x00,0x00,0x00,0x00,0x00,
/* tile 36 */

  0x00,0xFF,0xFF,0x00,0x00,0xFF,0xFF,0x00,
  0x00,0xFF,0xFF,0x00,0x00,0xFF,0xFF,0x00,
  0x00,0xFF,0xFF,0x00,0x00,0xFF,0xFF,0x00,
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  0x00,0x00,0x00,0x00,0x00,0x00,0x00,0x00,
/* tile 37 */

  0xFF,0xFF,0xFF,0xFF,0xFF,0xFF,0xFF,0x00,
  0x00,0x00,0x00,0x00,0xFF,0xFF,0xFF,0x00,
  0x00,0x00,0x00,0xFF,0xFF,0xFF,0x00,0x00,
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  0x00,0x00,0x00,0x00,0x00,0x00,0x00,0x00,