
/////////////////////////TROPHY///////////////////////////////////////////////////////////////////////
////////////////////////////////////////////////////////////////////////////////////////////////////
/* tile 0 */

  0x00,0x00,0x00,0x00,0x0B,0x0B,0x0B,0x0B,
  0x00,0x00,0x00,0x00,0x0B,0x37,0x37,0xBF,
  0x00,0x0B,0x0B,0x0B,0x0B,0x26,0x26,0x2F,
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  0x0B,0x37,0x26,0x0B,0x0B,0x2F,0x37,0xBF,
/* tile 1 */

  0x0B,0x0B,0x0B,0x0B,0x0B,0x0B,0x0B,0x0B,
  0xBF,0x37,0x37,0x37,0x37,0x37,0x37,0x37,
  0x2F,0x26,0x26,0x26,0x26,0x26,0x26,0x26,
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  0xBF,0x37,0x37,0x37,0x37,0x37,0x37,0x2F,
/* tile 2 */

  0x0B,0x0B,0x0B,0x0B,0x00,0x00,0x00,0x00,
  0x2F,0x26,0x15,0x0B,0x00,0x00,0x00,0x00,
  0x26,0x15,0x0B,0x0B,0x0B,0x0B,0x0B,0x00,
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  0x2F,0x26,0x15,0x0B,0x0B,0x37,0x26,0x0B,
/* tile 3 */

  0x0B,0x26,0x37,0x0B,0x0B,0x26,0x37,0xBF,
  0x00,0x0B,0x37,0x26,0x0B,0x15,0x37,0xBF,
  0x00,0x0B,0x15,0x37,0x0B,0x0B,0x26,0x37,
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  0x00,0x00,0x00,0x00,0x00,0x00,0x00,0x00,
/* tile 4 */

  0xBF,0xBF,0x37,0x37,0x37,0x37,0x37,0x2F,
  0xBF,0xBF,0x37,0x37,0x37,0x37,0x37,0x2F,
  0xBF,0xBF,0x37,0x37,0x37,0x37,0x2F,0x2F,
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  0x00,0x0B,0x26,0x26,0x26,0x15,0x0B,0x00,
/* tile 5 */

  0x2F,0x26,0x15,0x0B,0x0B,0x2F,0x15,0x0B,
  0x2F,0x26,0x15,0x0B,0x15,0x2F,0x0B,0x00,
  0x26,0x15,0x0B,0x15,0x2F,0x15,0x0B,0x00,
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  0x00,0x00,0x00,0x00,0x00,0x00,0x00,0x00,
/* tile 6 */

  0x00,0x00,0x00,0x00,0x00,0x00,0x00,0x00,
  0x00,0x00,0x00,0x00,0x00,0x00,0x00,0x00,
  0x00,0x00,0x00,0x00,0x00,0x00,0x00,0x00,
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  0x00,0x00,0x00,0x00,0x00,0x00,0x00,0x00,
/* tile 7 */

  0x00,0x00,0x0B,0x2F,0x26,0x0B,0x00,0x00,
  0x00,0x00,0x0B,0x37,0x26,0x0B,0x00,0x00,
  0x00,0x00,0x0B,0x37,0x26,0x0B,0x00,0x00,
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  0x00,0x0B,0x0B,0x0B,0x0B,0x0B,0x0B,0x00,
