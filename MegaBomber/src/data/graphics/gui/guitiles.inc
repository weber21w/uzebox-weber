const char GuiTiles[] PROGMEM = {
/* tile 0 */

  0x00,0x00,0x00,0x00,0x00,0x00,0x00,0x00,
  0x00,0x00,0x00,0x00,0x00,0x00,0x00,0x00,
  0x00,0x00,0x00,0x00,0x00,0x00,0x00,0x00,
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  0x00,0x00,0x00,0x00,0x00,0x00,0x00,0x00,
/* tile 1 */

  0x00,0x00,0x00,0x00,0x00,0x00,0x00,0x00,
  0x00,0x12,0x63,0x63,0x63,0x63,0x63,0x63,
  0x00,0x12,0x12,0x63,0x63,0x63,0x63,0x63,
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  0x00,0x12,0x12,0x12,0x63,0x63,0x63,0x00,
/* tile 2 */

  0x00,0x00,0x00,0x00,0x00,0x00,0x00,0x00,
  0x63,0x63,0x63,0x63,0x63,0x63,0x63,0x00,
  0x63,0x63,0x63,0x63,0x63,0x63,0x63,0x00,
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  0x00,0x12,0x12,0x12,0x63,0x63,0x63,0x00,
/* tile 3 */

  0x00,0x12,0x12,0x12,0x63,0x63,0x63,0x00,
  0x63,0x63,0x12,0x12,0x63,0x63,0x63,0x00,
  0x63,0x63,0x63,0x12,0x63,0x63,0x63,0x00,
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  0x00,0x00,0x00,0x00,0x00,0x00,0x00,0x00,
/* tile 4 */

  0x00,0x12,0x12,0x12,0x63,0x63,0x63,0x00,
  0x00,0x12,0x12,0x12,0x63,0x63,0x63,0x63,
  0x00,0x12,0x12,0x12,0x63,0x63,0x63,0x63,
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  0x00,0x00,0x00,0x00,0x00,0x00,0x00,0x00,
/* tile 5 */

  0x00,0x00,0x00,0x00,0x00,0x00,0x00,0x00,
  0x63,0x63,0x63,0x63,0x63,0x63,0x63,0x63,
  0x63,0x63,0x63,0x63,0x63,0x63,0x63,0x63,
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  0x00,0x00,0x00,0x00,0x00,0x00,0x00,0x00,
/* tile 6 */

  0x00,0x00,0x00,0x00,0x00,0x00,0x00,0x00,
  0x00,0x63,0x63,0x63,0x63,0x63,0x63,0x63,
  0x00,0x63,0x63,0x63,0x63,0x63,0x63,0x63,
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  0x00,0x00,0x00,0x00,0x00,0x00,0x00,0x00,
/* tile 7 */

  0x00,0x12,0x12,0x12,0x63,0x63,0x63,0x00,
  0x00,0x12,0x12,0x12,0x63,0x63,0x63,0x00,
  0x00,0x12,0x12,0x12,0x63,0x63,0x63,0x00,
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  0x00,0x00,0x00,0x00,0x00,0x00,0x00,0x00,
/* tile 8 */

  0x00,0x12,0x12,0x12,0x63,0x63,0x63,0x00,
  0x00,0x12,0x12,0x12,0x63,0x63,0x63,0x00,
  0x00,0x12,0x12,0x12,0x63,0x63,0x63,0x00,
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  0x00,0x12,0x12,0x12,0x63,0x63,0x63,0x00,
/* tile 9 */

  0x00,0x00,0x00,0x00,0x00,0x00,0x00,0x00,
  0x00,0x00,0x00,0x00,0x00,0x00,0x00,0x00,
  0x00,0x00,0x00,0x00,0x00,0x01,0x01,0x01,
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  0x01,0xFF,0xFF,0xFF,0xFF,0xFF,0x01,0xFF,
/* tile 10 */

  0x00,0x00,0x00,0x00,0x00,0x00,0x00,0x00,
  0x00,0x00,0x00,0x00,0x00,0x00,0x00,0x00,
  0x01,0x01,0x01,0x01,0x01,0x01,0x01,0x00,
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  0xFF,0x01,0xFF,0xFF,0x01,0x00,0x00,0x00,
/* tile 11 */

  0x01,0xFF,0xFF,0x01,0x01,0x01,0x01,0x5B,
  0x01,0xFF,0x5B,0xFF,0x5B,0x5B,0x5B,0x01,
  0x01,0x5B,0x01,0x01,0x5B,0xFF,0xFF,0x5B,
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  0x00,0x00,0x00,0x00,0x00,0x00,0x00,0x00,
/* tile 12 */

  0xFF,0x01,0x01,0x01,0x01,0x00,0x00,0x00,
  0x01,0x5B,0xFF,0xFF,0x01,0x00,0x00,0x00,
  0x01,0x01,0x01,0x01,0x01,0x00,0x00,0x00,
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  0x00,0x00,0x00,0x00,0x00,0x00,0x00,0x00,};
const char GuiMap[] PROGMEM=
{
};
const char TrophyMap[] PROGMEM = {
   3,3,
   40,41,42,
   43,44,45,
   46,47,46,
};