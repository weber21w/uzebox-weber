/* tile 0 */

  0x00,0x00,0x00,0x00,0x00,0x00,0x00,0x00,
  0x00,0x00,0x00,0x00,0x00,0x00,0x00,0x00,
  0x00,0x00,0x00,0x00,0x00,0x01,0x01,0x01,
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  0x01,0xFF,0xFF,0xFF,0xFF,0xFF,0x01,0xFF,
/* tile 1 */

  0x00,0x00,0x00,0x00,0x00,0x00,0x00,0x00,
  0x00,0x00,0x00,0x00,0x00,0x00,0x00,0x00,
  0x01,0x01,0x01,0x01,0x01,0x01,0x01,0x00,
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  0xFF,0x01,0xFF,0xFF,0x01,0x00,0x00,0x00,
/* tile 2 */

  0x01,0xFF,0xFF,0x01,0x01,0x01,0x01,0x5B,
  0x01,0xFF,0x5B,0xFF,0x5B,0x5B,0x5B,0x01,
  0x01,0x5B,0x01,0x01,0x5B,0xFF,0xFF,0x5B,
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  0x00,0x00,0x00,0x00,0x00,0x00,0x00,0x00,
/* tile 3 */

  0xFF,0x01,0x01,0x01,0x01,0x00,0x00,0x00,
  0x01,0x5B,0xFF,0xFF,0x01,0x00,0x00,0x00,
  0x01,0x01,0x01,0x01,0x01,0x00,0x00,0x00,
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  0x00,0x00,0x00,0x00,0x00,0x00,0x00,0x00,