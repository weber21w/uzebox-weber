/* tile 0 */

  0xFE,0xFE,0xFE,0xFE,0xFE,0x01,0x01,0x01,
  0xFE,0xFE,0xFE,0x01,0x01,0xAC,0x01,0x5F,
  0xFE,0xFE,0x01,0xAC,0xFF,0xFF,0x01,0x5F,
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  0xFE,0x01,0xAC,0xFF,0xFF,0xFF,0xFF,0xFF,
/* tile 1 */

  0xFE,0x01,0x8A,0xAC,0xFF,0xFF,0xFF,0xFF,
  0x09,0xEC,0x01,0xAC,0xAC,0xAC,0xFF,0xFF,
  0x09,0xF6,0x01,0x01,0x8A,0xAC,0xAC,0xAC,
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  0x09,0xE2,0xE2,0xE2,0xE2,0xE2,0xE2,0xE2,
/* tile 2 */

  0xFE,0xFE,0xFE,0xFE,0xFE,0x00,0x00,0x00,
  0xFE,0xFE,0xFE,0x00,0x00,0xAC,0xFF,0xFF,
  0xFE,0xFE,0x00,0x8A,0xFF,0xFF,0xFF,0xFF,
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  0xFE,0x00,0xAC,0x0F,0x77,0x00,0x77,0x77,
/* tile 3 */

  0xFE,0x00,0x8A,0x0F,0x77,0x00,0x77,0x77,
  0x09,0xEC,0x00,0xAC,0x0F,0x0F,0x0F,0x0F,
  0x09,0xF6,0x90,0x00,0x8A,0xAC,0xAC,0xFF,
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  0x09,0xE2,0x00,0x00,0x00,0xE2,0xE2,0xE2,
/* tile 4 */

  0xFE,0xFE,0xFE,0xFE,0xFE,0x01,0x01,0x01,
  0xFE,0xFE,0xFE,0x01,0x01,0xAC,0xFF,0xFF,
  0xFE,0xFE,0x01,0xAC,0xFF,0xFF,0xFF,0xFF,
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  0xFE,0x01,0x77,0x77,0x01,0x77,0x0F,0xFF,
/* tile 5 */

  0x01,0x01,0x01,0xFE,0xFE,0xFE,0xFE,0xFE,
  0xAC,0xAC,0x8A,0x01,0xFE,0x01,0x01,0xFE,
  0xFF,0xFF,0xAC,0xAC,0x01,0x0F,0x5F,0x01,
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  0xFF,0xFF,0xAC,0xAC,0xAC,0x01,0xFE,0xFE,
/* tile 6 */

  0xFE,0x01,0x77,0x77,0x01,0x77,0x0F,0xFF,
  0x09,0x01,0x0F,0x0F,0x0F,0x0F,0xFF,0xFF,
  0x09,0x01,0x01,0x8A,0xAC,0xAC,0xAC,0xAC,
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  0x09,0x01,0x01,0xE2,0xE2,0xE2,0xE2,0xE2,
/* tile 7 */

  0xFF,0xFF,0xAC,0xAC,0x8A,0x01,0x09,0xFE,
  0xFF,0xAC,0xAC,0x8A,0x01,0xF6,0xEC,0x09,
  0xAC,0x8A,0x01,0x01,0xE2,0x90,0xF6,0x09,
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  0xE2,0xE2,0xE2,0xE2,0xE2,0xE2,0xE2,0x09,
/* tile 8 */

  0x09,0xE2,0xEC,0xEC,0xEC,0xEC,0xE2,0x90,
  0xFE,0x09,0xEC,0xEC,0xEC,0xEC,0xEC,0xE2,
  0xFE,0x09,0xE2,0xEC,0xEC,0xEC,0xEC,0xEC,
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  0xFE,0xFE,0xFE,0xFE,0x09,0x09,0xFE,0xFE,