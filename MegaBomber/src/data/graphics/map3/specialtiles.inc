///////////////////////////////////////////////////
///////////////////////////////////////////////////
///////////////////////////////////////////////////
///////////////////////////////////////////////////
/////////////////SPECIALS//////////////////////////
///////////////////////////////////////////////////
///////////////////////////////////////////////////
///////////////////////////////////////////////////
///////////////////////////////////////////////////

#define SPECIALSTARTTILE NUMMAPTILES+NUMBORDERTILES
/* tile 0 */

  0x5C,0x13,0x09,0x5A,0xAD,0x09,0x0A,0x0A,
  0x5C,0x13,0x09,0x5A,0xAD,0x09,0x0A,0x0A,
  0x53,0x09,0x09,0x5A,0xAD,0x09,0x09,0x09,
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  0x0A,0x53,0x09,0x5A,0xAD,0x09,0x0A,0x0A,
/* tile 1 */

  0x0A,0x0A,0x09,0x5A,0xAD,0x09,0x53,0x13,
  0x0A,0x0A,0x09,0x5A,0xAD,0x09,0x13,0x13,
  0x09,0x09,0x09,0x5A,0xAD,0x09,0x09,0x53,
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  0x0A,0x0A,0x09,0x5A,0xAD,0x09,0x53,0x53,
/* tile 2 */

  0x5C,0x13,0x09,0x5A,0xAD,0x09,0x0A,0x0A,
  0x53,0x13,0x09,0x5A,0xAD,0x09,0x0A,0x0A,
  0x53,0x09,0x09,0x5A,0xAD,0x09,0x09,0x09,
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  0x0A,0x53,0x09,0x5A,0xAD,0x09,0x0A,0x0A,
/* tile 3 */

  0x0A,0x0A,0x09,0x5A,0xAD,0x09,0x53,0x53,
  0x0A,0x0A,0x09,0x5A,0xAD,0x09,0x13,0x53,
  0x09,0x09,0x09,0x5A,0xAD,0x09,0x09,0x53,
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  0x0A,0x0A,0x09,0x5A,0xAD,0x09,0x53,0x53,
/* tile 4 */

  0x0A,0x53,0x09,0x09,0x09,0x53,0x53,0x0A,
  0x53,0x09,0x25,0x2E,0x2E,0x09,0x0A,0x0A,
  0x09,0x09,0x09,0x09,0x09,0x09,0x09,0x09,
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  0x0A,0x09,0x25,0x2E,0x2E,0x09,0x0A,0x0A,
/* tile 5 */

  0x0A,0x53,0x09,0x09,0x09,0x53,0x53,0x0A,
  0x53,0x09,0x25,0x2E,0x2E,0x09,0x0A,0x53,
  0x09,0x09,0x09,0x09,0x09,0x09,0x09,0x09,
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  0x0A,0x09,0x25,0x2E,0x2E,0x09,0x0A,0x0A,
/* tile 6 */

  0x0A,0x09,0x25,0x2E,0x2E,0x09,0x0A,0x0A,
  0x09,0x09,0x09,0x09,0x09,0x09,0x09,0x09,
  0xAD,0xAD,0xAD,0xAD,0xAD,0xAD,0xAD,0xAD,
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  0x0A,0x0A,0x09,0x09,0x09,0x53,0x53,0x0A,
/* tile 7 */

  0x0A,0x09,0x25,0x2E,0x2E,0x09,0x0A,0x0A,
  0x09,0x09,0x09,0x09,0x09,0x09,0x09,0x09,
  0xAD,0xAD,0xAD,0xAD,0xAD,0xAD,0xAD,0xAD,
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  0x0A,0x53,0x09,0x09,0x09,0x53,0x53,0x0A,
/* tile 8 */

  0x53,0x53,0x0A,0x5C,0x53,0x5C,0x53,0x53,
  0x53,0x13,0x1A,0x0A,0x53,0x53,0x53,0x53,
  0x09,0x09,0x09,0x0A,0x13,0x1A,0x53,0x53,
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  0x0A,0x0A,0x0A,0x0A,0x0A,0x09,0x09,0x5A,
/* tile 9 */

  0x53,0x13,0x13,0x0A,0x13,0x5C,0x13,0x5C,
  0x53,0x13,0x13,0x0A,0x5C,0x53,0x13,0x53,
  0x13,0x13,0x0A,0x0A,0x13,0x53,0x13,0x53,
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  0xAD,0xAD,0x09,0x25,0x09,0x53,0x53,0x0A,
/* tile 10 */

  0x0A,0x0A,0x0A,0x0A,0x0A,0x09,0x25,0x09,
  0x0A,0x0A,0x0A,0x0A,0x09,0x25,0x2E,0x25,
  0x09,0x09,0x0A,0x09,0x25,0x2E,0x2E,0x2E,
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  0x5C,0x09,0x09,0xAD,0x5A,0x09,0x0A,0x0A,
/* tile 11 */

  0x5A,0xAD,0xAD,0x09,0x53,0x53,0x13,0x0A,
  0x09,0x5A,0xAD,0x5A,0x09,0x13,0x0A,0x5C,
  0x25,0x09,0xAD,0xAD,0x09,0x0A,0x5C,0x53,
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  0x0A,0x0A,0x09,0xAD,0x5A,0x09,0x0A,0x0A,
/* tile 12 */

  0x5C,0x09,0x09,0xAD,0x5A,0x09,0x0A,0x0A,
  0x09,0x09,0x5A,0xAD,0x5A,0x09,0x0A,0x0A,
  0x09,0x5A,0xAD,0xAD,0x09,0x25,0x09,0x0A,
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  0x0A,0x0A,0x0A,0x0A,0x0A,0x09,0x25,0x09,
/* tile 13 */

  0x0A,0x0A,0x09,0xAD,0x5A,0x09,0x0A,0x0A,
  0x0A,0x0A,0x09,0xAD,0x5A,0x09,0x13,0x53,
  0x0A,0x0A,0x09,0xAD,0x5A,0x09,0x13,0x53,
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  0x5A,0xAD,0xAD,0x09,0x53,0x53,0x13,0x0A,
/* tile 14 */

  0x53,0x53,0x0A,0x5C,0x53,0x09,0x09,0x5A,
  0x09,0x09,0x09,0x09,0x09,0x5A,0xAD,0xAD,
  0xAD,0xAD,0xAD,0xAD,0xAD,0xAD,0xAD,0x5A,
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  0x53,0x53,0x53,0x0A,0x53,0x53,0x53,0x53,
/* tile 15 */

  0xAD,0xAD,0x09,0x25,0x09,0x53,0x53,0x0A,
  0x5A,0x09,0x2E,0x25,0x09,0x53,0x53,0x0A,
  0x09,0x25,0x25,0x09,0x5C,0x53,0x13,0x0A,
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  0x53,0x13,0x13,0x0A,0x13,0x5C,0x13,0x5C,
/* tile 16 */

  0x53,0x53,0x09,0x5A,0xAD,0x09,0x0A,0x53,
  0x53,0x0A,0x09,0x5A,0xAD,0x09,0x53,0x53,
  0x53,0x13,0x09,0x5A,0xAD,0x09,0x0A,0x0A,
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  0x53,0x13,0x0A,0x0A,0x09,0x5A,0xAD,0x5A,
/* tile 17 */

  0x0A,0x0A,0x09,0x5A,0xAD,0x09,0x09,0x5C,
  0x0A,0x0A,0x09,0x5A,0xAD,0xAD,0x09,0x09,
  0x0A,0x0A,0x0A,0x09,0x5A,0xAD,0xAD,0x09,
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  0x09,0x25,0x2E,0x25,0x09,0x0A,0x0A,0x0A,
/* tile 18 */

  0x53,0x53,0x13,0x13,0x0A,0x09,0x5A,0xAD,
  0x13,0x13,0x13,0x0A,0x09,0x25,0x09,0xAD,
  0x13,0x13,0x0A,0x0A,0x09,0x25,0x2E,0x09,
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  0x5C,0x53,0x53,0x53,0x0A,0x0A,0x0A,0x0A,
/* tile 19 */

  0x5A,0x09,0x25,0x09,0x0A,0x0A,0x0A,0x0A,
  0xAD,0x5A,0x09,0x09,0x09,0x09,0x09,0x09,
  0xAD,0xAD,0xAD,0xAD,0xAD,0xAD,0xAD,0xAD,
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  0x0A,0x5C,0x53,0x53,0x53,0x53,0x53,0x0A,
/* tile 20 */

  0x0A,0x09,0x09,0x09,0x09,0x09,0x09,0x09,
  0x09,0xEC,0xF6,0xF6,0xF6,0xF6,0xF6,0xF6,
  0x09,0xF6,0x90,0xE2,0xE2,0xE2,0xE2,0xE2,
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  0x09,0xE2,0xE2,0xE2,0xE2,0xE2,0xE2,0xE2,
/* tile 21 */

  0x09,0x09,0x09,0x09,0x09,0x09,0x09,0x0A,
  0xF6,0xF6,0xF6,0xF6,0xF6,0xF6,0xEC,0x09,
  0xE2,0xE2,0xE2,0xE2,0xE2,0x90,0xF6,0x09,
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  0xE2,0xE2,0xE2,0xE2,0xE2,0xE2,0xE2,0x09,
/* tile 22 */

  0x09,0xE2,0xEC,0xEC,0xEC,0xEC,0xE2,0x90,
  0x09,0x09,0xEC,0xEC,0xEC,0xEC,0xEC,0xE2,
  0x09,0x09,0xE2,0xEC,0xEC,0xEC,0xEC,0xEC,
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  0x0A,0x0A,0x09,0x09,0x09,0x09,0x09,0x09,
/* tile 23 */

  0x90,0xE2,0xEC,0xEC,0xEC,0xEC,0xE2,0x09,
  0xE2,0xEC,0xEC,0xEC,0xEC,0xEC,0x09,0x09,
  0xEC,0xEC,0xEC,0xEC,0xEC,0xE2,0x09,0x09,
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  0x09,0x09,0x09,0x09,0x09,0x53,0x53,0x0A,
