///////////////////////////////////////////////////
///////////////////////////////////////////////////
///////////////////////////////////////////////////
///////////////////////////////////////////////////
/////////////////BORDER////////////////////////////
///////////////////////////////////////////////////
///////////////////////////////////////////////////
///////////////////////////////////////////////////
///////////////////////////////////////////////////

/* tile 0 */

  0xEE,0x9C,0x9B,0x9B,0x52,0x4A,0x4A,0x52,
  0xA5,0x9C,0x9C,0x9B,0x52,0x4A,0x4A,0x4A,
  0x9C,0x9C,0x9B,0x52,0x52,0x1A,0x4A,0x4A,
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  0x52,0x52,0x52,0x9B,0x52,0x4A,0x4A,0x4A,
/* tile 1 */

  0x0A,0x0A,0x0A,0x13,0x5C,0x5C,0x0A,0x0A,
  0x0A,0x13,0x0A,0x0A,0x5C,0x5C,0x0A,0x4A,
  0x0A,0x5C,0x0A,0x0A,0x13,0x5C,0x13,0x0A,
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  0x0A,0xAD,0x5C,0x0A,0x52,0x0A,0x0A,0x13,
/* tile 2 */

  0x0A,0x0A,0x0A,0x15,0x27,0x09,0x09,0x52,
  0x4A,0x52,0x15,0x27,0x09,0x27,0x15,0x09,
  0x4A,0x15,0x27,0x37,0x09,0x37,0x37,0x37,
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  0x0A,0x0A,0x0A,0x15,0x15,0x27,0x27,0x27,
/* tile 3 */

  0x09,0x09,0x27,0x15,0x0A,0x0A,0x0A,0x0A,
  0x15,0x27,0x09,0x27,0x15,0x4A,0x52,0x52,
  0x37,0x37,0x09,0x37,0x27,0x15,0x4A,0x52,
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  0x27,0x27,0x15,0x15,0x0A,0x0A,0x0A,0x0A,
/* tile 4 */

  0x0A,0x0A,0x0A,0x0A,0x0A,0x0A,0x0A,0x13,
  0x4A,0x52,0x52,0x9B,0x52,0x4A,0x0A,0x13,
  0x4A,0x4A,0x52,0x52,0x4A,0x4A,0x0A,0x13,
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  0x0A,0x0A,0x0A,0x0A,0x0A,0x0A,0x0A,0x0A,
/* tile 5 */

  0x5C,0x0A,0x0A,0x0A,0x0A,0x0A,0x0A,0x0A,
  0x5C,0x0A,0x52,0x4A,0x4A,0x4A,0x52,0x52,
  0x13,0x0A,0x9B,0x52,0x4A,0x4A,0x4A,0x52,
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  0x0A,0x0A,0x0A,0x0A,0x0A,0x0A,0x0A,0x0A,
/* tile 6 */

  0x0A,0x0A,0x0A,0x15,0x27,0x09,0x09,0x52,
  0x4A,0x52,0x15,0x27,0x09,0x27,0x15,0x09,
  0x4A,0x15,0x27,0x37,0x09,0x37,0x37,0x37,
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  0x0A,0x0A,0x0A,0x15,0x15,0x27,0x27,0x27,
/* tile 7 */

  0x09,0x09,0x27,0x15,0x0A,0x0A,0x0A,0x0A,
  0x15,0x27,0x09,0x27,0x15,0x4A,0x52,0x4A,
  0x37,0x37,0x09,0x37,0x27,0x15,0x4A,0x4A,
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  0x27,0x27,0x15,0x15,0x0A,0x0A,0x0A,0x0A,
/* tile 8 */

  0x0A,0x0A,0x5C,0x5C,0x13,0x0A,0x0A,0x0A,
  0x4A,0x0A,0x5C,0x5C,0x0A,0x0A,0x13,0x0A,
  0x0A,0x13,0x5C,0x13,0x0A,0x0A,0x5C,0x0A,
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  0x13,0x0A,0x0A,0x52,0x0A,0x5C,0xAD,0x0A,
/* tile 9 */

  0x4A,0x4A,0x52,0x9B,0x9C,0x9C,0x52,0x9B,
  0x4A,0x4A,0x52,0x9B,0x9C,0xA5,0x52,0x9C,
  0x4A,0x4A,0x52,0x1A,0x9B,0x9C,0x52,0x9C,
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  0x52,0x9B,0x52,0x52,0x52,0x9B,0x9C,0x9C,
/* tile 10 */

  0x9B,0x52,0x9C,0x9C,0x9B,0x52,0x4A,0x4A,
  0x9C,0x52,0xA5,0x9C,0x9B,0x52,0x4A,0x4A,
  0x9C,0x52,0x9C,0x9B,0x1A,0x52,0x4A,0x4A,
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  0x9C,0x9C,0x9B,0x52,0x52,0x52,0x9B,0x52,
/* tile 11 */

  0x0A,0xAD,0x5C,0x0A,0x9B,0x0A,0x5C,0x0A,
  0x0A,0x5C,0x5C,0x0A,0x52,0x0A,0x5C,0x0A,
  0x09,0x09,0x5C,0x0A,0x15,0x13,0x5C,0x0A,
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  0x0A,0x09,0x27,0x09,0x15,0x37,0x27,0x09,
/* tile 12 */

  0x0A,0x5C,0x0A,0x9B,0x0A,0x5C,0xAD,0x0A,
  0x0A,0x5C,0x0A,0x52,0x0A,0x5C,0x5C,0x0A,
  0x0A,0x5C,0x13,0x15,0x0A,0x5C,0x09,0x09,
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  0x09,0x27,0x37,0x15,0x09,0x27,0x09,0x0A,
/* tile 13 */

  0x52,0x4A,0x4A,0x52,0x9B,0x9B,0x9C,0xEE,
  0x4A,0x4A,0x4A,0x52,0x9B,0x9C,0x9C,0xA5,
  0x4A,0x4A,0x1A,0x52,0x52,0x9B,0x9C,0x9C,
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  0x4A,0x4A,0x4A,0x52,0x9B,0x52,0x52,0x52,
/* tile 14 */

  0x0A,0x09,0x37,0x37,0x37,0x37,0x37,0x09,
  0x0A,0x09,0x27,0x37,0x37,0x37,0x27,0x09,
  0x0A,0x37,0x09,0x27,0x37,0x27,0x09,0x37,
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  0x0A,0xAD,0x5C,0x0A,0x15,0x13,0x5C,0x0A,
/* tile 15 */

  0x09,0x37,0x37,0x37,0x37,0x37,0x09,0x0A,
  0x09,0x27,0x37,0x37,0x37,0x27,0x09,0x0A,
  0x37,0x09,0x27,0x37,0x27,0x09,0x37,0x0A,
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  0x0A,0x5C,0x13,0x15,0x0A,0x5C,0xAD,0x0A,
/* tile 16 */

  0x0A,0xAD,0x5C,0x0A,0x9B,0x0A,0x5C,0x0A,
  0x0A,0xAD,0x0A,0x0A,0x52,0x0A,0x5C,0x0A,
  0x0A,0x0A,0x13,0x0A,0x9B,0x0A,0x5C,0x0A,
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  0x0A,0x0A,0x0A,0x5C,0x5C,0x0A,0x5C,0x0A,
/* tile 17 */

  0x0A,0x5C,0x0A,0x9B,0x0A,0x5C,0xAD,0x0A,
  0x0A,0x5C,0x0A,0x52,0x0A,0x0A,0xAD,0x0A,
  0x0A,0x5C,0x0A,0x9B,0x0A,0x13,0x0A,0x0A,
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  0x0A,0x5C,0x0A,0x5C,0x5C,0x0A,0x0A,0x0A,
/* tile 18 */

  0x0A,0x13,0x0A,0x13,0x5C,0x13,0x0A,0x0A,
  0x0A,0x5C,0x0A,0x0A,0x5C,0x5C,0x0A,0x0A,
  0x0A,0xAD,0x13,0x0A,0x13,0x13,0x13,0x0A,
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  0x0A,0xAD,0x5C,0x0A,0x9B,0x0A,0x0A,0x0A,
/* tile 19 */

  0x0A,0x0A,0x13,0x5C,0x13,0x0A,0x13,0x0A,
  0x0A,0x0A,0x5C,0x5C,0x0A,0x0A,0x5C,0x0A,
  0x0A,0x13,0x13,0x13,0x0A,0x13,0xAD,0x0A,
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  0x0A,0x0A,0x0A,0x9B,0x0A,0x5C,0xAD,0x0A,
/* tile 20 */

  0x52,0x52,0x52,0x9B,0x52,0x4A,0x4A,0x4A,
  0xEE,0x9C,0x9B,0x9B,0x52,0x4A,0x4A,0x52,
  0xA5,0x9C,0x9C,0x9B,0x52,0x4A,0x4A,0x4A,
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  0x9B,0x9B,0x9B,0x52,0x52,0x4A,0x4A,0x4A,

#define NUMBORDERTILES 21