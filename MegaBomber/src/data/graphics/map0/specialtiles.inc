///////////////////////////////////////////////////
///////////////////////////////////////////////////
///////////////////////////////////////////////////
///////////////////////////////////////////////////
/////////////////SPECIALS//////////////////////////
///////////////////////////////////////////////////
///////////////////////////////////////////////////
///////////////////////////////////////////////////
///////////////////////////////////////////////////

#define SPECIALSTARTTILE NUMMAPTILES+NUMBORDERTILES

/* tile 0 */

  0x5B,0xF5,0xF5,0xA3,0x18,0x18,0x18,0x18,
  0x5B,0xF5,0xF5,0xA3,0x18,0x18,0x18,0x18,
  0x5B,0xF5,0xF5,0xA3,0x60,0x60,0x60,0x60,
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  0x5B,0xF5,0xF5,0xA3,0x68,0x68,0x68,0x68,
/* tile 1 */

  0x18,0x18,0x18,0x18,0xA3,0xF5,0xF5,0x09,
  0x18,0x18,0x18,0x18,0xA3,0xF5,0xF5,0x09,
  0x60,0x60,0x60,0x60,0xA3,0xF5,0xF5,0x09,
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  0x68,0x68,0x68,0x68,0xA3,0xF5,0xF5,0x09,
/* tile 2 */

  0x5B,0xF5,0xF5,0xA3,0x68,0x68,0x68,0x68,
  0x5B,0xF5,0xF5,0xA3,0x68,0x68,0x68,0x68,
  0x5B,0xF5,0xF5,0xA3,0x68,0x68,0x68,0x68,
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  0x5B,0xFF,0xFF,0xA3,0x18,0x18,0x18,0x18,
/* tile 3 */

  0x68,0x68,0x68,0x68,0xA3,0xF5,0xF5,0x09,
  0x68,0x68,0x68,0x68,0xA3,0xF5,0xF5,0x09,
  0x68,0x68,0x68,0x68,0xA3,0xF5,0xF5,0x09,
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  0x18,0x18,0x18,0x18,0xA3,0xFF,0xFF,0x09,
/* tile 4 */

  0x5B,0xF5,0xF5,0xA3,0x68,0x68,0x68,0x68,
  0x5B,0xF5,0xF5,0xA3,0x68,0x68,0x68,0x68,
  0x5B,0xF5,0xF5,0xA3,0x68,0x68,0x68,0x68,
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  0x5B,0xF5,0xF5,0xA3,0x18,0x18,0x18,0x18,
/* tile 5 */

  0x68,0x68,0x68,0x68,0xA3,0xF5,0xF5,0x09,
  0x68,0x68,0x68,0x68,0xA3,0xF5,0xF5,0x09,
  0x68,0x68,0x68,0x68,0xA3,0xF5,0xF5,0x09,
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  0x18,0x18,0x18,0x18,0xA3,0xF5,0xF5,0x09,
/* tile 6 */

  0x5B,0xF5,0xF5,0xA3,0x18,0x18,0x18,0x18,
  0x5B,0xF5,0xF5,0xA3,0x60,0x60,0x60,0x60,
  0x5B,0xF5,0xF5,0xA3,0x60,0x60,0x60,0x60,
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  0x5B,0xFF,0xFF,0xA3,0x68,0x68,0x68,0x68,
/* tile 7 */

  0x18,0x18,0x18,0x18,0xA3,0xF5,0xF5,0x09,
  0x60,0x60,0x60,0x60,0xA3,0xF5,0xF5,0x09,
  0x60,0x60,0x60,0x60,0xA3,0xF5,0xF5,0x09,
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  0x68,0x68,0x68,0x68,0xA3,0xFF,0xFF,0x09,
/* tile 8 */

  0x09,0x09,0x09,0x09,0x09,0x09,0x09,0x09,
  0xFF,0xF5,0xF5,0xF5,0xF5,0xF5,0xF5,0xF5,
  0xFF,0xF5,0xF5,0xF5,0xF5,0xF5,0xF5,0xF5,
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  0x18,0x18,0x60,0x60,0x60,0x68,0x68,0x68,
/* tile 9 */

  0x09,0x09,0x09,0x09,0x09,0x09,0x09,0x09,
  0xF5,0xF5,0xF5,0xF5,0xF5,0xF5,0xF5,0xF5,
  0xF5,0xF5,0xF5,0xF5,0xF5,0xF5,0xF5,0xF5,
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  0x68,0x68,0x60,0x60,0x60,0x60,0x18,0x18,
/* tile 10 */

  0x18,0x18,0x60,0x60,0x60,0x68,0x68,0x68,
  0x18,0x18,0x60,0x60,0x60,0x68,0x68,0x68,
  0x18,0x18,0x60,0x60,0x60,0x68,0x68,0x68,
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  0x5B,0x5B,0x5B,0x5B,0x5B,0x5B,0x5B,0x5B,
/* tile 11 */

  0x68,0x68,0x60,0x60,0x60,0x60,0x18,0x18,
  0x68,0x68,0x60,0x60,0x60,0x60,0x18,0x18,
  0x68,0x68,0x60,0x60,0x60,0x60,0x18,0x18,
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  0x5B,0x5B,0x5B,0x5B,0x5B,0x5B,0x5B,0x5B,
/* tile 12 */

  0x09,0x09,0x09,0x09,0x09,0x09,0x09,0x09,
  0xFF,0xF5,0xF5,0xF5,0xF5,0xF5,0xF5,0xF5,
  0xFF,0xF5,0xF5,0xF5,0xF5,0xF5,0xF5,0xF5,
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  0x68,0x68,0x68,0x60,0x60,0x60,0x60,0x18,
/* tile 13 */

  0x09,0x09,0x09,0x09,0x09,0x09,0x09,0x09,
  0xF5,0xF5,0xF5,0xF5,0xF5,0xF5,0xF5,0xF5,
  0xF5,0xF5,0xF5,0xF5,0xF5,0xF5,0xF5,0xF5,
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  0x18,0x60,0x60,0x60,0x68,0x68,0x68,0x68,
/* tile 14 */

  0x68,0x68,0x68,0x60,0x60,0x60,0x60,0x18,
  0x68,0x68,0x68,0x60,0x60,0x60,0x60,0x18,
  0x68,0x68,0x68,0x60,0x60,0x60,0x60,0x18,
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  0x5B,0x5B,0x5B,0x5B,0x5B,0x5B,0x5B,0x5B,
/* tile 15 */

  0x18,0x60,0x60,0x60,0x68,0x68,0x68,0x68,
  0x18,0x60,0x60,0x60,0x68,0x68,0x68,0x68,
  0x18,0x60,0x60,0x60,0x68,0x68,0x68,0x68,
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  0x5B,0x5B,0x5B,0x5B,0x5B,0x5B,0x5B,0x5B,