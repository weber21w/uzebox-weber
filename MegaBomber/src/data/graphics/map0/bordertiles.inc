///////////////////////////////////////////////////
///////////////////////////////////////////////////
///////////////////////////////////////////////////
///////////////////////////////////////////////////
/////////////////BORDER////////////////////////////
///////////////////////////////////////////////////
///////////////////////////////////////////////////
///////////////////////////////////////////////////
///////////////////////////////////////////////////

/* tile 1 */

  0xED,0xED,0xED,0xED,0xED,0xED,0xED,0xED,
  0x5A,0x5A,0x5A,0xED,0xED,0xF5,0x9B,0xED,
  0x9B,0x9B,0x9B,0x5A,0xED,0xED,0xF5,0xED,
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  0xED,0xED,0xED,0xED,0xED,0xED,0xF5,0xED,
/* tile 2 */

  0xF5,0x51,0x51,0x51,0x51,0x51,0x51,0x51,
  0xF5,0x5A,0x5A,0x5A,0x5A,0x5A,0x5A,0x5A,
  0xF5,0x52,0x52,0x52,0x52,0x52,0x52,0x52,
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  0xF5,0x9B,0x9B,0x52,0x5A,0x9B,0x9B,0x9B,
/* tile 3 */

  0x51,0x51,0x51,0x51,0x51,0x51,0x51,0x51,
  0x5A,0x5A,0x5A,0x5A,0x5A,0x5A,0x5A,0x5A,
  0x52,0x52,0x52,0x52,0x52,0x52,0x52,0x52,
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  0x9B,0x9B,0x9B,0x9B,0x9B,0x9B,0x9B,0x9B,
/* tile 4 */

  0x51,0x51,0x51,0x51,0x51,0x51,0x51,0x51,
  0x5A,0x5A,0x5A,0x5A,0x5A,0x5A,0x5A,0x5A,
  0x52,0x52,0x52,0x52,0x52,0x52,0x52,0x52,
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  0x5A,0x52,0x51,0x5F,0x5F,0x5F,0x5F,0x5F,
/* tile 5 */

  0x51,0x51,0x51,0x51,0x51,0x51,0x51,0x51,
  0x5A,0x5A,0x5A,0x5A,0x5A,0x5A,0x5A,0x5A,
  0x52,0x52,0x52,0x52,0x52,0x52,0x52,0x52,
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  0x5F,0x5F,0x5F,0x5F,0x5F,0x5F,0x5F,0x5F,
/* tile 6 */

  0x51,0x51,0x51,0x51,0x51,0x51,0x51,0x51,
  0x5A,0x5A,0x5A,0x5A,0x5A,0x5A,0x5A,0x5A,
  0x52,0x52,0x52,0x52,0x52,0x52,0x52,0x52,
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  0x5F,0x5F,0x5F,0x5F,0x5F,0x51,0x9B,0x9B,
/* tile 7 */

  0x51,0x51,0x51,0x51,0x51,0x51,0x51,0xF5,
  0x5A,0x5A,0x5A,0x5A,0x5A,0x5A,0x5A,0xF5,
  0x52,0x52,0x52,0x52,0x52,0x52,0x52,0xF5,
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  0x9B,0x9B,0x9B,0x5A,0x52,0x9B,0x9B,0xF5,
/* tile 8 */

  0xED,0xED,0xED,0xED,0xED,0xED,0xED,0xED,
  0xED,0x9B,0xF5,0xED,0xED,0x5A,0x5A,0x5A,
  0xED,0xF5,0xED,0xED,0x5A,0x9B,0x9B,0x9B,
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  0xED,0xF5,0xED,0xED,0xED,0xED,0xED,0xED,
/* tile 9 */

  0xED,0xED,0xED,0xED,0xED,0xED,0xED,0xED,
  0x5A,0x5A,0x5A,0x5A,0x5A,0xED,0xED,0xED,
  0x9B,0x9B,0x9B,0x9B,0x9B,0x5A,0xED,0xED,
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  0xED,0xED,0xED,0xED,0xED,0xED,0xED,0xED,
/* tile 10 */

  0xF5,0x9B,0x9B,0x5A,0x52,0x5A,0x9B,0x9B,
  0xF5,0x9B,0x9B,0x5A,0x52,0x5A,0x5A,0x9B,
  0xF5,0x9B,0x9B,0x9B,0x5A,0x52,0x5A,0x5A,
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  0xF5,0x9B,0x9B,0x5A,0x5A,0x5A,0x52,0x51,
/* tile 11 */

  0x9B,0x9B,0x9B,0x9B,0x9B,0x9B,0x9B,0x9B,
  0x5A,0x9B,0x5A,0x9B,0x5A,0x9B,0x5A,0x9B,
  0x9B,0x5A,0x9B,0x5A,0x9B,0x5A,0x9B,0x5A,
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  0x51,0x51,0x51,0x51,0x51,0x51,0x51,0x51,
/* tile 12 */

  0x5A,0x52,0x52,0x51,0x51,0x51,0x51,0x51,
  0x5A,0x5A,0x52,0x52,0x51,0x56,0x56,0x51,
  0x9B,0x5A,0x5A,0x52,0x51,0x56,0x56,0x51,
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  0x51,0x51,0x51,0x51,0x51,0x51,0x51,0x51,
/* tile 13 */

  0x51,0x51,0x51,0x51,0x51,0x51,0x51,0x51,
  0x52,0x52,0x52,0x52,0x52,0x52,0x52,0x52,
  0x5A,0x5A,0x5A,0x5A,0x5A,0x5A,0x5A,0x5A,
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  0x51,0x51,0x51,0x51,0x51,0x51,0x51,0x51,
/* tile 14 */

  0x51,0x51,0x51,0x51,0x51,0x51,0x51,0x51,
  0x52,0x52,0x52,0x52,0x51,0xD0,0x51,0xD0,
  0x5A,0x5A,0x5A,0x5A,0x51,0xD9,0x51,0xD9,
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  0x51,0x51,0x51,0x51,0x51,0x51,0x51,0x51,
/* tile 15 */

  0x51,0x51,0x51,0x51,0x51,0x51,0x51,0x51,
  0xD0,0xD0,0xD0,0xD0,0xD0,0xD0,0xD0,0xD0,
  0xD9,0xD9,0xD9,0xD9,0xD9,0xD9,0xD9,0xD9,
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  0x51,0x51,0x51,0x51,0x51,0x51,0x51,0x51,
/* tile 16 */

  0x51,0x51,0x51,0x51,0x51,0x51,0x51,0x51,
  0xD0,0xD0,0x51,0xD0,0x51,0x52,0x52,0x52,
  0xD9,0xE2,0x51,0xD9,0x51,0x5A,0x5A,0x5A,
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  0x51,0x51,0x51,0x51,0x51,0x51,0x51,0x51,
/* tile 17 */

  0x51,0x51,0x51,0x51,0x51,0x51,0x51,0x51,
  0x52,0x52,0x52,0x52,0x52,0x52,0x52,0x52,
  0x5A,0x5A,0x5A,0x5A,0x5A,0x5A,0x5A,0x52,
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  0x51,0x51,0x51,0x51,0x51,0x51,0x51,0x51,
/* tile 18 */

  0x51,0x51,0x51,0x51,0x51,0x5A,0x9B,0x9B,
  0x51,0x56,0x56,0x51,0x5A,0x9B,0x5A,0x9B,
  0x51,0x56,0x56,0x51,0x5A,0x5A,0x9B,0x5A,
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  0x51,0x51,0x51,0x51,0x51,0x51,0x51,0x51,
/* tile 19 */

  0x9B,0x9B,0x5A,0x52,0x5A,0x9B,0x9B,0xF5,
  0x9B,0x5A,0x5A,0x52,0x5A,0x9B,0x9B,0xF5,
  0x5A,0x5A,0x52,0x5A,0x9B,0x9B,0x9B,0xF5,
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  0x51,0x52,0x5A,0x5A,0x5A,0x9B,0x9B,0xF5,
/* tile 20 */

  0xED,0xED,0xED,0xED,0xED,0xED,0xED,0xED,
  0xED,0xED,0xED,0x5A,0x5A,0x5A,0x5A,0x5A,
  0xED,0xED,0x5A,0x9B,0x9B,0x9B,0x9B,0x9B,
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  0xED,0xED,0xED,0xED,0xED,0xED,0xED,0xED,
/* tile 21 */

  0xF5,0x9B,0x9B,0x9B,0x5A,0x52,0x52,0x51,
  0xF5,0x9B,0x9B,0x5A,0x5A,0x5A,0x52,0x51,
  0xF5,0x9B,0x9B,0x9B,0x5A,0x52,0x52,0x51,
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  0xF5,0x9B,0x9B,0x9B,0x5A,0x5A,0x52,0x51,
/* tile 22 */

  0x51,0x52,0x52,0x5A,0x9B,0x9B,0x9B,0xF5,
  0x51,0x52,0x5A,0x5A,0x5A,0x9B,0x9B,0xF5,
  0x51,0x52,0x52,0x5A,0x9B,0x9B,0x9B,0xF5,
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  0x51,0x52,0x5A,0x5A,0x9B,0x9B,0x9B,0xF5,
/* tile 23 */

  0xF5,0x9B,0x9B,0x5A,0x9B,0x52,0x52,0x51,
  0xF5,0x9B,0x9B,0x52,0x9B,0x5A,0x52,0x51,
  0xF5,0x9B,0x9B,0x51,0x5A,0x9B,0x52,0x51,
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  0xF5,0x9B,0x9B,0x51,0x51,0x51,0x51,0x52,
/* tile 24 */

  0x51,0x52,0x52,0x9B,0x5A,0x9B,0x9B,0xF5,
  0x51,0x52,0x5A,0x9B,0x52,0x9B,0x9B,0xF5,
  0x51,0x52,0x9B,0x5A,0x51,0x9B,0x9B,0xF5,
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  0x52,0x51,0x51,0x51,0x51,0x9B,0x9B,0xF5,
/* tile 25 */

  0x11,0xED,0xED,0xED,0xED,0xF5,0xED,0x9B,
  0x63,0x11,0xED,0xF5,0xF5,0xED,0xED,0xED,
  0xB5,0x63,0x11,0x52,0x5B,0x9B,0xED,0xED,
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  0xFE,0xFE,0xB5,0x63,0x11,0xB5,0xFF,0x52,
/* tile 26 */

  0xF5,0x9B,0x9B,0x51,0x52,0x52,0x52,0x52,
  0xF5,0x9B,0x9B,0x51,0x52,0x52,0x52,0x52,
  0xF5,0x9B,0x9B,0x51,0x52,0x52,0x52,0x52,
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  0xF5,0x9B,0x9B,0x51,0x52,0x52,0x52,0x52,
/* tile 27 */

  0x52,0x52,0x52,0x52,0x51,0x9B,0x9B,0xF5,
  0x52,0x52,0x52,0x52,0x51,0x9B,0x9B,0xF5,
  0x52,0x52,0x52,0x52,0x51,0x9B,0x9B,0xF5,
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  0x52,0x52,0x52,0x52,0x51,0x9B,0x9B,0xF5,
/* tile 28 */

  0x9B,0xED,0xF5,0xED,0xED,0xED,0xED,0x11,
  0xED,0xED,0xED,0xF5,0xF5,0xED,0x11,0x63,
  0xED,0xED,0x9B,0x5B,0x52,0x11,0x63,0xB5,
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  0x52,0xFF,0xB5,0x11,0x63,0xB5,0xFE,0xFE,
/* tile 29 */

  0xB5,0xFE,0xB5,0x11,0x63,0xFE,0xFF,0x11,
  0x63,0x63,0x11,0x63,0xB5,0xFF,0xFE,0x11,
  0x5A,0x5A,0x63,0xB5,0xB5,0xFF,0x63,0x11,
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  0x5A,0x5A,0x9B,0x9B,0xF5,0xED,0xED,0xED,
/* tile 30 */

  0xF5,0x9B,0x9B,0x52,0x51,0x52,0x52,0x52,
  0xF5,0x9B,0x9B,0x5A,0x51,0x52,0x5B,0x5B,
  0xF5,0x9B,0x9B,0x9B,0x52,0x51,0x52,0x52,
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  0xF5,0x9B,0x9B,0x5A,0x5A,0x5A,0x52,0x51,
/* tile 31 */

  0x52,0x52,0x52,0x51,0x52,0x9B,0x9B,0xF5,
  0x5B,0x5B,0x52,0x51,0x5A,0x9B,0x9B,0xF5,
  0x52,0x52,0x51,0x52,0x9B,0x9B,0x9B,0xF5,
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  0x51,0x52,0x5A,0x5A,0x5A,0x9B,0x9B,0xF5,
/* tile 32 */

  0x11,0xFF,0xFE,0x63,0x11,0xB5,0xFE,0xB5,
  0x11,0xFE,0xFF,0xB5,0x63,0x11,0x63,0x63,
  0x11,0x63,0xFF,0xB5,0xB5,0x63,0x5A,0x5A,
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  0xED,0xED,0xED,0xF5,0x9B,0x9B,0x5A,0x5A,

#define NUMBORDERTILES 32