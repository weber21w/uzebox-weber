#if MAP == 0
#include "map0/defines.inc"
#include "map0/tileoffsets.inc"
#include "map0/tiles.inc"
#include "map0/border.inc"
#include "map0/map.inc"
#elif MAP == 1
#include "map1/defines.inc"
#include "map1/tileoffsets.inc"
#include "map1/tiles.inc"
#include "map1/border.inc"
#include "map1/map.inc"
#elif MAP == 2
#include "map2/defines.inc"
#include "map2/tileoffsets.inc"
#include "map2/tiles.inc"
#include "map2/border.inc"
#include "map2/map.inc"
#elif MAP == 3
#include "map3/defines.inc"
#include "map3/tileoffsets.inc"
#include "map3/tiles.inc"
#include "map3/border.inc"
#include "map3/map.inc"
#elif MAP == 4
#include "map4/defines.inc"
#include "map4/tileoffsets.inc"
#include "map4/tiles.inc"
#include "map4/border.inc"
#include "map4/map.inc"
#endif