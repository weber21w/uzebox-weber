//INST: lead fast env
const char patch00[] PROGMEM ={ 
0,PC_WAVE,3,//4
0,PC_TREMOLO_LEVEL,128,
0,PC_TREMOLO_RATE,111,
//0,PC_NOTE_HOLD,0,
1,PC_ENV_SPEED,-22,
0,PATCH_END
};

//INST: lead slow env
const char patch01[] PROGMEM ={ 
0,PC_WAVE,0,
0,PC_TREMOLO_LEVEL,192,
0,PC_TREMOLO_RATE,120,
0,PC_ENV_VOL,150,
0,PC_ENV_SPEED,35,
5,PC_ENV_SPEED,-25,
//1,PC_ENV_SPEED,-35,
5,PC_ENV_SPEED,-45,

1,PATCH_END
};

//INST: base -  triangular
const char patch02[] PROGMEM ={	
0,PC_WAVE,4,
0,PC_ENV_VOL,160,
0,PC_ENV_SPEED,20,
1,PC_ENV_SPEED,30,
0,PC_WAVE,4,
1,PC_ENV_SPEED,-16,
1,PC_ENV_SPEED,-14,
//0,PC_NOTE_HOLD,0,
4,PATCH_END
};


//Explode Patch
const char patch03[] PROGMEM ={
//0,PC_NOISE_PARAMS,3,
0,PC_NOISE_PARAMS,222,
0,PC_TREMOLO_LEVEL,222,
0,PC_TREMOLO_RATE,120,
0,PC_ENV_VOL,145,
0,PC_ENV_SPEED,30,
9,PC_ENV_SPEED,-15,
0,PC_NOISE_PARAMS,22,
2,PC_ENV_SPEED,30,
2,PC_ENV_SPEED,-10,
2,PC_ENV_SPEED,-8,
//3,PC_ENV_SPEED,30,
//3,PC_ENV_SPEED,-40,
//5,PC_ENV_SPEED,20,
//5,PC_ENV_SPEED,-50,
//2,PC_ENV_SPEED,30,  
35,PC_NOTE_CUT,0,
0,PATCH_END
};

//Bomb Kick
const char patch04[] PROGMEM ={
0,PC_WAVE,1,//2,
1,PC_PITCH,69,
1,PC_PITCH,73,
1,PC_PITCH,70,
1,PC_PITCH,74,
1,PC_PITCH,71,
1,PC_PITCH,75,
1,PC_PITCH,72,
1,PC_PITCH,76,
1,PC_PITCH,73,
1,PC_PITCH,77,
1,PC_NOTE_CUT,0,
1,PATCH_END
};

//Power Up
const char patch05[] PROGMEM ={ 
0,PC_WAVE,1,//2,
1,PC_PITCH,69,
1,PC_PITCH,73,
1,PC_PITCH,70,
1,PC_PITCH,74,
1,PC_PITCH,71,
1,PC_PITCH,75,
1,PC_PITCH,72,
1,PC_PITCH,76,
1,PC_PITCH,73,
1,PC_PITCH,77,
1,PC_NOTE_CUT,0,
0,PATCH_END 
};

//Victory Bell
#define VICTORY_FX 6
const char patch06[] PROGMEM ={ 
0,PC_WAVE,1,//2,
1,PC_PITCH,69,
1,PC_PITCH,73,

10,PC_PITCH,69,
1,PC_PITCH,73,

10,PC_PITCH,69,
1,PC_PITCH,73,

10,PC_PITCH,69,
1,PC_PITCH,73,

10,PC_PITCH,69,
1,PC_PITCH,73,

10,PC_NOTE_CUT,0,
0,PATCH_END 
};

//Hurry Up!
#define HURRY_FX 7
const char patch07[] PROGMEM ={ 
0,PC_WAVE,1,//2,
1,PC_PITCH,69,
1,PC_PITCH,73,

10,PC_PITCH,69,
1,PC_PITCH,73,

10,PC_PITCH,69,
1,PC_PITCH,73,

10,PC_PITCH,69,
1,PC_PITCH,73,

10,PC_PITCH,69,
1,PC_PITCH,73,

10,PC_NOTE_CUT,0,
0,PATCH_END 

};

#define PLANT_BOMB_FX 8
//Plant bomb
const char patch08[] PROGMEM ={
0,PC_WAVE,2,//
0,PC_PITCH,43,
1,PC_PITCH,45,
1,PC_PITCH,47,
1,PC_PITCH,49,
1,PC_PITCH,48,
1,PC_NOTE_CUT,0,
1,PATCH_END
};

#define HIT_FLOOR_FX 9
//Hit Floor
const char patch09[] PROGMEM ={ 
0,PC_WAVE,2,
0,PC_TREMOLO_LEVEL,128,
0,PC_TREMOLO_RATE,111,
0,PC_PITCH,58,
2,PC_PITCH,56,
2,PC_PITCH,54,
2,PC_PITCH,52,
1,PC_PITCH,51,
1,PC_PITCH,50,
1,PC_NOTE_CUT,0,
1,PATCH_END
};

#define HIT_FLOOR_FX2 10
//Empty
const char patch10[] PROGMEM ={ 
0,PC_WAVE,1,
0,PC_TREMOLO_LEVEL,128,
0,PC_TREMOLO_RATE,111,
0,PC_PITCH,44,
2,PC_PITCH,48,
4,PC_PITCH,44,
2,PC_PITCH,48,
1,PC_PITCH,40,
3,PC_NOTE_CUT,0,
1,PATCH_END
};

//Player Die
#define PLAYER_DIE_FX 11
const char patch11[] PROGMEM ={ 
0,PC_WAVE,0,
//0,PC_ENV_VOL,3,
0,PC_TREMOLO_LEVEL,128,
0,PC_TREMOLO_RATE,111,
1,PC_PITCH,58,
2,PC_PITCH,59,
1,PC_PITCH,58,
1,PC_PITCH,60,
2,PC_PITCH,61,
1,PC_PITCH,60,
0,PC_TREMOLO_LEVEL,200,
0,PC_TREMOLO_RATE,111,
1,PC_PITCH,62,
2,PC_PITCH,63,
1,PC_PITCH,62,
1,PC_PITCH,64,
2,PC_PITCH,65,
1,PC_PITCH,64,
1,PC_PITCH,66,
1,PC_PITCH,65,
1,PC_PITCH,66,

0,PC_TREMOLO_LEVEL,255,
0,PC_TREMOLO_RATE,111,
0,PC_WAVE,0,
1,PC_PITCH,69,
2,PC_PITCH,71,
1,PC_PITCH,69,
2,PC_PITCH,72,
1,PC_PITCH,69,
2,PC_PITCH,73,
1,PC_PITCH,69,
2,PC_PITCH,74,
1,PC_PITCH,69,
2,PC_PITCH,75,
1,PC_NOTE_CUT,0,
1,PATCH_END
};

//Bass Drum
const char patch12[] PROGMEM ={ 
0,PC_NOISE_PARAMS,14,
0,PC_ENV_VOL,170,
0,PC_ENV_SPEED,30,
1,PC_ENV_SPEED,-20,
1,PC_ENV_SPEED,-8,
1,PC_ENV_SPEED,-4,  
1,PC_NOTE_CUT,0,
0,PATCH_END
};

//Drop Block
#define BLOCK_DROP_FX 9//13 not working why??!!??
const char patch13[] PROGMEM ={ 
0,PC_WAVE,0,
//0,PC_TREMOLO_LEVEL,128,
//0,PC_TREMOLO_RATE,111,
0,PC_PITCH,44,
2,PC_PITCH,48,
4,PC_PITCH,44,
2,PC_PITCH,48,
1,PC_PITCH,40,
3,PC_NOTE_CUT,0,
1,PATCH_END
};

//Snare
const char patch14[] PROGMEM ={ 
0,PC_NOISE_PARAMS,8,
0,PC_ENV_VOL,200,
0,PC_ENV_SPEED,-30,
1,PC_ENV_SPEED,-15,
1,PC_ENV_SPEED,-8, 
2,PC_NOTE_CUT,0,
0,PATCH_END
};

//Empty
const char patch15[] PROGMEM ={ 
1,PATCH_END
};

//Empty
const char patch16[] PROGMEM ={ 
1,PATCH_END
};

//Empty
const char patch17[] PROGMEM ={ 
1,PATCH_END
};

//Hi-Hat
const char patch18[] PROGMEM ={ 
0,PC_NOISE_PARAMS,2,
0,PC_ENV_VOL,44,
0,PC_ENV_SPEED,-30,
1,PC_ENV_SPEED,-15,
1,PC_ENV_SPEED,-8, 
2,PC_NOTE_CUT,0,
0,PATCH_END
};

//Empty
const char patch19[] PROGMEM ={ 
1,PATCH_END
};

//Empty
const char patch20[] PROGMEM ={ 
1,PATCH_END
};

//Empty
const char patch21[] PROGMEM ={ 
1,PATCH_END
};

//Ride Cymbal
const char patch22[] PROGMEM ={ 
0,PC_NOISE_PARAMS,4,
0,PC_ENV_VOL,44,
0,PC_ENV_SPEED,-30,
1,PC_ENV_SPEED,-15,
1,PC_ENV_SPEED,-8, 
2,PC_NOTE_CUT,0,
0,PATCH_END
};

const struct PatchStruct patches[] PROGMEM = {
{0,NULL,patch00,0,0},
{0,NULL,patch01,0,0},
{0,NULL,patch02,0,0},
{1,NULL,patch03,0,0},
{0,NULL,patch04,0,0},
{0,NULL,patch05,0,0},
{0,NULL,patch06,0,0},
{0,NULL,patch07,0,0},
{0,NULL,patch08,0,0},
{0,NULL,patch09,0,0},
{0,NULL,patch10,0,0},
{0,NULL,patch11,0,0},

{1,NULL,patch12,0,0},
{1,NULL,patch13,0,0},
{1,NULL,patch14,0,0},
{1,NULL,patch15,0,0},
{1,NULL,patch16,0,0},
{1,NULL,patch17,0,0},
{1,NULL,patch18,0,0},
{1,NULL,patch19,0,0},
{1,NULL,patch20,0,0},
{1,NULL,patch21,0,0},
{1,NULL,patch22,0,0},
};

