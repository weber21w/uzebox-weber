const char strUzeboxOffset[]    PROGMEM = "SXCEMV";//get around ram tile limit for RamifyFont()
const char strMegaBomber[]      PROGMEM = "MEGA BOMBER";
const char strBattleGame[]      PROGMEM = "BATTLE3GAME";
const char strUzeboxLive[]      PROGMEM = "UZEBOX3LIVE";
const char strLocal[]           PROGMEM = "LOCAL";
const char strUzenet[]          PROGMEM = "UZENET";
const char strNetwork[]         PROGMEM = "NETWORK";
const char strOptions[]          PROGMEM = "OPTIONS";
const char strVanity[]          PROGMEM = "LEE WEBER 2011";

const char strGettingList[]     PROGMEM = "5GETTING3LIST5";
const char strPing[]            PROGMEM = "PING";
const char strNoGames[]         PROGMEM = "NO3GAMES3FOUND";
const char strEmpty[]           PROGMEM = "55EMPTY553";
const char strBack[]            PROGMEM = "BACK";
const char strQuit[]            PROGMEM = "QUIT";
const char strRefresh[]         PROGMEM = "REFRESH";

const char strBattleSetup[]       PROGMEM = "BATTLE SETUP";
const char strGameType[]        PROGMEM = "GAME TYPE";
const char strSingle[]          PROGMEM = "SINGLE";
const char strTeam[]            PROGMEM = "TEAM";
const char strRound[]            PROGMEM = "ROUND";
const char strBlitz[]            PROGMEM = "BLOCK";
const char strTime[]            PROGMEM = "TIME";
const char strMatches[]         PROGMEM = "MATCHES";
const char strPlayers[]         PROGMEM = "PLAYERS";
const char strCpu[]             PROGMEM = "CPU";
const char strMan[]             PROGMEM = "MAN";
const char strGhost[]           PROGMEM = "GHOST";
const char strOn[]              PROGMEM = "ON ";
const char strOff[]             PROGMEM = "OFF";

const char str1P[]              PROGMEM = "1P ";
const char str2P[]              PROGMEM = "2P ";
const char str3P[]              PROGMEM = "3P ";
const char str4P[]              PROGMEM = "4P ";


const char strMap[]             PROGMEM = "MAP";

