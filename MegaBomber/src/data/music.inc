#define EXPLODESFX 3
#define EXPLODESFXVOL 255
#define PLAYERDIESFX 4
#define PLAYERDIESFXVOL 255
#define POWERPICKUPSFX 5
#define POWERPICKUPSFXVOL 255

//m -f22 -s0 -e30650 maybe try 30640?? getting closer the lower I go...

const char StageSong[] PROGMEM ={/*
0x00,0xc3,0x00,0x00,0xc2,0x02,0x00,0xc1,0x01,0x00,0xc0,0x00,0x00,0xb0,0x64,0x00,0x00,0x64,0x00,0x00,0xb1,0x64,0x00,0x00,0x91,0x45,0x48,0x00,0xb1,0x64,0x00,0x00,
0xb2,0x64,0x00,0x00,0x92,0x21,0x60,0x00,0xb3,0x64,0x00,0x00,0x93,0x0c,0x66,0x00,0xff,0x06,0x01,0x53,0x06,0x91,0x4c,0x48,0x00,0x92,0x2d,0x60,0x04,0x91,0x4c,0x48,
0x03,0x45,0x48,0x00,0x92,0x21,0x60,0x00,0x93,0x0e,0x60,0x03,0x0e,0x40,0x04,0x91,0x4c,0x48,0x00,0x92,0x2d,0x60,0x00,0x93,0x0e,0x20,0x03,0x12,0x66,0x03,0x91,0x45,
0x48,0x00,0x92,0x21,0x60,0x00,0x93,0x0c,0x66,0x04,0x0c,0x66,0x03,0x91,0x4c,0x48,0x00,0x92,0x2d,0x60,0x00,0x93,0x0e,0x40,0x04,0x0e,0x40,0x03,0x91,0x4d,0x48,0x00,
0x92,0x2e,0x60,0x00,0x93,0x0e,0x60,0x03,0x0e,0x40,0x04,0x0e,0x20,0x03,0x0e,0x60,0x03,0x91,0x45,0x48,0x00,0x92,0x21,0x60,0x00,0x93,0x12,0x60,0x07,0x91,0x4c,0x48,
0x00,0x92,0x2d,0x60,0x03,0x91,0x4c,0x48,0x04,0x45,0x48,0x00,0x92,0x21,0x60,0x00,0x93,0x0e,0x60,0x03,0x0e,0x40,0x04,0x91,0x4c,0x48,0x00,0x92,0x2d,0x60,0x00,0x93,
0x0e,0x20,0x03,0x0e,0x60,0x03,0x91,0x4c,0x48,0x00,0x92,0x2d,0x60,0x00,0x93,0x12,0x60,0x04,0x0e,0x60,0x03,0x91,0x4b,0x48,0x00,0x92,0x2c,0x60,0x03,0x93,0x0e,0x40,
0x04,0x91,0x4a,0x48,0x00,0x92,0x2b,0x60,0x00,0x93,0x0e,0x60,0x03,0x0e,0x40,0x04,0x91,0x49,0x48,0x00,0x92,0x2a,0x60,0x00,0x93,0x0e,0x20,0x03,0x0e,0x60,0x03,0x91,
0x45,0x48,0x00,0x92,0x21,0x60,0x00,0x93,0x12,0x60,0x00,0x0c,0x66,0x07,0x91,0x4c,0x48,0x00,0x92,0x2d,0x60,0x03,0x91,0x4c,0x48,0x04,0x45,0x48,0x00,0x92,0x21,0x60,
0x00,0x93,0x0e,0x60,0x03,0x0e,0x40,0x03,0x91,0x4c,0x48,0x00,0x92,0x2d,0x60,0x00,0x93,0x0e,0x20,0x04,0x0e,0x60,0x03,0x91,0x45,0x48,0x00,0x92,0x21,0x60,0x00,0x93,
0x12,0x60,0x00,0x0c,0x66,0x04,0x0c,0x66,0x03,0x91,0x4c,0x48,0x00,0x92,0x2d,0x60,0x00,0x93,0x0c,0x66,0x03,0x0e,0x40,0x04,0x91,0x4d,0x48,0x00,0x92,0x2e,0x60,0x00,
0x93,0x0e,0x60,0x03,0x0e,0x40,0x03,0x0e,0x20,0x04,0x0e,0x60,0x03,0x91,0x45,0x48,0x00,0x92,0x21,0x60,0x00,0x93,0x12,0x60,0x07,0x91,0x4c,0x48,0x00,0x92,0x2d,0x60,
0x03,0x91,0x4c,0x48,0x04,0x45,0x48,0x00,0x92,0x21,0x60,0x00,0x93,0x0e,0x60,0x03,0x0e,0x40,0x03,0x91,0x4c,0x48,0x00,0x92,0x2d,0x60,0x00,0x93,0x0e,0x20,0x04,0x0e,
0x60,0x03,0x91,0x4c,0x48,0x00,0x92,0x2d,0x60,0x00,0x93,0x12,0x60,0x03,0x0e,0x60,0x04,0x91,0x4b,0x48,0x00,0x92,0x2c,0x60,0x03,0x93,0x0e,0x40,0x04,0x91,0x4a,0x48,
0x00,0x92,0x2b,0x60,0x00,0x93,0x0c,0x66,0x03,0x0c,0x66,0x03,0x91,0x49,0x48,0x00,0x92,0x2a,0x60,0x00,0x93,0x0c,0x66,0x04,0x0c,0x66,0x03,0x91,0x45,0x48,0x00,0x92,
0x21,0x60,0x00,0x93,0x12,0x60,0x00,0x0e,0x66,0x07,0x90,0x51,0x60,0x00,0x91,0x4c,0x48,0x00,0x92,0x2d,0x60,0x03,0x91,0x4c,0x48,0x04,0x90,0x51,0x60,0x00,0x91,0x45,
0x48,0x00,0x92,0x21,0x60,0x00,0x93,0x0e,0x60,0x03,0x0e,0x40,0x03,0x90,0x4f,0x60,0x00,0x91,0x4c,0x48,0x00,0x92,0x2d,0x60,0x00,0x93,0x0e,0x20,0x04,0x0e,0x60,0x03,
0x90,0x51,0x60,0x00,0x91,0x45,0x48,0x00,0x92,0x21,0x60,0x00,0x93,0x12,0x60,0x03,0x0e,0x60,0x04,0x90,0x51,0x60,0x00,0x91,0x4c,0x48,0x00,0x92,0x2d,0x60,0x00,0x93,
0x0e,0x40,0x03,0x90,0x4f,0x60,0x00,0x93,0x0e,0x40,0x03,0x90,0x54,0x60,0x00,0x91,0x4d,0x48,0x00,0x92,0x2e,0x60,0x00,0x93,0x0e,0x60,0x04,0x0e,0x40,0x03,0x0e,0x20,
0x04,0x0e,0x60,0x03,0x91,0x45,0x48,0x00,0x92,0x21,0x60,0x00,0x93,0x12,0x60,0x07,0x90,0x51,0x60,0x00,0x91,0x4c,0x48,0x00,0x92,0x2d,0x60,0x03,0x91,0x4c,0x48,0x03,
0x90,0x51,0x60,0x00,0x91,0x45,0x48,0x00,0x92,0x21,0x60,0x00,0x93,0x0e,0x60,0x04,0x0e,0x40,0x03,0x90,0x4f,0x60,0x00,0x91,0x4c,0x48,0x00,0x92,0x2d,0x60,0x00,0x93,
0x0e,0x20,0x03,0x0e,0x60,0x04,0x90,0x51,0x60,0x00,0x91,0x4c,0x48,0x00,0x92,0x2d,0x60,0x00,0x93,0x12,0x60,0x03,0x0e,0x60,0x04,0x90,0x51,0x60,0x00,0x91,0x4b,0x48,
0x00,0x92,0x2c,0x60,0x00,0x93,0x0e,0x40,0x03,0x90,0x4f,0x60,0x00,0x93,0x0e,0x40,0x03,0x90,0x48,0x60,0x00,0x91,0x4a,0x48,0x00,0x92,0x2b,0x60,0x00,0x93,0x0e,0x60,
0x04,0x0e,0x40,0x03,0x91,0x49,0x48,0x00,0x92,0x2a,0x60,0x00,0x93,0x0e,0x20,0x03,0x0e,0x60,0x04,0x90,0x4c,0x60,0x00,0x91,0x4c,0x48,0x00,0x92,0x28,0x60,0x00,0x93,
0x12,0x60,0x07,0x90,0x4f,0x60,0x00,0x91,0x53,0x48,0x00,0x92,0x34,0x60,0x03,0x91,0x53,0x48,0x00,0x92,0x34,0x60,0x03,0x90,0x4c,0x60,0x00,0x91,0x4c,0x48,0x00,0x92,
0x28,0x60,0x00,0x93,0x0e,0x60,0x04,0x0e,0x40,0x03,0x90,0x4a,0x60,0x00,0x91,0x53,0x48,0x00,0x92,0x34,0x60,0x00,0x93,0x0e,0x20,0x03,0x0e,0x60,0x04,0x90,0x4c,0x60,
0x00,0x91,0x4c,0x48,0x00,0x92,0x28,0x60,0x00,0x93,0x12,0x60,0x03,0x0e,0x60,0x03,0x91,0x53,0x48,0x00,0x92,0x34,0x60,0x00,0x93,0x0e,0x40,0x04,0x0e,0x40,0x03,0x91,
0x54,0x48,0x00,0x92,0x26,0x60,0x00,0x93,0x0e,0x60,0x04,0x0e,0x40,0x03,0x92,0x27,0x60,0x00,0x93,0x0e,0x20,0x03,0x0e,0x60,0x04,0x91,0x4c,0x48,0x00,0x92,0x28,0x60,
0x00,0x93,0x12,0x60,0x06,0x91,0x53,0x48,0x00,0x92,0x34,0x60,0x04,0x91,0x53,0x48,0x00,0x92,0x34,0x60,0x03,0x91,0x4c,0x48,0x00,0x92,0x28,0x60,0x00,0x93,0x0e,0x60,
0x04,0x0e,0x40,0x03,0x91,0x53,0x48,0x00,0x92,0x34,0x60,0x00,0x93,0x0e,0x20,0x03,0x0e,0x60,0x04,0x91,0x4c,0x48,0x00,0x92,0x28,0x60,0x00,0x93,0x0e,0x60,0x03,0x92,
0x34,0x60,0x00,0x93,0x0e,0x60,0x03,0x91,0x53,0x48,0x00,0x92,0x26,0x60,0x00,0x93,0x0e,0x60,0x04,0x92,0x32,0x60,0x00,0x93,0x0e,0x60,0x03,0x91,0x58,0x48,0x00,0x92,
0x25,0x60,0x00,0x93,0x0c,0x66,0x03,0x92,0x31,0x60,0x00,0x93,0x0c,0x66,0x04,0x92,0x23,0x60,0x00,0x93,0x0c,0x66,0x03,0x92,0x2f,0x60,0x00,0x93,0x0c,0x66,0x04,0x91,
0x45,0x48,0x00,0x92,0x21,0x60,0x00,0x93,0x12,0x60,0x06,0x90,0x51,0x60,0x00,0x91,0x4c,0x48,0x00,0x92,0x2d,0x60,0x04,0x91,0x4c,0x48,0x03,0x90,0x51,0x60,0x00,0x91,
0x45,0x48,0x00,0x92,0x21,0x60,0x00,0x93,0x0e,0x60,0x03,0x0e,0x40,0x04,0x90,0x4f,0x60,0x00,0x91,0x4c,0x48,0x00,0x92,0x2d,0x60,0x00,0x93,0x0e,0x20,0x03,0x0e,0x60,
0x04,0x90,0x51,0x60,0x00,0x91,0x45,0x48,0x00,0x92,0x21,0x60,0x00,0x93,0x12,0x60,0x03,0x0e,0x60,0x03,0x90,0x51,0x60,0x00,0x91,0x4c,0x48,0x00,0x92,0x2d,0x60,0x00,
0x93,0x0e,0x40,0x04,0x90,0x4f,0x60,0x00,0x93,0x0e,0x40,0x03,0x90,0x54,0x60,0x00,0x91,0x4d,0x48,0x00,0x92,0x2e,0x60,0x00,0x93,0x0e,0x60,0x03,0x0e,0x40,0x04,0x0e,
0x20,0x03,0x0e,0x60,0x03,0x91,0x45,0x48,0x00,0x92,0x21,0x60,0x00,0x93,0x12,0x60,0x07,0x90,0x51,0x60,0x00,0x91,0x4c,0x48,0x00,0x92,0x2d,0x60,0x04,0x91,0x4c,0x48,
0x03,0x90,0x51,0x60,0x00,0x91,0x45,0x48,0x00,0x92,0x21,0x60,0x00,0x93,0x0e,0x60,0x03,0x0e,0x40,0x04,0x90,0x4f,0x60,0x00,0x91,0x4c,0x48,0x00,0x92,0x2d,0x60,0x00,
0x93,0x0e,0x20,0x03,0x0e,0x60,0x03,0x90,0x51,0x60,0x00,0x91,0x4c,0x48,0x00,0x92,0x2d,0x60,0x00,0x93,0x12,0x60,0x04,0x0e,0x60,0x03,0x90,0x51,0x60,0x00,0x91,0x4b,
0x48,0x00,0x92,0x2c,0x60,0x00,0x93,0x0e,0x40,0x03,0x90,0x4f,0x60,0x00,0x93,0x0e,0x40,0x04,0x90,0x48,0x60,0x00,0x91,0x4a,0x48,0x00,0x92,0x2b,0x60,0x00,0x93,0x0e,
0x60,0x03,0x0e,0x40,0x04,0x91,0x49,0x48,0x00,0x92,0x2a,0x60,0x00,0x93,0x0e,0x20,0x03,0x0e,0x60,0x03,0x90,0x4c,0x60,0x00,0x91,0x4c,0x48,0x00,0x92,0x28,0x60,0x00,
0x93,0x12,0x60,0x07,0x90,0x4f,0x60,0x00,0x91,0x53,0x48,0x00,0x92,0x34,0x60,0x03,0x91,0x53,0x48,0x00,0x92,0x34,0x60,0x04,0x90,0x4c,0x60,0x00,0x91,0x4c,0x48,0x00,
0x92,0x28,0x60,0x00,0x93,0x0e,0x60,0x03,0x0e,0x40,0x04,0x90,0x4a,0x60,0x00,0x91,0x53,0x48,0x00,0x92,0x34,0x60,0x00,0x93,0x0e,0x20,0x03,0x0e,0x60,0x03,0x90,0x4c,
0x60,0x00,0x91,0x4c,0x48,0x00,0x92,0x28,0x60,0x00,0x93,0x12,0x60,0x04,0x0e,0x60,0x03,0x91,0x53,0x48,0x00,0x92,0x34,0x60,0x00,0x93,0x0e,0x40,0x03,0x0e,0x40,0x04,
0x91,0x54,0x48,0x00,0x92,0x26,0x60,0x00,0x93,0x0e,0x60,0x03,0x0e,0x40,0x03,0x92,0x27,0x60,0x00,0x93,0x0e,0x20,0x04,0x0e,0x60,0x03,0x91,0x4c,0x48,0x00,0x92,0x28,
0x60,0x00,0x93,0x12,0x60,0x07,0x91,0x53,0x48,0x00,0x92,0x34,0x60,0x03,0x91,0x53,0x48,0x00,0x92,0x34,0x60,0x04,0x91,0x4c,0x48,0x00,0x92,0x28,0x60,0x00,0x93,0x0e,
0x60,0x03,0x0e,0x40,0x03,0x91,0x53,0x48,0x00,0x92,0x34,0x60,0x00,0x93,0x0e,0x20,0x04,0x0e,0x60,0x03,0x91,0x4c,0x48,0x00,0x92,0x28,0x60,0x00,0x93,0x12,0x60,0x04,
0x92,0x34,0x60,0x00,0x93,0x0c,0x66,0x03,0x91,0x53,0x48,0x00,0x92,0x26,0x60,0x00,0x93,0x0c,0x66,0x03,0x92,0x32,0x60,0x00,0x93,0x0c,0x66,0x04,0x91,0x58,0x48,0x00,
0x92,0x25,0x60,0x00,0x93,0x0e,0x60,0x03,0x92,0x31,0x60,0x00,0x93,0x0c,0x66,0x03,0x92,0x23,0x60,0x00,0x93,0x0e,0x20,0x04,0x92,0x2f,0x60,0x00,0x93,0x0e,0x60,0x03,
0x91,0x4a,0x48,0x00,0x92,0x26,0x60,0x00,0x93,0x12,0x60,0x07,0x90,0x56,0x60,0x00,0x91,0x51,0x48,0x00,0x92,0x32,0x60,0x03,0x91,0x51,0x48,0x04,0x90,0x56,0x60,0x00,
0x91,0x4a,0x48,0x00,0x92,0x26,0x60,0x00,0x93,0x0e,0x60,0x03,0x0e,0x40,0x03,0x90,0x54,0x60,0x00,0x91,0x51,0x48,0x00,0x92,0x32,0x60,0x00,0x93,0x0e,0x20,0x04,0x0e,
0x60,0x03,0x90,0x56,0x60,0x00,0x91,0x4a,0x48,0x00,0x92,0x26,0x60,0x00,0x93,0x12,0x60,0x03,0x0e,0x60,0x04,0x90,0x56,0x60,0x00,0x91,0x51,0x48,0x00,0x92,0x32,0x60,
0x00,0x93,0x0e,0x40,0x03,0x90,0x54,0x60,0x00,0x93,0x0e,0x40,0x04,0x90,0x5a,0x60,0x00,0x91,0x52,0x48,0x00,0x92,0x33,0x60,0x00,0x93,0x0e,0x60,0x03,0x0e,0x40,0x03,
0x0e,0x20,0x04,0x0e,0x60,0x03,0x91,0x4a,0x48,0x00,0x92,0x26,0x60,0x00,0x93,0x12,0x60,0x07,0x90,0x56,0x60,0x00,0x91,0x51,0x48,0x00,0x92,0x32,0x60,0x03,0x91,0x51,
0x48,0x03,0x90,0x56,0x60,0x00,0x91,0x4a,0x48,0x00,0x92,0x26,0x60,0x00,0x93,0x0e,0x60,0x04,0x0e,0x40,0x03,0x90,0x54,0x60,0x00,0x91,0x51,0x48,0x00,0x92,0x32,0x60,
0x00,0x93,0x0e,0x20,0x04,0x0e,0x60,0x03,0x90,0x56,0x60,0x00,0x91,0x51,0x48,0x00,0x92,0x32,0x60,0x00,0x93,0x12,0x60,0x03,0x0e,0x60,0x04,0x90,0x56,0x60,0x00,0x91,
0x50,0x48,0x00,0x92,0x31,0x60,0x00,0x93,0x0e,0x40,0x03,0x90,0x54,0x60,0x00,0x93,0x0e,0x40,0x03,0x90,0x4e,0x60,0x00,0x91,0x4f,0x48,0x00,0x92,0x30,0x60,0x00,0x93,
0x0e,0x60,0x04,0x0e,0x40,0x03,0x91,0x4e,0x48,0x00,0x92,0x2f,0x60,0x00,0x93,0x0e,0x20,0x03,0x0e,0x60,0x04,0x91,0x4a,0x48,0x00,0x92,0x26,0x60,0x00,0x93,0x12,0x60,
0x07,0x90,0x56,0x60,0x00,0x91,0x51,0x48,0x00,0x92,0x32,0x60,0x03,0x91,0x51,0x48,0x03,0x90,0x56,0x60,0x00,0x91,0x4a,0x48,0x00,0x92,0x26,0x60,0x00,0x93,0x0e,0x60,
0x04,0x0e,0x40,0x03,0x90,0x54,0x60,0x00,0x91,0x51,0x48,0x00,0x92,0x32,0x60,0x00,0x93,0x0e,0x20,0x03,0x0e,0x60,0x04,0x90,0x56,0x60,0x00,0x91,0x4a,0x48,0x00,0x92,
0x26,0x60,0x00,0x93,0x12,0x60,0x03,0x0e,0x60,0x04,0x90,0x56,0x60,0x00,0x91,0x51,0x48,0x00,0x92,0x32,0x60,0x00,0x93,0x0e,0x40,0x03,0x90,0x54,0x60,0x00,0x93,0x0e,
0x40,0x03,0x90,0x5a,0x60,0x00,0x91,0x52,0x48,0x00,0x92,0x33,0x60,0x00,0x93,0x0e,0x60,0x04,0x0e,0x40,0x03,0x0e,0x20,0x03,0x0e,0x60,0x04,0x91,0x4a,0x48,0x00,0x92,
0x26,0x60,0x06,0x90,0x56,0x60,0x00,0x91,0x51,0x48,0x00,0x92,0x32,0x60,0x04,0x91,0x51,0x48,0x03,0x90,0x56,0x60,0x00,0x91,0x4a,0x48,0x00,0x92,0x26,0x60,0x00,0x93,
0x0e,0x60,0x04,0x0e,0x40,0x03,0x90,0x54,0x60,0x00,0x91,0x51,0x48,0x00,0x92,0x32,0x60,0x00,0x93,0x0e,0x20,0x03,0x0e,0x60,0x04,0x90,0x56,0x60,0x00,0x91,0x51,0x48,
0x00,0x92,0x32,0x60,0x00,0x93,0x0e,0x60,0x03,0x0e,0x60,0x03,0x90,0x56,0x60,0x00,0x91,0x50,0x48,0x00,0x92,0x31,0x60,0x00,0x93,0x0e,0x60,0x04,0x90,0x54,0x60,0x00,
0x93,0x0e,0x60,0x03,0x90,0x4e,0x60,0x00,0x91,0x4f,0x48,0x00,0x92,0x30,0x60,0x00,0x93,0x0e,0x60,0x04,0x0e,0x60,0x03,0x91,0x4e,0x48,0x00,0x92,0x2f,0x60,0x00,0x93,
0x0e,0x60,0x07,0x90,0x51,0x60,0x00,0x91,0x45,0x48,0x00,0x92,0x2d,0x60,0x00,0x93,0x0c,0x66,0x03,0x90,0x4f,0x60,0x00,0x91,0x45,0x48,0x00,0x93,0x0c,0x66,0x03,0x90,
0x4c,0x60,0x00,0x91,0x45,0x48,0x00,0x93,0x0c,0x66,0x04,0x90,0x4f,0x60,0x00,0x93,0x0c,0x66,0x03,0x90,0x51,0x60,0x00,0x91,0x45,0x48,0x00,0x92,0x28,0x60,0x00,0x93,
0x0e,0x60,0x03,0x91,0x45,0x48,0x00,0x93,0x0e,0x40,0x04,0x0e,0x20,0x03,0x91,0x45,0x48,0x00,0x93,0x0e,0x60,0x04,0x90,0x57,0x60,0x00,0x91,0x4b,0x48,0x00,0x92,0x33,
0x60,0x00,0x93,0x0e,0x60,0x03,0x90,0x55,0x60,0x00,0x91,0x4b,0x48,0x00,0x93,0x0e,0x60,0x03,0x90,0x52,0x60,0x00,0x93,0x0e,0x60,0x04,0x90,0x55,0x60,0x00,0x91,0x4b,
0x48,0x00,0x93,0x0e,0x60,0x03,0x90,0x57,0x60,0x00,0x91,0x4b,0x48,0x00,0x92,0x2e,0x60,0x00,0x93,0x0e,0x60,0x03,0x91,0x4b,0x48,0x00,0x93,0x0e,0x60,0x04,0x0e,0x60,
0x03,0x91,0x4b,0x48,0x04,0x90,0x51,0x60,0x00,0x91,0x4c,0x48,0x00,0x92,0x2d,0x60,0x00,0x93,0x0c,0x66,0x03,0x90,0x4f,0x60,0x00,0x91,0x4c,0x48,0x00,0x93,0x0c,0x66,
0x03,0x90,0x4c,0x60,0x00,0x93,0x0c,0x66,0x04,0x90,0x4f,0x60,0x00,0x91,0x4c,0x48,0x00,0x93,0x0c,0x66,0x03,0x90,0x51,0x60,0x00,0x91,0x4c,0x48,0x00,0x92,0x28,0x60,
0x00,0x93,0x0e,0x60,0x03,0x91,0x4c,0x48,0x00,0x93,0x0e,0x40,0x04,0x0e,0x20,0x03,0x91,0x4c,0x48,0x00,0x93,0x0e,0x60,0x03,0x90,0x57,0x60,0x00,0x91,0x52,0x48,0x00,
0x92,0x33,0x60,0x00,0x93,0x0e,0x60,0x04,0x90,0x55,0x60,0x00,0x91,0x52,0x48,0x00,0x93,0x0e,0x60,0x03,0x90,0x52,0x60,0x00,0x93,0x0e,0x60,0x04,0x90,0x55,0x60,0x00,
0x91,0x52,0x48,0x00,0x93,0x0e,0x60,0x03,0x90,0x57,0x60,0x00,0x91,0x52,0x48,0x00,0x92,0x2e,0x60,0x00,0x93,0x0e,0x60,0x03,0x91,0x52,0x48,0x00,0x93,0x0e,0x60,0x04,
0x0e,0x60,0x03,0x91,0x52,0x48,0x03,0x90,0x51,0x60,0x00,0x91,0x45,0x48,0x00,0x92,0x2d,0x60,0x00,0x93,0x0c,0x66,0x04,0x90,0x4f,0x60,0x03,0x4c,0x60,0x00,0x92,0x28,
0x60,0x04,0x90,0x51,0x60,0x03,0x57,0x60,0x00,0x91,0x4b,0x48,0x00,0x92,0x33,0x60,0x00,0x93,0x0e,0x66,0x03,0x90,0x55,0x60,0x04,0x52,0x60,0x00,0x92,0x2e,0x60,0x03,
0x90,0x57,0x60,0x03,0x51,0x60,0x00,0x91,0x52,0x48,0x00,0x92,0x2d,0x60,0x00,0x93,0x0c,0x66,0x04,0x90,0x4f,0x60,0x03,0x4c,0x60,0x00,0x92,0x28,0x60,0x03,0x90,0x51,
0x60,0x04,0x57,0x60,0x00,0x91,0x57,0x48,0x00,0x92,0x33,0x60,0x00,0x93,0x0e,0x66,0x03,0x90,0x55,0x60,0x04,0x52,0x60,0x00,0x92,0x2e,0x60,0x03,0x90,0x57,0x60,0x03,
0x93,0x0c,0x66,0x04,0x0c,0x66,0x03,0x90,0x4c,0x60,0x00,0x91,0x47,0x48,0x00,0x92,0x28,0x60,0x00,0x93,0x0c,0x66,0x03,0x90,0x4c,0x60,0x00,0x91,0x47,0x48,0x00,0x92,
0x28,0x60,0x00,0x93,0x12,0x66,0x04,0x90,0x4c,0x60,0x00,0x91,0x47,0x48,0x00,0x92,0x28,0x60,0x00,0x93,0x0c,0x66,0x03,0x12,0x66,0x03,0x90,0x52,0x60,0x00,0x91,0x4c,
0x48,0x00,0x92,0x2e,0x60,0x00,0x93,0x0c,0x66,0x04,0x12,0x66,0x03,0x90,0x4c,0x60,0x00,0x91,0x47,0x48,0x00,0x92,0x28,0x60,0x00,0x93,0x0c,0x66,0x04,0x0c,0x66,0x03,
0x92,0x26,0x60,0x00,0x93,0x0c,0x66,0x03,0x12,0x66,0x04,0x92,0x25,0x60,0x00,0x93,0x0e,0x66,0x03,0x0e,0x66,0x03,0x92,0x23,0x60,0x00,0x93,0x0e,0x66,0x04,0x0e,0x66,
0x03,0x90,0x45,0x60,0x00,0x92,0x29,0x60,0x00,0x93,0x0c,0x66,0x07,0x90,0x45,0x30,0x00,0x92,0x35,0x60,0x00,0x93,0x12,0x66,0x03,0x0e,0x66,0x04,0x90,0x48,0x60,0x00,
0x92,0x29,0x60,0x00,0x93,0x0c,0x66,0x03,0x12,0x66,0x03,0x90,0x48,0x30,0x00,0x92,0x35,0x60,0x00,0x93,0x0c,0x66,0x04,0x0e,0x66,0x03,0x90,0x4a,0x60,0x00,0x92,0x29,
0x60,0x00,0x93,0x0c,0x66,0x03,0x0c,0x66,0x04,0x90,0x4a,0x30,0x00,0x92,0x35,0x60,0x00,0x93,0x0c,0x66,0x03,0x0e,0x66,0x04,0x90,0x4c,0x60,0x00,0x92,0x29,0x60,0x00,
0x93,0x0c,0x66,0x03,0x0e,0x66,0x03,0x90,0x4c,0x30,0x00,0x92,0x35,0x60,0x00,0x93,0x0c,0x66,0x04,0x0c,0x66,0x03,0x90,0x4f,0x60,0x00,0x92,0x28,0x60,0x00,0x93,0x0c,
0x66,0x07,0x90,0x4f,0x30,0x00,0x92,0x34,0x60,0x07,0x90,0x4c,0x60,0x00,0x92,0x28,0x60,0x00,0x93,0x0e,0x66,0x06,0x90,0x4f,0x60,0x00,0x92,0x34,0x60,0x07,0x90,0x54,
0x60,0x00,0x92,0x2d,0x60,0x00,0x93,0x0c,0x66,0x03,0x0c,0x66,0x04,0x90,0x53,0x60,0x00,0x92,0x39,0x60,0x00,0x93,0x0c,0x66,0x03,0x0c,0x66,0x03,0x90,0x51,0x60,0x00,
0x92,0x2d,0x60,0x00,0x93,0x0c,0x66,0x04,0x0e,0x66,0x03,0x90,0x51,0x30,0x00,0x92,0x39,0x60,0x04,0x93,0x0e,0x66,0x03,0x90,0x45,0x60,0x00,0x92,0x29,0x60,0x00,0x93,
0x0c,0x66,0x03,0x0c,0x66,0x04,0x90,0x45,0x30,0x00,0x92,0x35,0x60,0x00,0x93,0x0c,0x66,0x03,0x12,0x66,0x03,0x90,0x48,0x60,0x00,0x92,0x29,0x60,0x00,0x93,0x0c,0x66,
0x04,0x12,0x66,0x03,0x90,0x48,0x30,0x00,0x92,0x35,0x60,0x00,0x93,0x0c,0x66,0x04,0x12,0x66,0x03,0x90,0x4a,0x60,0x00,0x92,0x29,0x60,0x00,0x93,0x0c,0x66,0x03,0x0c,
0x66,0x04,0x90,0x4a,0x30,0x00,0x92,0x35,0x60,0x00,0x93,0x0c,0x66,0x03,0x12,0x66,0x03,0x90,0x4c,0x60,0x00,0x92,0x29,0x60,0x00,0x93,0x0e,0x66,0x04,0x0e,0x66,0x03,
0x90,0x4c,0x30,0x00,0x92,0x35,0x60,0x00,0x93,0x0e,0x66,0x03,0x0e,0x66,0x04,0x90,0x4e,0x60,0x00,0x92,0x2f,0x60,0x00,0x93,0x0c,0x66,0x07,0x90,0x4e,0x30,0x00,0x92,
0x3b,0x60,0x00,0x93,0x12,0x66,0x03,0x0e,0x66,0x03,0x90,0x4b,0x60,0x00,0x92,0x2f,0x60,0x00,0x93,0x0c,0x66,0x04,0x12,0x66,0x03,0x90,0x4e,0x60,0x00,0x92,0x3b,0x60,
0x00,0x93,0x0c,0x66,0x03,0x0e,0x66,0x04,0x90,0x44,0x60,0x00,0x92,0x28,0x60,0x00,0x93,0x0c,0x66,0x03,0x90,0x50,0x56,0x00,0x93,0x0c,0x66,0x03,0x90,0x44,0x4c,0x00,
0x92,0x34,0x60,0x00,0x93,0x0c,0x66,0x04,0x90,0x50,0x42,0x00,0x93,0x0e,0x66,0x03,0x90,0x44,0x38,0x00,0x92,0x28,0x60,0x00,0x93,0x0c,0x66,0x04,0x90,0x50,0x2e,0x00,
0x93,0x0e,0x66,0x03,0x90,0x44,0x24,0x00,0x92,0x34,0x60,0x00,0x93,0x0c,0x66,0x03,0x90,0x50,0x1a,0x00,0x93,0x0c,0x66,0x04,0x91,0x48,0x38,0x00,0x93,0x0c,0x60,0x00,
0x0e,0x66,0x03,0x12,0x60,0x03,0x90,0x51,0x60,0x00,0x91,0x48,0x38,0x00,0x93,0x16,0x60,0x04,0x0e,0x66,0x02,0x16,0x04,0x01,0x90,0x51,0x60,0x00,0x91,0x48,0x38,0x00,
0x93,0x0c,0x60,0x04,0x12,0x60,0x03,0x90,0x4f,0x60,0x00,0x91,0x48,0x38,0x00,0x93,0x16,0x60,0x00,0x0e,0x66,0x06,0x16,0x04,0x01,0x90,0x51,0x60,0x00,0x91,0x48,0x38,
0x00,0x93,0x0c,0x60,0x00,0x0e,0x66,0x03,0x12,0x60,0x00,0x0e,0x66,0x03,0x90,0x51,0x60,0x00,0x93,0x16,0x60,0x00,0x0e,0x66,0x04,0x90,0x4f,0x60,0x00,0x91,0x48,0x38,
0x02,0x93,0x16,0x04,0x01,0x90,0x51,0x60,0x00,0x91,0x48,0x38,0x00,0x93,0x0c,0x60,0x00,0x0e,0x66,0x03,0x12,0x60,0x04,0x90,0x4f,0x60,0x00,0x91,0x48,0x38,0x00,0x93,
0x12,0x60,0x00,0x0e,0x66,0x03,0x12,0x60,0x04,0x90,0x51,0x60,0x00,0x91,0x48,0x38,0x00,0x93,0x0c,0x60,0x03,0x12,0x60,0x03,0x90,0x4f,0x60,0x00,0x91,0x48,0x38,0x00,
0x93,0x16,0x60,0x06,0x16,0x04,0x01,0x90,0x51,0x60,0x00,0x91,0x48,0x38,0x00,0x93,0x0c,0x60,0x03,0x12,0x60,0x04,0x90,0x4f,0x60,0x00,0x91,0x48,0x38,0x00,0x93,0x16,
0x60,0x06,0x16,0x04,0x01,0x90,0x51,0x60,0x00,0x91,0x48,0x38,0x00,0x93,0x0c,0x60,0x03,0x12,0x60,0x03,0x90,0x51,0x60,0x00,0x93,0x16,0x60,0x03,0x91,0x48,0x38,0x01,
0x90,0x4f,0x60,0x02,0x93,0x16,0x04,0x01,0x90,0x51,0x60,0x00,0x93,0x0c,0x60,0x03,0x90,0x54,0x60,0x00,0x93,0x12,0x60,0x01,0x91,0x48,0x38,0x03,0x90,0x51,0x60,0x00,
0x93,0x12,0x60,0x03,0x90,0x4f,0x60,0x00,0x93,0x12,0x60,0x03,0x90,0x4c,0x60,0x00,0x91,0x4e,0x38,0x00,0x93,0x0c,0x60,0x04,0x12,0x60,0x03,0x90,0x4f,0x60,0x00,0x91,
0x4e,0x38,0x00,0x93,0x16,0x60,0x06,0x16,0x04,0x01,0x90,0x4c,0x60,0x00,0x91,0x4e,0x38,0x00,0x93,0x0c,0x60,0x03,0x12,0x60,0x04,0x90,0x4a,0x60,0x00,0x91,0x4e,0x38,
0x00,0x93,0x16,0x60,0x06,0x16,0x04,0x00,0x90,0x4c,0x60,0x00,0x91,0x4e,0x38,0x00,0x93,0x0c,0x60,0x02,0x90,0x4c,0x5a,0x02,0x4c,0x54,0x00,0x93,0x12,0x60,0x01,0x90,
0x4c,0x4e,0x02,0x4c,0x48,0x00,0x93,0x16,0x60,0x02,0x90,0x4c,0x42,0x02,0x4c,0x3c,0x01,0x4c,0x36,0x01,0x93,0x16,0x04,0x01,0x90,0x4c,0x30,0x00,0x93,0x0c,0x60,0x02,
0x90,0x4c,0x2a,0x01,0x4c,0x24,0x00,0x93,0x12,0x60,0x02,0x90,0x4c,0x1e,0x02,0x4c,0x18,0x00,0x93,0x12,0x60,0x01,0x90,0x4c,0x12,0x02,0x4c,0x0c,0x00,0x93,0x12,0x60,
0x02,0x90,0x4c,0x06,0x01,0x91,0x4e,0x38,0x00,0x93,0x0c,0x60,0x04,0x12,0x60,0x03,0x91,0x51,0x38,0x00,0x93,0x16,0x60,0x06,0x16,0x04,0x01,0x91,0x4e,0x38,0x00,0x93,
0x0c,0x60,0x03,0x12,0x60,0x04,0x91,0x4c,0x38,0x00,0x93,0x16,0x60,0x05,0x16,0x04,0x01,0x91,0x4e,0x38,0x00,0x93,0x0c,0x60,0x04,0x12,0x60,0x03,0x16,0x60,0x06,0x16,
0x04,0x01,0x0c,0x60,0x03,0x12,0x60,0x03,0x12,0x60,0x04,0x12,0x60,0x03,0x91,0x48,0x38,0x00,0x93,0x0c,0x60,0x04,0x12,0x60,0x03,0x90,0x51,0x60,0x00,0x91,0x48,0x38,
0x00,0x93,0x16,0x60,0x06,0x16,0x04,0x01,0x90,0x51,0x60,0x00,0x91,0x48,0x38,0x00,0x93,0x0c,0x60,0x03,0x12,0x60,0x03,0x90,0x4f,0x60,0x00,0x91,0x48,0x38,0x00,0x93,
0x16,0x60,0x06,0x16,0x04,0x01,0x90,0x51,0x60,0x00,0x91,0x48,0x38,0x00,0x93,0x0c,0x60,0x04,0x12,0x60,0x03,0x90,0x51,0x60,0x00,0x91,0x48,0x38,0x00,0x93,0x16,0x60,
0x03,0x90,0x4f,0x60,0x03,0x93,0x16,0x04,0x01,0x90,0x51,0x60,0x00,0x91,0x48,0x38,0x00,0x93,0x0c,0x60,0x03,0x12,0x60,0x03,0x90,0x4f,0x60,0x00,0x91,0x48,0x38,0x00,
0x93,0x12,0x60,0x04,0x12,0x60,0x03,0x90,0x51,0x60,0x00,0x91,0x48,0x38,0x00,0x93,0x0c,0x60,0x03,0x12,0x60,0x04,0x90,0x4f,0x60,0x00,0x91,0x48,0x38,0x00,0x93,0x16,
0x60,0x06,0x16,0x04,0x01,0x90,0x51,0x60,0x00,0x91,0x48,0x38,0x00,0x93,0x0c,0x60,0x03,0x12,0x60,0x03,0x90,0x4f,0x60,0x00,0x91,0x48,0x38,0x00,0x93,0x16,0x60,0x06,
0x16,0x04,0x01,0x90,0x51,0x60,0x00,0x91,0x48,0x38,0x00,0x93,0x0c,0x60,0x03,0x12,0x60,0x04,0x90,0x51,0x60,0x00,0x91,0x48,0x38,0x00,0x93,0x16,0x60,0x03,0x90,0x4f,
0x60,0x03,0x93,0x16,0x04,0x01,0x90,0x51,0x60,0x00,0x91,0x48,0x38,0x00,0x93,0x0c,0x60,0x03,0x90,0x54,0x60,0x00,0x93,0x12,0x60,0x03,0x90,0x51,0x60,0x00,0x91,0x48,
0x38,0x00,0x93,0x12,0x60,0x04,0x90,0x4f,0x60,0x00,0x93,0x12,0x60,0x03,0x90,0x4c,0x60,0x00,0x91,0x48,0x38,0x00,0x93,0x0c,0x60,0x03,0x12,0x60,0x04,0x90,0x4f,0x60,
0x00,0x91,0x48,0x38,0x00,0x93,0x16,0x60,0x06,0x16,0x04,0x00,0x90,0x4c,0x60,0x00,0x91,0x48,0x38,0x00,0x93,0x0c,0x60,0x04,0x12,0x60,0x03,0x90,0x4a,0x60,0x00,0x91,
0x48,0x38,0x00,0x93,0x16,0x60,0x06,0x16,0x04,0x01,0x90,0x4c,0x60,0x00,0x91,0x48,0x38,0x00,0x93,0x0c,0x60,0x02,0x90,0x4c,0x5a,0x01,0x4c,0x54,0x00,0x93,0x12,0x60,
0x02,0x90,0x4c,0x4e,0x02,0x4c,0x48,0x00,0x93,0x16,0x60,0x01,0x90,0x4c,0x42,0x02,0x4c,0x3c,0x02,0x4c,0x36,0x01,0x93,0x16,0x04,0x00,0x90,0x4c,0x30,0x00,0x91,0x48,
0x38,0x00,0x93,0x0c,0x60,0x02,0x90,0x4c,0x2a,0x02,0x4c,0x24,0x00,0x93,0x12,0x60,0x01,0x90,0x4c,0x1e,0x02,0x4c,0x18,0x00,0x93,0x12,0x60,0x02,0x90,0x4c,0x12,0x02,
0x4c,0x0c,0x00,0x93,0x12,0x60,0x01,0x90,0x4c,0x06,0x02,0x91,0x4e,0x48,0x00,0x93,0x0c,0x60,0x03,0x12,0x60,0x04,0x91,0x51,0x48,0x00,0x93,0x16,0x60,0x06,0x16,0x04,
0x00,0x91,0x4e,0x48,0x00,0x93,0x0c,0x60,0x04,0x12,0x60,0x03,0x91,0x4c,0x48,0x00,0x93,0x16,0x60,0x06,0x16,0x04,0x01,0x91,0x4e,0x48,0x00,0x93,0x0c,0x60,0x03,0x12,
0x60,0x04,0x16,0x60,0x05,0x16,0x04,0x01,0x0c,0x60,0x04,0x12,0x60,0x03,0x12,0x60,0x03,0x12,0x60,0x04,0x90,0x45,0x60,0x00,0x92,0x1d,0x60,0x00,0x93,0x0c,0x66,0x07,
0x90,0x45,0x30,0x00,0x91,0x51,0x48,0x00,0x92,0x29,0x60,0x03,0x91,0x51,0x48,0x03,0x90,0x48,0x60,0x00,0x92,0x1d,0x60,0x00,0x93,0x0e,0x66,0x07,0x90,0x48,0x30,0x00,
0x91,0x51,0x48,0x00,0x92,0x29,0x60,0x03,0x91,0x51,0x48,0x04,0x90,0x4a,0x60,0x00,0x92,0x1d,0x60,0x00,0x93,0x0c,0x66,0x06,0x90,0x4a,0x30,0x00,0x91,0x51,0x48,0x00,
0x92,0x29,0x60,0x04,0x91,0x51,0x48,0x03,0x90,0x4c,0x60,0x00,0x92,0x1d,0x60,0x00,0x93,0x0e,0x66,0x07,0x90,0x4c,0x30,0x00,0x91,0x51,0x48,0x00,0x92,0x29,0x60,0x03,
0x91,0x51,0x48,0x04,0x90,0x4f,0x60,0x00,0x92,0x1c,0x60,0x00,0x93,0x0c,0x66,0x06,0x90,0x4f,0x30,0x00,0x91,0x51,0x48,0x00,0x92,0x28,0x60,0x04,0x91,0x51,0x48,0x03,
0x90,0x4c,0x60,0x00,0x92,0x1c,0x60,0x00,0x93,0x0e,0x66,0x07,0x90,0x4f,0x60,0x00,0x91,0x51,0x48,0x00,0x92,0x28,0x60,0x03,0x91,0x51,0x48,0x04,0x90,0x54,0x60,0x00,
0x92,0x21,0x60,0x00,0x93,0x0c,0x66,0x06,0x90,0x53,0x60,0x00,0x91,0x51,0x48,0x00,0x92,0x2d,0x60,0x00,0x93,0x0c,0x66,0x04,0x91,0x51,0x48,0x03,0x90,0x51,0x60,0x00,
0x92,0x21,0x60,0x00,0x93,0x0e,0x66,0x07,0x90,0x51,0x30,0x00,0x91,0x51,0x48,0x00,0x92,0x2d,0x60,0x03,0x91,0x51,0x48,0x04,0x90,0x45,0x60,0x00,0x92,0x1d,0x60,0x00,
0x93,0x0c,0x66,0x06,0x90,0x45,0x30,0x00,0x91,0x51,0x48,0x00,0x92,0x29,0x60,0x04,0x91,0x51,0x48,0x03,0x90,0x48,0x60,0x00,0x92,0x1d,0x60,0x00,0x93,0x0e,0x66,0x07,
0x90,0x48,0x30,0x00,0x91,0x51,0x48,0x00,0x92,0x29,0x60,0x03,0x91,0x51,0x48,0x03,0x90,0x4a,0x60,0x00,0x92,0x1d,0x60,0x00,0x93,0x0c,0x66,0x07,0x90,0x4a,0x30,0x00,
0x91,0x51,0x48,0x00,0x92,0x29,0x60,0x04,0x91,0x51,0x48,0x03,0x90,0x4c,0x60,0x00,0x92,0x1d,0x60,0x00,0x93,0x0e,0x66,0x07,0x90,0x4c,0x30,0x00,0x91,0x51,0x48,0x00,
0x92,0x29,0x60,0x03,0x91,0x51,0x48,0x03,0x90,0x4e,0x60,0x00,0x92,0x23,0x60,0x00,0x93,0x0c,0x66,0x07,0x90,0x4e,0x30,0x00,0x91,0x4e,0x48,0x00,0x92,0x2f,0x60,0x04,
0x91,0x4e,0x48,0x03,0x90,0x4b,0x60,0x00,0x92,0x23,0x60,0x00,0x93,0x0e,0x66,0x07,0x90,0x4e,0x60,0x00,0x91,0x4e,0x48,0x00,0x92,0x2f,0x60,0x03,0x91,0x4e,0x48,0x03,
0x90,0x44,0x60,0x00,0x92,0x1c,0x60,0x04,0x90,0x50,0x56,0x03,0x44,0x4c,0x00,0x91,0x50,0x48,0x00,0x92,0x28,0x60,0x00,0x93,0x0c,0x66,0x03,0x90,0x50,0x42,0x00,0x91,
0x50,0x48,0x04,0x90,0x44,0x38,0x00,0x92,0x1c,0x60,0x00,0x93,0x0e,0x66,0x03,0x90,0x50,0x2e,0x04,0x44,0x24,0x00,0x91,0x50,0x48,0x00,0x92,0x28,0x60,0x03,0x90,0x50,
0x1a,0x00,0x91,0x50,0x48,0x03,0x90,0x45,0x60,0x00,0x92,0x1d,0x60,0x00,0x93,0x0c,0x66,0x07,0x90,0x45,0x30,0x00,0x91,0x51,0x48,0x00,0x92,0x29,0x60,0x03,0x91,0x51,
0x48,0x04,0x90,0x48,0x60,0x00,0x92,0x1d,0x60,0x00,0x93,0x0e,0x66,0x07,0x90,0x48,0x30,0x00,0x91,0x51,0x48,0x00,0x92,0x29,0x60,0x03,0x91,0x51,0x48,0x03,0x90,0x4a,
0x60,0x00,0x92,0x1d,0x60,0x00,0x93,0x0c,0x66,0x07,0x90,0x4a,0x30,0x00,0x91,0x51,0x48,0x00,0x92,0x29,0x60,0x03,0x91,0x51,0x48,0x04,0x90,0x4c,0x60,0x00,0x92,0x1d,
0x60,0x00,0x93,0x0e,0x66,0x06,0x90,0x4c,0x30,0x00,0x91,0x51,0x48,0x00,0x92,0x29,0x60,0x04,0x91,0x51,0x48,0x03,0x90,0x4f,0x60,0x00,0x92,0x1c,0x60,0x00,0x93,0x0c,
0x66,0x07,0x90,0x4f,0x30,0x00,0x91,0x51,0x48,0x00,0x92,0x28,0x60,0x03,0x91,0x51,0x48,0x04,0x90,0x4c,0x60,0x00,0x92,0x1c,0x60,0x00,0x93,0x0e,0x66,0x06,0x90,0x4f,
0x60,0x00,0x91,0x51,0x48,0x00,0x92,0x28,0x60,0x04,0x91,0x51,0x48,0x03,0x90,0x54,0x60,0x00,0x92,0x21,0x60,0x00,0x93,0x0c,0x66,0x07,0x90,0x53,0x60,0x00,0x91,0x51,
0x48,0x00,0x92,0x2d,0x60,0x00,0x93,0x0c,0x66,0x03,0x91,0x51,0x48,0x04,0x90,0x51,0x60,0x00,0x92,0x21,0x60,0x00,0x93,0x0e,0x66,0x06,0x90,0x51,0x30,0x00,0x91,0x51,
0x48,0x00,0x92,0x2d,0x60,0x04,0x91,0x51,0x48,0x03,0x90,0x45,0x60,0x00,0x92,0x1d,0x60,0x00,0x93,0x0c,0x66,0x07,0x90,0x45,0x30,0x00,0x91,0x51,0x48,0x00,0x92,0x29,
0x60,0x03,0x91,0x51,0x48,0x04,0x90,0x48,0x60,0x00,0x92,0x1d,0x60,0x00,0x93,0x0e,0x66,0x06,0x90,0x48,0x30,0x00,0x91,0x51,0x48,0x00,0x92,0x29,0x60,0x04,0x91,0x51,
0x48,0x03,0x90,0x4a,0x60,0x00,0x92,0x1d,0x60,0x00,0x93,0x0c,0x66,0x07,0x90,0x4a,0x30,0x00,0x91,0x51,0x48,0x00,0x92,0x29,0x60,0x03,0x91,0x51,0x48,0x03,0x90,0x4c,
0x60,0x00,0x92,0x1d,0x60,0x00,0x93,0x0e,0x66,0x07,0x90,0x4c,0x30,0x00,0x91,0x51,0x48,0x00,0x92,0x29,0x60,0x04,0x91,0x51,0x48,0x03,0x90,0x4e,0x60,0x00,0x92,0x23,
0x60,0x00,0x93,0x0c,0x66,0x07,0x90,0x4e,0x30,0x00,0x91,0x4e,0x48,0x00,0x92,0x2f,0x60,0x03,0x91,0x4e,0x48,0x03,0x90,0x4b,0x60,0x00,0x92,0x23,0x60,0x00,0x93,0x0e,
0x66,0x07,0x90,0x4e,0x60,0x00,0x91,0x4e,0x48,0x00,0x92,0x2f,0x60,0x04,0x91,0x4e,0x48,0x03,0x90,0x44,0x60,0x00,0x92,0x1c,0x60,0x00,0x93,0x0c,0x66,0x03,0x90,0x50,
0x56,0x00,0x93,0x0c,0x66,0x04,0x90,0x44,0x4c,0x00,0x91,0x50,0x48,0x00,0x92,0x28,0x60,0x00,0x93,0x0c,0x66,0x03,0x90,0x50,0x42,0x00,0x91,0x50,0x48,0x00,0x93,0x0c,
0x66,0x03,0x90,0x44,0x38,0x00,0x92,0x1c,0x60,0x00,0x93,0x0e,0x66,0x04,0x90,0x50,0x2e,0x03,0x44,0x24,0x00,0x91,0x50,0x48,0x00,0x92,0x28,0x60,0x00,0x93,0x0c,0x66,
0x02,0xff,0x06,0x01,0x45,0x01,0x90,0x50,0x1a,0x00,0x91,0x50,0x48,0x3a,0xb3,0x64,0x00,0x00,0xff,0x2f,0x00 
*/

























0x00,0xc3,0x00,0x00,0xc2,0x02,0x00,0xc1,0x01,0x00,0xc0,0x00,0x00,0xb0,0x64,0x00,0x00,0x64,0x00,0x00,0xb1,0x64,0x00,0x00,0x91,0x45,0x48,0x00,0xb1,0x64,0x00,0x00,
0xb2,0x64,0x00,0x00,0x92,0x21,0x60,0x00,0xb3,0x64,0x00,0x00,0x93,0x0c,0x66,0x00,0xff,0x06,0x01,0x53,0x0b,0x91,0x4c,0x48,0x00,0x92,0x2d,0x60,0x06,0x91,0x4c,0x48,
0x05,0x45,0x48,0x00,0x92,0x21,0x60,0x00,0x93,0x0e,0x60,0x06,0x0e,0x40,0x06,0x91,0x4c,0x48,0x00,0x92,0x2d,0x60,0x00,0x93,0x0e,0x20,0x05,0x12,0x66,0x06,0x91,0x45,
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0x03,0xff,0x06,0x01,0x45,0x02,0x90,0x50,0x1a,0x00,0x91,0x50,0x48,0x61,0xb3,0x64,0x00,0x00,0xff,0x2f,0x00 

};


