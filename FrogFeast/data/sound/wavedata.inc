const char RibbitWave[] PROGMEM = {
0x01,0x06,0x09,0x04,0xFE,0xFD,0x00,0xFF,0x01,0x06,0x0C,0x0B,0x02,0xFE,0xFE,0xF6,
0xEE,0xF1,0xFD,0x0A,0x13,0x14,0x0F,0x01,0xEC,0xE0,0xE4,0xF4,0x05,0x12,0x16,0x10,
0x06,0xFF,0xF5,0xEA,0xEB,0xF8,0x09,0x16,0x1A,0x16,0x0D,0xFF,0xF0,0xE8,0xEA,0xF6,
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0x04,0x03,0x01,0x02,0x04,0x05,0x04,0x05,0x07,0x05,0x02,0x00,0x02,0x01,0xFE,0xFC,
0xFC,0xFB,0xFB,0xFC,0x00,0x03,0x03,0x02,0x02,0x03,0x01,0x00,/*0x01,0x00,0xFE,0xFD,
0xFC,0xFD,0xFC,0xFC,0xFC,0xFD,0xFF,0x01,0x04,0x07,0x0A,0x0A,0x0B,0x0A,0x09,0x08,
0x05,0x02,0x01,0x00,0x00,0xFE,0xFC,0xFB,0xFD,0xFF,0x00,0x00,*/};


const char SplashWave[] PROGMEM = {/*
0xFE,0xFE,0xFE,0x01,0x02,0x04,0x02,0x03,0x02,0x03,0x02,0x02,0x03,0x03,0x02,0x01,
0x04,0x04,0x05,0x03,0x05,0x00,0x01,0x02,0x02,0x05,0x07,0x04,0x03,0x06,0x03,0x04,
0x03,0x08,0x07,0x07,0x02,0x05,0x04,0x0A,0x0A,0x09,0x0B,0x03,0x0A,0x01,0x07,0x09,
0x08,0x08,0x06,0x08,0x09,0x0C,0x0A,0x0A,0x0A,0x09,0x0A,0x0B,0x0C,0x0C,0x0C,0x0C,
0x0C,0x0E,0x0C,0x0C,0x0C,0x0E,0x0C,0x0C,0x0B,0x07,0x08,0x07,0x0A,0x08,0x08,0x04,
0x07,0x06,0x05,0x05,0x01,0x02,0x02,0x07,0x02,0x01,0xFF,0x02,0xFC,0xFD,0x02,0xFA,
0xF6,0xF7,0xFA,0xF7,0xF6,0xF3,0xF7,0xF9,0xF6,0xF6,0xF4,0xF4,0xF6,0xF0,0xF2,0xEF,
0xEE,0xEE,0xEE,0xED,0xF0,0xEF,0xED,0xF2,0xF1,0xF2,0xEF,0xF3,0xEC,0xED,0xED,0xF1,
0xF1,0xEE,0xF0,0xED,0xEC,0xED,0xED,0xEB,0xED,0xEA,0xEC,0xED,0xF0,0xED,0xEB,0xE4,
0xEB,0xE9,0xE9,0xE9,0xEB,0xEA,0xE9,0xEC,0xE7,0xE7,0xE5,0xE6,0xE5,0xE7,0xE2,0xF1,
0xE7,0xEB,0xF3,0xE6,0xEA,0xE9,0xEA,0xEF,0xEC,0xE2,0xE0,0xE2,0xEC,0xE5,0xED,0xE7,
0xDE,0xE9,0xE7,0xE6,0xED,0xEB,0xE6,0xE9,0xEE,0xED,0xEA,0xF5,0xEB,0xE9,0xEF,0xF3,
0xE4,0xE1,0xEB,0xE8,0xEE,0xE9,0xEA,0xEE,0xF7,0xE5,0xE8,0xE4,0xEE,0xEB,0xE5,0xF0,
0xDD,0xEA,0xEA,0xED,0xEE,0xF0,0xE8,0xEE,0xF1,0xE2,0xF1,0xF2,0xE9,0xE0,0xDF,0xF2,
0xF7,0xFE,0xE7,0xEB,0xF5,0xDE,0xEA,0xFC,0xE7,0xEA,0xF4,0xEE,0xFB,0xF1,0xED,0xE8,
0xF0,0xFA,0xF5,0xF7,0x00,0xE5,0xE8,0x01,0xF5,0xF1,0xF5,0xF0,0xEF,0xF3,0xFC,0xFE,
0xF9,0xF1,0xF7,0xF6,0xEB,0x04,0xFB,0xEA,0xFB,0xFA,0xF1,0x02,0xFB,0xF2,0xF0,0x02,
0xFA,0xF9,0xFE,0xF2,0xF0,0xF9,0x07,0xF3,0xFB,0xF1,0xF4,0x07,0xF5,0xF5,0xFD,0xF8,
0x09,0x08,0xFD,0xF1,0xF0,0x00,0x07,0x03,0xEF,0xF5,0xFB,0xF6,0xF5,0x09,0xF5,0xFB,
0x06,0xFF,0x09,0xF6,0xFF,0xFB,0xFD,0x0B,0xF7,0x07,0xF8,0xFB,0x04,0x01,0xFE,0x0C,
0x06,0xF5,0x07,0xF9,0x32,0xD9,0x02,0x28,0xF8,0xF2,0x0B,0x1F,0xE7,0x0F,0xFA,0x10,
0x05,0x0B,0xD4,0x26,0x0F,0xCA,0x46,0xF0,0xF0,0x27,0xEB,0xFF,0x31,0xE3,0x0D,0x09,
0xE5,0x0F,0xFE,0x02,0x0E,0x13,0xD8,0x0B,0x14,0x05,0x0C,0xFD,0x0E,0xE5,0x12,0x06,
0x1A,0xFE,0xF2,0x14,0xFB,0x21,0xEE,0x03,0x20,0xEE,0x24,0x00,0xF5,0x04,0xE4,0x1F,
0x0B,0xFA,0xF3,0x16,0xE6,0x14,0x15,0xEB,0xFF,0xEB,0x13,0x02,0x16,0xF8,0xF9,0xFE,
0x00,0x0C,0x09,0xF2,0x06,0xF7,0x03,0x01,0xFD,0xFF,0xED,0x06,0xFB,0x02,0xDF,0x0C,
0x0B,0xF5,0x08,0xF3,0xF1,0xFC,0x04,0x11,0xF6,0xFE,0xF0,0xF4,0x06,0x02,0x04,0xED,
0x03,0xF6,0x04,0xFC,0x08,0xF3,0xF9,0x03,0xF8,0x07,0xF2,0x0C,0xED,0x08,0xFF,0xFA,
0x02,0xF2,0x0A,0xF7,0x03,0x00,0xF2,0xFF,0xFF,0x00,0xFE,0xF5,0xFA,0xF5,0x08,0xF7,
0x14,0xFE,0xEE,0x0F,0xF1,0x0A,0xF3,0xF4,0x03,0x03,0x06,0xF3,0x00,0x01,0xFA,0x01,
0xF9,0x03,0xF9,0xF7,0xFB,0x01,0xFE,0xF6,0xF9,0xFB,0x02,0xFD,0xFD,0xEB,0x07,0x06,
0x09,0xFC,0x08,0xFD,0xEB,0x0C,0x13,0x15,0xF0,0x04,0x08,0xFD,0x00,0x0C,0x00,0xF9,
0xEE,0xFC,0x14,0x0E,0x06,0x09,0x01,0xF9,0xFA,0x0A,0x02,0x0F,0x06,0xF9,0x13,0xF2,
0x14,0xF9,0x15,0x0A,0xF1,0x07,0x04,0x23,0x17,0x15,0x01,0x04,0x0F,0x06,0xFD,0x0C,
0x08,0x00,0x07,0x0E,0x0D,0x19,0x23,0x20,0x1B,0x15,0x0A,0x03,0x0C,0xF5,0x06,0x00,
0x02,0x0B,0x03,0x12,0xFD,0x02,0x04,0x0C,0x12,0x15,0x0E,0x09,0x1A,0x1E,0x1D,0x21,
0x1B,0x0D,0x0A,0x13,0x12,0xFA,0xF6,0x0B,0x06,0xFB,0x07,0x1F,0x42,0x20,0x03,0x09,
0x17,0x10,0x0B,0x02,0xF1,0x00,0xFE,0x17,0x1C,0x03,0x1E,0x0E,0xE8,0xED,0x0B,0x0D,
0xF6,0xFF,0x0F,0x1F,0x0B,0x08,0x05,0x12,0x11,0x10,0xEE,0xFA,0xFF,0xFF,0x0B,0xF3,
0xFF,0x0E,0x21,0xFE,0x09,0xFC,0x12,0x06,0xF0,0x0E,0xFA,0x0C,0x0E,0xF9,0x02,0x08,
0x0E,0x10,0x08,0x05,0x11,0x08,0x02,0x0E,0x03,0x08,0x06,0x0A,0x01,0x0D,0x0E,0x0A,
0xFA,0x02,0x0D,0x05,0x05,0x08,0x18,0xE8,0xFB,0x11,0x09,0xF6,0xFB,0x05,0xE6,0x07,
0x02,0xEF,0xF8,0xF6,0xF8,0xFE,0xF8,0xF6,0x02,0xEC,0xFA,0xFF,0xD9,0xFB,0x09,0xF0,
0xF4,0xFD,0xF7,0xF7,0x06,0xF2,0xEA,0x02,0xF0,0xE8,0xFC,0xFD,0xFA,0xF8,0xF4,0xF8,
0x07,0xF5,0xE7,0xED,0xFC,0x06,0xFA,0xE1,0xDB,0x03,0xF3,0xFA,0x00,0xEA,0x05,0xFB,
0xDA,0x0A,0x10,0xE6,0xFE,0xFB,0xF3,0x0B,0x06,0x00,0x08,0x00,0xFF,0x00,0x04,0x02,
0xFD,0xFC,0xFA,0xFA,0x02,0x08,0xF7,0x02,0x0E,0xFD,0x0D,0x12,0x0A,0x07,0x0C,0x08,
0x1B,0x08,0x03,0x1D,0x07,0x0F,0x00,0x07,0x06,0x00,0x08,0x00,0xFD,0x0B,0x12,0x01,
0xF6,0x38,0x28,0xFB,0x0A,0x12,0x25,0x07,0xFD,0x14,0x1F,0xF2,0x01,0x16,0x07,0x02,
0x07,0x0D,0x06,0x0A,0xFD,0xFE,0x13,0x0D,0xF8,0x06,0x21,0x17,0x0B,0x14,0x16,0x0D,
0x04,0x0D,0x0F,0x0A,0x1B,0xF0,0x03,0x31,0x0B,0x1C,0x08,0x0C,0x2C,0x1E,0xFB,0x0B,
0x15,0x0B,0x18,0x0E,0x03,0x09,0x0E,0x0A,0x08,0x04,0x1D,0x0D,0x02,0xF4,0x00,0x10,
0xF9,0x1A,0x05,0x0F,0x1C,0x0A,0x06,0x09,0x1F,0x15,0x0F,0xFD,0x1D,0x14,0x08,0x0E,
0x04,0x0C,0x0E,0xFE,0x06,0x03,0xFF,0xFA,0xF5,0xFC,0xD7,0xD7,0xF7,0x47,0x67,0x29,
0xC2,0xBF,0xEE,0x45,0x0E,0xCB,0xCD,0xE6,0x11,0x04,0x16,0x0B,0x36,0xFC,0xE4,0xC5,
0xC6,0xDA,0xEA,0xED,0x2E,0x4A,0x2C,0x4A,0x5D,0x7A,0x43,0x25,0x08,0xFC,0xF2,0xE3,
0xA3,0xC0,0x0A,0xE5,0xD6,0x0D,0x13,0x0A,0x13,0x1A,0x08,0x24,0x1E,0xE9,0x05,0x08,
0x18,0x08,0x1F,0x26,0x23,0x2E,0x1B,0x0E,0x12,0x11,0x0E,0xFA,0xF0,0x01,0xFF,0x00,
0xF5,0x02,0x05,0x08,0xF1,0xFA,0x1E,0x10,0x03,0xF4,0xFC,0x05,0x0C,0x0B,0x04,0x0B,
0x13,0x23,0x0A,0x00,0x0A,0x0C,0x07,0xFA,0x03,0xF9,0xF9,0xFF,0xEB,0x04,0x14,0x05,
0xF9,0xED,0x04,0x19,0x15,0xF7,0xE2,0xFB,0x17,0xF3,0xD5,0x02,0x14,0x0E,0x0A,0x0D,
0x08,0x19,0x15,0xF4,0x05,0x1B,0x03,0xEB,0xF0,0xF7,0x1C,0x09,0xED,0xF3,0x16,0x19,
0xEC,0xDD,0xFC,0x17,0x09,0xF5,0xE0,0xEE,0x0B,0xFF,0xF6,0x0B,0xF7,0x06,0x09,0xEF,
0xF7,0x09,0x09,0xF1,0xEA,0x00,0x0E,0xF3,0xD8,0x0E,0x1B,0xF4,0xEE,0xEB,0x03,0xF5,
0xED,0xEA,0xF5,0xEF,0xEA,0xE3,0xAF,0x02,0x4D,0x2A,0x04,0x06,0x20,0x1C,0x0A,0x0D,
0xFE,0xF6,0xE8,0xEE,0x13,0x09,0xF4,0xF1,0xFD,0xEC,0xEB,0xFE,0x0E,0x0C,0x05,0x07,
0x14,0x08,0xF5,0xFE,0x11,0x1D,0x08,0xF8,0x06,0x19,0x05,0xF1,0xF9,0x04,0x04,0xF5,
0xFA,0x14,0x04,0xFF,0xF7,0x01,0x18,0x06,0x08,0x06,0x02,0x12,0x02,0xED,0xF5,0x0A,
0xF9,0xFB,0x21,0xF8,0xF1,0x0A,0x16,0x20,0x0B,0xFC,0x07,0x0F,0xFF,0xF2,0xF5,0xFE,
0xFD,0xF7,0xFA,0xF3,0x02,0xF9,0xED,0x08,0x01,0xF9,0xF1,0xFB,0x0E,0x07,0xF6,0xF0,
0xFA,0x0E,0xFE,0xF1,0xF9,0xF9,0xFC,0xF0,0xEE,0xF4,0xF5,0xF6,0xE9,0xF6,0x1C,0x22,
0x0D,0xF8,0xF3,0xF7,0xF8,0xFB,0x06,0x05,0xF7,0xE1,0xE5,0xED,0xF9,0xFE,0xFD,0xF7,
0xEE,0xEF,0xF1,0xFD,0x00,0x02,0xFD,0xFE,0xF9,0xF8,0xFC,0x07,0xF8,0xF7,0xF3,0xF1,
0xF4,0xE9,0xF5,0xFE,0xF8,0xF3,0xFA,0xFA,0x02,0xFA,0xFC,0xFF,0x05,0x01,0xFB,0x03,
0xFE,0xF1,0x09,0x05,0x04,0xFC,0xF3,0x06,0xFA,0x06,0xF0,0x05,0x07,0xF5,0xFC,0xFD,
0x0B,0x02,0xF9,0x05,0x02,0x00,0x02,0xFC,0xFE,0xFE,0x01,0xFD,0xFC,0xFC,0xFC,0xFE,
0x02,0xFE,0xFD,0x01,0xFC,0x01,0x03,0xFE,0xFE,0xFE,0xFD,0xF8,0xFE,0x01,0xFF,0xF9,
0xF7,0xFA,0x02,0xFD,0xFA,0x01,0xFE,0xFD,0xF8,0x02,0xFF,0xFA,0xFC,0xFA,0xFB,0xF8,
0xF9,0xFF,0xFE,0xFA,0xF6,0x01,0xFF,0xF8,0x04,0xFD,0x03,0x01,0xFE,0x02,0x04,0x00,
0xFC,0x01,0xFE,0xFB,0xF9,0xFA,0xFB,0xFC,0xF5,0xF7,0xF8,0xFA,0xF9,0xFE,0x00,0xFA,
0xFB,0xFB,0xFE,0xFE,0xFF,0xFC,0xFE,0xFD,0xF9,0xFA,0xFC,0xFC,0xFE,0xFA,0xFA,0xFB,
0xF9,0xF9,0xFE,0xFD,0xFC,0xF9,0xF9,0xFA,0xF9,0x01,0xFC,0x01,0xFF,0xFD,0xF7,0xF7,
0x02,0xF2,0xF8,0x01,0xF8,0xFE,0xF4,0xFA,0x04,0x00,0xF1,0xF6,0xFC,0xEF,0xE6,0xF6,
0x09,0xEF,0xE7,0xF6,0xFD,0xEF,0xE9,0xFC,0xFC,0xED,0xF0,0xFE,0xFD,0xF2,0xF7,0xFD,
0xFA,0xFB,0xFC,0xFA,0xF9,0xFD,0xFD,0xF8,0xF7,0xF9,0xF7,0xF6,0xFD,0x00,0xFA,0xF8,
0xF4,0xF5,0xFB,0xF9,0xFD,0x00,0xF7,0xF5,0xFE,0x00,0xFA,0xF8,0xFD,0xFF,0xFB,0xF8,
0xF7,0xFB,0xF9,0xFB,0xFC,0xFA,0xF9,0xF8,0xF9,0xFC,0xFE,0xFA,0xFB,0xFA,0xF8,0xFD,
0xF8,0xFD,0xFF,0xF9,0xFF,0xFB,0xFF,0xFE,0x02,0xFE,0xF6,0xFA,0xF8,0xFA,0xF2,0xF8,
0xFB,0xF8,0xF7,0xF8,0xFA,0xFD,0xFA,0xF7,0xFD,0xFB,0xFE,0xFF,0x00,0xFE,0xFF,0xFA,
0x02,0xFE,0xF6,0xFD,0xFD,0xFA,0xF9,0xF9,0xF4,0xFB,0xF6,0xF3,0xFA,0xFF,0xF4,0xF6,
0xF9,0xFF,0xFD,0xF4,0xFA,0xFF,0x03,0xF8,0xFF,0x01,0xFE,0xF6,0xF6,0xFA,0xFC,0xF9,
0xF5,0xF9,0xFD,0xF9,0xEF,0xFB,0xFE,0xFB,0xF8,0xFA,0xFA,0xF5,0xF8,0xFE,0xFB,0xFA,
0xFA,0xFA,0xFE,0xFD,0xFB,0xFB,0xFC,0xFF,0xF7,0xF5,0xFB,0xF7,0xF7,0xFB,0xFB,0xF2,
0xF7,0xF9,0xF5,0xF6,0xFB,0xF7,0xF7,0xF9,0xF7,0xF6,0xF7,0xF8,0xF5,0xFA,0xF8,0xFB,
0xF5,0xF6,0xF5,0xFD,0xFA,0xF1,0xF9,0xF7,0xFB,0xFD,0xFB,0xEF,0xF4,0x04,0xFD,0xEC,
0xF5,0x02,0xFD,0xF3,0xF0,0xFC,0x04,0xED,0xF0,0x00,0x04,0xF1,0xEA,0x02,0x03,0xF9,
0xED,0xFC,0x05,0xFD,0xF1,0xFB,0x01,0x00,0xF5,0xF5,0x02,0xFD,0xF9,0xF2,0x01,0x01,
0xF9,0xF7,0xFE,0x01,0xFA,0xF8,0xFC,0xFE,0xFB,0xF8,0xFB,0xFF,0xFB,0xF9,0xFA,0xFD,
0xFE,0xFA,0xFC,0xFC,0xFD,0xFC,0xFA,0xFE,0xFF,0x01,0xFA,0xFD,0xFF,0xFC,0xF8,0xFD,
0xFE,0xFB,0xF9,0xFB,0xFC,0xFA,0xFB,0xFA,0xFE,0xFC,0xFA,0xFB,0xFD,0xFE,0x02,0xF7,
0xF8,0x03,0x00,0xF5,0xF8,0xFF,0xFE,0x00,0xF6,0xFD,0xFE,0xFE,0x00,0xF8,0x00,0xFD,
0xF8,0xFE,0xFA,0xFD,0xFB,0xF8,0xFF,0xFC,0xFD,0xF9,0x02,0x01,0xF6,0xFB,0x00,0x02,
0xF6,0xFC,0xFE,0x05,0xFA,0xF3,0x09,0x04,0xF6,0xF4,0x05,0x00,0xFB,0xF9,0xF9,0x02,
0xFB,0xF8,0xFC,0x02,0xFE,0xF8,0xFD,0xFD,0xFB,0xF9,0xFE,0xFB,0xFB,0xF9,0xF8,0xFD,
0xFD,0xFD,0xF5,0xFC,0xFE,0xF9,0xFB,0xFE,0xFC,0xFD,0xFD,0xFD,0xFD,0xFC,0xFE,0xFA,
0xFC,0xFB,0xFB,0xF9,0xFF,0xFE,0xF9,0xFC,0xFB,0xFC,0xFD,0xFD,0xFC,0xFB,0x00,0x01,
0xFB,0xFE,0xFF,0xFE,0xFF,0xFE,0xFD,0xFD,0xFF,0xFF,0xFD,0xFD,0xFF,0xFF,0xFE,0x01,
0xFF,0xFF,0xFE,0xFF,0x00,0xFC,0xFF,0x03,0x01,0xF8,0x04,0x00,0xFD,0xFC,0x05,0x03,
0xFB,0xFD,0xFF,0x05,0xFA,0xFE,0xFE,0x00,0x03,0xFE,0xFB,0x00,0x05,0x01,0xF9,0xFD,
0x06,0x00,0xFA,0xFF,0x04,0xFF,0xFD,0xFE,0x00,0xFE,0x01,0x01,0xFF,0xFF,0x01,0x01,
0x03,0x00,0x02,0x03,0x03,0x04,0x02,0x04,0x04,0x05,0x02,0x03,0x02,0x02,0x00,0x01,
0x04,0x01,0x00,0x01,0x04,0x02,0xFE,0x01,0x04,0x01,0xFE,0x02,0x07,0x05,0xFE,0x01,
0x06,0x02,0x02,0x00,0x02,0x02,0x03,0x01,0xFF,0x00,0x02,0x02,0xFE,0x03,0x00,0xFF,
0x00,0x00,0x00,0x01,0x02,0x00,0x00,0x01,0x02,0x01,0x01,0xFF,0x00,0x03,0x03,0x00,
0xFF,0xFF,0x03,0x04,0x05,0x00,0xF9,0x00,0x05,0x04,0xFC,0xFE,0x03,0xFF,0xFF,0xFD,
0x03,0x03,0xFC,0xFF,0x03,0x04,0xFD,0x00,0x01,0x05,0x02,0xFC,0x03,0x03,0x06,0xFD,
0x03,0x02,0x02,0xFF,0x02,0x02,0x03,0x01,0xFD,0x05,0xFC,0x02,0xFE,0x04,0x02,0x03,
0xFA,0xFD,0x0A,0x03,0x00,0xFE,0x06,0x03,0x00,0xFE,0x08,0x0B,0x01,0xFA,0x06,0x05,
0x03,0x00,0x01,0x09,0xFF,0xFD,0xFE,0x07,0x04,0x01,0xFB,0x02,0x0D,0xFB,0xF9,0x08,
0x0D,0xFB,0xF8,0x0C,0x06,0xFA,0x00,0x09,0x05,0x00,0x01,0x02,0x05,0x06,0x04,0xFD,
0xFF,0x07,0x05,0xFE,0x00,0x05,0x03,0x00,0x04,0x03,0x02,0x01,0x03,0x01,0x03,0x03,
0x00,0x02,0x02,0x06,0x04,0x00,0x00,0x04,0x04,0x03,0xFF,0x00,0x02,0x05,0x03,0x00,
0x01,0x04,0x02,0x01,0x01,0xFF,0x03,0x02,0x05,0x02,0x02,0x04,0x03,0x03,0x03,0x03,
0x04,0x03,0x03,0x04,0x04,0x05,0x02,0x05,0x06,0x06,0x02,0x01,0x06,0x07,0x05,0x03,
0x05,0x05,0x05,0x05,0x06,0x06,0x05,0x07,0x06,0x05,0x03,0x03,0x05,0x04,0x04,0x03,
0x03,0x04,0x03,0x05,0x09,0x00,0x00,0x06,0x0A,0x03,0x00,0x07,0x09,0x03,0xFE,0x08,
0x09,0x03,0xFE,0x07,0x08,0x03,0xFE,0x04,0x09,0x03,0x00,0x02,0x06,0x03,0x04,0x04,
0x04,0x05,0x06,0x03,0x06,0x07,0x03,0x03,0x04,0x06,0x04,0x03,0x04,0x04,0x03,0x00,
0x04,0x06,0x03,0x02,0x02,0x02,0x04,0x05,0x03,0x02,0x02,0x06,0x03,0x00,0x05,0x08,
0x02,0x00,0x04,0x04,0x02,0x01,0x06,0x06,0x03,0x00,0x06,0x06,0x03,0x01,0x05,0x04,
0x03,0x02,0x05,0x04,0x01,0x01,0x03,0x04,0x00,0x01,0x02,0x04,0x01,0x00,0x02,0x02,
0x02,0x02,0x03,0xFF,0x01,0x02,0x01,0x00,0x01,0x02,0x00,0x00,0x02,0x03,0x00,0xFF,
0x01,0x02,0xFF,0xFF,0xFE,0xFF,0xFE,0xFE,0xFF,0xFB,0x00,0xFF,0x00,0xFD,0xFF,0xFE,
0xFE,0xFC,0x01,0x01,0xFD,0xFE,0x00,0x05,0xFB,0xFF,0xFE,0x01,0xFE,0xFD,0xFC,0xFD,
0xFE,0xFE,0xFE,0xFB,0xFF,0xFB,0xFF,0xFD,0xFE,0xFD,0xFD,0xFF,0xFD,0xFD,0xFD,0xFC,
0xFB,0x00,0xFD,0xFB,0xFD,0x01,0xFB,0xF8,0x00,0xFD,0xFC,0xFC,0xFF,0xFB,0xFC,0xFB,
0xFC,0x02,0xF6,0xFC,0xFF,0xFB,0xFA,0xFB,0xFF,0xFA,0xF8,0x01,0xFD,0xFA,0xFA,0xFD,
0xFF,0xF9,0xFA,0xFC,0xFD,0xFB,0xFA,0xFA,0xFD,0xFB,0xFB,0xFC,0xFB,0xFA,0xFB,0xFD,
0xFA,0xFC,0xFA,0xFC,0xFD,0xFB,0xFB,0xFD,0xF9,0xFA,0x01,0xFA,0xFA,0xFB,0xFE,0xFE,
0xF9,0xFA,0xFF,0x02,0xF8,0xF8,0xFF,0xFF,0xF8,0xF9,0xFE,0xFD,0xFB,0xFC,0xFD,0xFD,
0xFC,0xFB,0xF9,0xFB,0xFB,0xF9,0xFC,0xFD,0xFC,0xFA,0xFD,0xF9,0xFA,0xFD,0xFC,0xFA,
0xFC,0xFD,0xFA,0xFA,0xFA,0xFB,0xFC,0xFA,0xF9,0xFD,0xFB,0xF8,0xFB,0xFC,0xFB,0xF8,
0xF9,0xFC,0xFB,0xFA,0xFA,0xFB,0xFD,0xFA,0xFA,0xFC,0xFB,0xFC,0xFB,0xF9,0xFD,0xFC,
0xFA,0xFB,0xFB,0xFC,0xFB,0xFC,0xFA,0xFB,0xFB,0xFC,0xFB,0xFA,0xFB,0xFC,0xFC,0xFB,
0xFB,0xFD,0xFB,0xFA,0xFD,0xFD,0xFB,0xFB,0xFD,0xFE,0xFC,0xFA,0xFB,0xFC,0xFD,0xFB,
0xFB,0xFC,0xFC,0xFC,0xFD,0xFC,0xFE,0xFC,0xFD,0xFE,0xFB,0xFF,0xFD,0xFC,0xFC,0xFF,
0xFC,0xFA,0xFE,0x01,0xFE,0xFB,0xFD,0x01,0xFE,0xFA,0xFE,0xFF,0xFD,0xFD,0xFF,0xFF,
0xFE,0xFF,0xFF,0xFF,0xFD,0x00,0x00,0xFB,0x02,0x01,0xFD,0xFB,0x01,0xFF,0xFE,0x03,
0xFF,0xFC,0x00,0x03,0xFE,0xFC,0xFD,0x04,0xFF,0xFF,0xFE,0x00,0xFE,0xFD,0x02,0xFE,
0xFE,0xFE,0x00,0xFE,0xFC,0xFF,0x00,0xFE,0xFD,0x00,0xFF,0xFB,0x01,0x03,0xFB,0xFA,
0xFF,0x07,0x00,0xF7,0xFF,0x03,0x01,0xFC,0xFB,0x00,0x02,0x03,0xFC,0xF8,0x00,0x07,
0x01,0xFA,0xF9,0x01,0x09,0x01,0xF8,0xFD,0x05,0x05,0xFE,0xFF,0x01,0xFF,0x05,0x03,
0xFE,0xF9,0x03,0x0A,0xFD,0xFB,0x05,0x08,0xFD,0xFA,0x02,0x0C,0x01,0xFA,0x02,0x0A,
0x05,0xFE,0xFE,0x06,0x08,0x05,0x00,0xFB,0x04,0x07,0x04,0xFC,0xFE,0x07,0x09,0xFC,
0xFE,0x04,0x05,0x00,0xFF,0x03,0x04,0x01,0x00,0x04,0x00,0x02,0x03,0x02,0xFD,0x01,
0x04,0x03,0xFB,0xFD,0x08,0x00,0xFC,0x01,0x03,0x00,0xFF,0x00,0xFF,0x03,0xFD,0xFE,
0x00,0xFE,0x05,0x01,0xFC,0xFC,0x04,0x00,0xFC,0xFF,0x00,0xFF,0xFE,0x03,0xFE,0xFA,
0x01,0x05,0xFF,0xFB,0xFE,0x04,0x01,0xFC,0xFD,0x02,0x01,0xFE,0xFE,0xFE,0x01,0x00,
0xFE,0xFE,0x00,0x01,0xFE,0xFD,0xFF,0x02,0xFF,0xFE,0xFE,0x01,0x01,0xFF,0xFF,0x00,
0x01,0xFE,0xFF,0xFF,0x00,0x02,0xFF,0xFF,0x00,0x01,0x01,0xFC,0xFF,0x04,0x01,0xFC,
0xFC,0xFC,0x00,0x04,0x01,0xFE,0xFB,0xFE,0x04,0x04,0x01,0xFD,0x01,0x04,0x03,0xFE,
0xFF,0x05,0x05,0xFF,0x02,0x03,0xFE,0xFF,0x01,0x04,0x04,0xFC,0xFE,0x03,0xFF,0x01,
0x03,0x00,0x03,0x05,0xFB,0xFF,0x04,0x04,0x0A,0xFA,0xFA,0x06,0x02,0x07,0x02,0xFD,
0xFE,0x03,0x03,0x03,0xFD,0xFF,0x08,0x01,0xFE,0x01,0x03,0x01,0x03,0x04,0x00,0x01,
0x04,0x03,0xFF,0xFF,0x04,0x02,0x02,0x01,0x01,0x00,0x01,0x05,0x04,0xFF,0xFE,0x06,
0x06,0xFE,0xFF,0x01,0x05,0x01,0x00,0xFF,0x00,0xFF,0xFE,0x09,0x00,0xFE,0x04,0x02,
0xFD,0x00,0x03,0x09,0xFE,0x01,0x04,0xFE,0x02,0x06,0xFF,0xFD,0x05,0xFD,0x04,0x00,
0x02,0x01,0x01,0x03,0xFE,0x04,0x06,0x02,0xFE,0x03,0x06,0x01,0xFE,0x01,0x04,0x02,
0x02,0x00,0x05,0xFF,0x01,0x03,0x02,0x03,0x00,0x00,0x01,0x03,0x00,0x02,0x01,0x04,
0x00,0x00,0x01,0x01,0x02,0x04,0x03,0xFE,0xFF,0x04,0x04,0xFF,0xFF,0x05,0x03,0xFD,
0x00,0xFF,0x02,0xFB,0x0C,0x08,0xF4,0xF7,0xFE,0x02,0x05,0x0A,0xFF,0xF4,0xF7,0x06,
0x06,0xFF,0xFB,0x01,0xFF,0xFE,0xFE,0xFA,0xFB,0x02,0x06,0xFB,0xF8,0xFC,0x02,0xFF,
0xFE,0xFA,0xFB,0xFD,0xFE,0x00,0xFB,0xFD,0xFE,0x00,0xFF,0xFB,0xFE,0xFF,0xFE,0xFD,
0xFF,0x00,0xFC,0xFE,0xFF,0xFE,0xFD,0xFD,0xFE,0xFD,0xFD,0xFD,0xFB,0xFB,0xFC,0xFE,
0xFE,0xFB,0xFC,0xFD,0xFB,0xFB,0xFB,0xFD,0xFB,0xFB,0xFD,0xFB,0xFA,0xFC,0xFF,0xFD,
0xFC,0xFD,0xFD,0xFC,0xFD,0xFD,0xFC,0xFC,0xFD,0xFB,0xFD,0xFC,0xFD,0xFC,0xFB,0xFE,
0xFB,0xFC,0xFD,0xFB,0xFB,0xFE,0xFC,0xFB,0xFD,0x00,0xFE,0xFA,0xFC,0xFC,0xFD,0xFD,
0xFA,0xFA,0xFE,0xFD,0xFC,0xFD,0xFC,0xFB,0xFD,0xFE,0xFD,0xFB,0xFC,0xFE,0xFC,0xFD,
0xFD,0xFC,0xFD,0x00,0xFE,0xFB,0xFA,0xFC,0xFE,0x01,0xFF,0xF9,0xF8,0xFE,0x00,0xFE,
0xFB,0xFC,0xFD,0x00,0xFD,0xF9,0xFA,0xFE,0x01,0xFC,0xFB,0xF9,0xFE,0xFD,0xFD,0xFA,
0xFC,0xFD,0xF9,0xFF,0xF8,0xF8,0xFF,0x01,0xFD,0xFB,0xF7,0xFC,0x01,0xFA,0xFA,0xFE,
0xFD,0xFB,0xFA,0xFA,0xFB,0xFD,0xFE,0xFD,0xFC,0xFB,0xFB,0xFD,0xFB,0xFD,0xFE,0xFA,
0xFA,0xFE,0xFF,0xF9,0xFB,0xFB,0x01,0xFC,0xF8,0xFA,0xFE,0xFB,0xFA,0xFF,0xF9,0xFD,
0xFD,0xFA,0xFB,0xFE,0xFE,0xFB,0xFC,0xFC,0xFD,0xFC,0xFF,0xFE,0xFC,0xFA,0xF9,0xFF,
0x00,0x00,0xFA,0xF9,0xFE,0x00,0xFE,0xFB,0xFE,0x00,0xFF,0xFD,0xFB,0xFC,0x00,0x01,
0xFE,0xFD,0xFD,0xFD,0xFE,0xFE,0xFF,0xFE,0xFD,0xFF,0xFF,0xFD,0xFC,0x00,0x00,0xFE,
0xFE,0xFE,0xFF,0xFD,0xFF,0x00,0x00,0xFD,0xFE,0x00,0x00,0xFF,0xFF,0x00,0xFF,0xFE,
0x00,0x02,0x00,0xFE,0x01,0xFF,0xFF,0x00,0x00,0xFF,0xFE,0x00,0xFF,0x00,0x00,0xFE,
0xFF,0x02,0x01,0xFF,0xFC,0x01,0x01,0x02,0xFD,0x03,0xFC,0x02,0x03,0xFB,0x05,0x00,
0xFF,0x02,0x02,0xFB,0x05,0xFF,0xFB,0x04,0x02,0xFE,0xFF,0x01,0x01,0xFD,0xFF,0x04,
0x00,0xFD,0x01,0x00,0xFE,0x01,0x06,0xF9,0xFD,0x08,0xFA,0x01,0x00,0xFD,0x01,0x03,
0xFB,0xFB,0x02,0x02,0xFF,0xFD,0xFE,0xFE,0xFF,0x02,0xFF,0xFF,0xFF,0xFE,0x02,0x00,
0x05,0xFD,0xF3,0x0B,0x12,0xF4,0xF1,0x02,0x16,0x06,0xEF,0xF7,0x0F,0x0E,0xF8,0xFB,
0x06,0x04,0x00,0x02,0x03,0x03,0x00,0xFE,0x04,0x08,0x02,0xFF,0xFE,0x05,0x0A,0x01,
0xFC,0x04,0x09,0x02,0x00,0x04,0x04,0x05,0x01,0x04,0x06,0x05,0x02,0x03,0x07,0x05,
0x05,0x03,0x02,0x04,0x08,0x05,0x02,0x02,0x09,0x05,0x02,0x04,0x05,0x05,0x04,0x01,
0x04,0x09,0x04,0x02,0x03,0x06,0x06,0x02,0x04,0x06,0x04,0x06,0x05,0x04,0x05,0x03,
0x08,0x08,0x03,0x04,0x03,0x0A,0x05,0x06,0x05,0x03,0x05,0x07,0x07,0x04,0x03,0x03,
0x06,0x05,0x07,0xFF,0x04,0x04,0x06,0x04,0x04,0x02,0x02,0x03,0x06,0x06,0x04,0x02,
0x00,0x07,0x05,0x05,0x00,0x01,0x02,0x05,0x05,0x01,0x00,0x01,0x03,0x08,0x03,0xFF,
0x03,0x05,0x04,0x01,0x03,0x04,0x02,0x00,0x05,0x04,0x03,0x00,0x02,0x06,0x04,0x02,
0x01,0x03,0x03,0x04,0x03,0x01,0x03,0x04,0x05,0x03,0x02,0x04,0x04,0x02,0x04,0x04,
0x04,0x02,0x03,0x07,0x04,0x02,0x03,0x06,0x02,0x05,0x03,0x05,0x02,0x04,0x09,0x00,
0x05,0x04,0x01,0x06,0x04,0x04,0x03,0xFF,0x02,0x06,0x05,0x00,0x01,0x04,0x02,0x02,
0x01,0x02,0x03,0x02,0x00,0x01,0x03,0x00,0x00,0x01,0x01,0x02,0x01,0x01,0x02,0x02,
0xFF,0x02,0x01,0x00,0xFF,0x01,0x05,0x01,0xFF,0xFE,0x03,0x01,0xFF,0x00,0x01,0x01,
0xFF,0x00,0x00,0x01,0x00,0x01,0x00,0x00,0x00,0x00,0x03,0xFF,0x00,0x02,0xFF,0x02,
0x01,0x00,0x02,0x01,0x00,0x00,0x04,0xFE,0x00,0x03,0xFC,0x06,0x02,0xFE,0x01,0x03,
0x00,0x03,0x01,0xFE,0x02,0x01,0x02,0x02,0x01,0x00,0x01,0x02,0x00,0xFF,0x06,0x03,
0x01,0x00,0x01,0x02,0x01,0x03,0x03,0x01,0xFE,0x02,0x04,0x01,0xFE,0x01,0x01,0x02,
0x00,0x00,0x02,0xFF,0x01,0x01,0xFE,0xFF,0x00,0x00,0x00,0xFF,0x00,0xFE,0x00,0xFD,
0x00,0x02,0xFB,0xFD,0x00,0x00,0xFD,0xFE,0xFD,0xFE,0xFD,0xFF,0xFF,0xFD,0xFB,0xFE,
0x00,0xFD,0xFC,0xFD,0xFE,0xFD,0xFE,0xFE,0xFE,0xFD,0xFE,0xFF,0xFE,0xFD,0xFE,0xFE,
0xFE,0xFC,0xFE,0xFF,0xFE,0xFB,0x00,0xFD,0xFF,0xFE,0xFB,0x00,0xFD,0xFF,0xFC,0xFF,
0xFE,0xFE,0xFC,0x00,0x00,0xFE,0xFE,0xFD,0x00,0x00,0xFF,0xFE,0xFD,0xFE,0x00,0x00,
0x00,0xFD,0xFE,0x00,0x00,0xFF,0xFE,0xFF,0x00,0xFF,0xFF,0xFF,0xFF,0xFF,0xFF,0x00,
0xFF,0xFF,0xFE,0xFF,0xFF,0x01,0xFF,0xFF,0xFF,0xFF,0x00,0xFF,0xFF,0x00,0x00,0x00,
0xFF,0x00,0x00,0x00,0xFF,0x00,0x00,0x00,0xFF,0xFF,0xFF,0x00,0xFF,0xFE,0xFF,0xFF,
0xFF,0xFF,0xFF,0xFF,0xFF,0xFF,0xFF,0xFE,0xFE,0x00,0xFF,0xFE,0xFF,0xFD,0xFF,0xFF,
0xFF,0xFF,0xFF,0xFD,0x00,0xFF,0xFE,0xFF,0xFD,0xFF,0xFE,0x00,0xFC,0x00,0xFF,0x00,
0xFD,0xFC,0x00,0x00,0x00,0xFD,0x00,0xFD,0x01,0x01,0xFE,0xFE,0xFF,0x01,0xFF,0x00,
0x01,0xFF,0x00,0xFF,0x01,0xFF,0xFF,0xFF,0x00,0x00,0xFF,0x00,0xFE,0x00,0x00,0x00,
0xFE,0xFE,0xFE,0x00,0xFF,0xFE,0xFD,0xFE,0xFE,0xFF,0xFF,0xFE,0xFE,0xFE,0xFF,0xFE,
0x00,0xFD,0xFE,0x01,0xFD,0x00,0xFE,0xFE,0xFE,0xFF,0x01,0xFD,0x02,0xFA,0xFE,0x02,
0xFF,0xFE,0xFF,0xFE,0xFE,0x02,0xFF,0xFD,0xFE,0xFE,0xFF,0xFF,0xFE,0xFE,0xFB,0xFF,
0xFE,0xFF,0xFC,0xFD,0xFE,0xFF,0xFE,0xFE,0xFE,0xFC,0xFD,0xFF,0xFF,0xFD,0xFD,0xFD,
0x00,0xFE,0xFD,0xFE,0xFC,0xFE,0xFE,0xFD,0xFD,0xFC,0xFB,0xFE,0xFF,0xFE,0xFD,0xF9,
0xFE,0xFF,0x00,0xFB,0xFC,0xFF,0xFE,0xFC,0xFC,0xFD,0xFC,0xFD,0xFC,0xFF,0xFC,0xFC,
0xFC,0xFE,0xFD,0xFC,0xFB,0xFE,0xFC,0xFD,0xFD,0xFD,0xFD,0xFB,0xFE,0xFC,0xFD,0xFB,
0xFE,0xFC,0xFD,0xFC,0xFD,0xFD,0xFE,0xFD,0xFE,0xFE,0xFD,0xFE,0xFD,0xFE,0xFC,0xFD,
0xFD,0xFE,0xFC,0xFE,0xFC,0xFE,0xFD,0xFD,0xFA,0x03,0xFE,0xFA,0xFD,0xFF,0x03,0xF8,
0xFE,0xFE,0x00,0xFC,0xFE,0xFF,0xFC,0xFB,0xFE,0xFF,0xFC,0xFA,0xFC,0x00,0xFE,0xFB,
0xF9,0xFF,0xFF,0xFC,0xFA,0xFD,0xFD,0xFD,0xFB,0xFD,0xFD,0xFC,0xFC,0xFE,0xFE,0xFC,
0xFB,0xFD,0x00,0xFD,0xFC,0xFC,0xFE,0xFD,0xFD,0xFD,0xFE,0xFD,0xFD,0xFE,0xFE,0xFD,
0xFC,0xFD,0xFE,0xFD,0xFC,0xFC,0xFE,0xFC,0xFC,0xFC,0xFC,0xFC,0xFB,0xFB,0xFC,0xFC,
0xFA,0xFB,0xFB,0xFB,0xFA,0xFB,0xFC,0xFB,0xFA,0xFB,0xFB,0xFB,0xFB,0xFB,0xFB,0xFB,
0xFB,0xFA,0xFC,0xFA,0xFB,0xFB,0xF9,0xFB,0xFA,0xFB,0xFB,0xFA,0xFA,0xFB,0xFB,0xFA,
0xFA,0xFA,0xFB,0xFA,0xFA,0xFB,0xFB,0xF9,0xF9,0xFB,0xFB,0xF8,0xFA,0xFA,0xFB,0xFA,
0xF9,0xFD,0xFA,0xFA,0xFA,0xFB,0xFD,0xF9,0xFC,0xF9,0xFC,0xFB,0xFA,0xFB,0xF9,0xFD,
0xFA,0xFC,0xFB,0xFB,0xFD,0xFA,0xFD,0xFC,0xFB,0xFB,0xFB,0xFD,0xFB,0xFB,0xFB,0xFC,
0xFC,0xFB,0xFB,0xFB,0xFC,0xFC,0xFC,0xFC,0xFC,0xFB,0xFC,0xFC,0xFC,0xFC,0xFB,0xFB,
0xFB,0xFC,0xFB,0xFB,0xFA,0xFB,0xFC,0xFC,0xFB,0xFB,0xFC,0xFC,0xFC,0xFB,0xFC,0xFB,
0xFC,0xFC,0xFA,0xFC,0xFC,0xFB,0xFC,0xFB,0xFA,0xFD,0xFC,0xFB,0xFB,0xFC,0xFE,0xFC,
0xFC,0xFC,0xFD,0xFD,0xFC,0xFC,0xFC,0xFD,0xFC,0xFD,0xFC,0xFD,0xFC,0xFD,0xFC,0xFC,
0xFC,0xFC,0xFC,0xFC,0xFD,0xFC,0xFC,0xFC,0xFC,0xFC,0xFC,0xFC,0xFD,0xFC,0xFD,0xFD,
0xFD,0xFE,0xFD,0xFE,0xFD,0xFE,0xFE,0xFE,0xFE,0xFE,0xFE,0xFE,0xFF,0xFE,0xFF,0xFF,
0xFE,0x00,0xFF,0x00,0xFF,0x00,0xFF,0x00,0x00,0xFF,0x01,0x00,0x01,0xFE,0x01,0xFF,
0x02,0xFF,0x00,0xFE,0x00,0x02,0xFC,0x03,0xFD,0x01,0xFF,0x01,0x00,0x00,0x00,0xFD,
0x01,0x00,0x00,0xFE,0x01,0xFE,0x00,0xFE,0x00,0x00,0xFF,0x01,0x00,0x01,0x02,0x00,
0x01,0x01,0x00,0x01,0x00,0x02,0x02,0x01,0x01,0x01,0x01,0x01,0x01,0x01,0x01,0x01,
0x01,0x02,0x01,0x01,0x00,0x01,0x01,0x00,0x01,0xFF,0x01,0xFF,0x00,0x00,0x01,0x01,
0x00,0x01,0x01,0x01,0x00,0x00,0x01,0x00,0x01,0x00,0x01,0xFF,0x00,0x02,0x00,0x03,
0xFC,0x01,0x03,0x01,0x01,0x01,0x04,0x00,0x04,0x03,0x01,0x03,0x03,0x02,0x04,0x03,
0x05,0x02,0x04,0x05,0x02,0x03,0x02,0x04,0x03,0x04,0x02,0x02,0x03,0x02,0x02,0x02,
0x03,0x02,0x02,0x02,0x02,0x02,0x02,0x02,0x01,0x02,0x02,0x01,0x02,0x02,0x02,0x02,
0x01,0x01,0x01,0x01,0x01,0x01,0x01,0x01,0x02,0x02,0x02,0x02,0x01,0x02,0x02,0x02,
0x03,0x02,0x03,0x03,0x03,0x03,0x03,0x03,0x03,0x04,0x03,0x03,0x03,0x03,0x04,0x03,
0x04,0x02,0x03,0x02,0x03,0x03,0x03,0x03,0x01,0x04,0x04,0x02,0x02,0x03,0x03,0x02,
0x02,0x01,0x01,0x01,0x01,0x02,0x03,0x01,0x02,0x04,0x02,0x03,0x02,0x02,0x03,0x04,
0x02,0x02,0x03,0x03,0x04,0x01,0x03,0x02,0x03,0x03,0x02,0x02,0x01,0x02,0x01,0x02,
0x01,0x01,0x01,0x01,0x01,0x01,0xFF,0x02,0xFF,0xFF,0x02,0x01,0x00,0x00,0x01,0xFF,
0x01,0xFF,0x00,0x00,0xFF,0x00,0xFF,0x00,0x00,0x00,0x00,0x00,0x00,0x00,0xFF,0x00,
0xFF,0x01,0x01,0xFF,0x00,0x00,0x00,0x00,0x01,0xFF,0x00,0x00,0x00,0xFF,0xFF,0x00,
0x00,0x00,0xFF,0xFF,0xFF,0xFF,0xFF,0xFF,0xFF,0xFF,0xFF,0xFE,0xFE,0xFF,0xFE,0xFF,
0xFE,0xFF,0xFF,0xFF,0xFF,0xFF,0xFE,0xFE,0xFF,0xFF,0xFF,0xFF,0x00,0xFF,0x00,0x00,
0x00,0x01,0x00,0x01,0x01,0x01,0x01,0x01,0x02,0x01,0x02,0x01,0x02,0x01,0x01,0x02,
0x01,0x01,0x01,0x01,0x00,0x02,0x01,0x01,0x00,0x01,0x02,0x01,0x01,0x01,0x01,0x01,
0x01,0x01,0x01,0x00,0x01,0x01,0x01,0x01,0x00,0x00,0x01,0x01,0x01,0x01,0x01,0x02,
0x02,0x02,0x02,0x02,0x01,0x02,0x02,0x02,0x02,0x02,0x02,0x03,0x03,0x02,0x03,0x03,
0x03,0x03,0x03,0x03,0x03,0x03,0x03,0x02,0x04,0x02,0x03,0x03,0x03,0x02,0x02,0x02,
0x03,0x04,0x02,0x04,0x02,0x04,0x03,0x03,0x03,0x03,0x04,0x02,0x04,0x04,0x03,0x03,
0x03,0x02,0x03,0x03,0x02,0x03,0x03,0x03,0x03,0x03,0x03,0x03,0x04,0x04,0x03,0x03,
0x03,0x04,0x04,0x04,0x04,0x04,0x04,0x04,0x04,0x04,0x03,0x04,0x03,0x04,0x03,0x03,
0x04,0x03,0x03,0x04,0x03,0x03,0x03,0x03,0x03,0x03,0x03,0x03,0x03,0x03,0x03,0x04,
0x02,0x05,0x05,0x01,0x05,0x03,0x03,0x05,0x03,0x04,0x03,0x05,0x04,0x06,0x05,0x04,
0x06,0x05,0x06,0x06,0x06,0x05,0x06,0x06,0x06,0x07,0x06,0x06,0x06,0x05,0x05,0x05,
0x05,0x05,0x05,0x05,0x05,0x05,0x05,0x05,0x05,0x05,0x05,0x05,0x05,0x05,0x06,0x05,
0x06,0x06,0x06,0x06,0x06,0x06,0x06,0x06,0x06,0x06,0x06,0x06,0x06,0x07,0x07,0x06,
0x06,0x07,0x07,0x06,0x07,0x07,0x06,0x07,0x06,0x06,0x06,0x06,0x06,0x06,0x05,0x06,
0x06,0x05,0x06,0x06,0x05,0x05,0x05,0x05,0x05,0x05,0x05,0x05,0x05,0x05,0x05,0x05,
0x04,0x05,0x05,0x05,0x05,0x05,0x05,0x05,0x06,0x05,0x04,0x04,0x05,0x03,0x04,0x04,
0x04,0x04,0x03,0x04,0x03,0x04,0x03,0x03,0x03,0x03,0x03,0x03,0x01,0x02,0x04,0x02,
0x01,0x00,0x01,0x02,0x03,0x01,0x00,0x01,0x01,0x02,0x02,0x01,0x01,0x01,0x01,0x01,
0x02,0x02,0x01,0x01,0x00,*/};

