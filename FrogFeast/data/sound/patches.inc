#include "wavedata.inc"

const char SplashNoise[] PROGMEM = {
0,PC_NOISE_PARAMS,3,
0,PC_ENV_VOL,0x33,
1,PC_ENV_SPEED,-17,
1,PC_NOISE_PARAMS,4, 
1,PC_ENV_SPEED,-11,
1,PC_NOISE_PARAMS,1,
5,PATCH_END
};

const char Tongue1[] PROGMEM ={
 	0,PC_WAVE,2,
	0,PC_ENV_VOL,120,
	0,PC_ENV_SPEED,-4,
	0,PC_PITCH,71,
	1,PC_PITCH,73,
	2,PC_PITCH,76,
	1,PC_PITCH,78,
	2,PC_PITCH,80,
	1,PC_PITCH,82,
	0,PC_ENV_SPEED,-30,
	4,PC_NOTE_CUT,0,
	0,PATCH_END
};

const char Tongue2[] PROGMEM ={
 	0,PC_WAVE,2,
	0,PC_ENV_VOL,120,
	//0,PC_ENV_SPEED,-6,
	0,PC_PITCH,70,
	1,PC_PITCH,72,
	2,PC_PITCH,75,
	1,PC_PITCH,78,
	2,PC_PITCH,81,
	1,PC_PITCH,82,
	1,PC_PITCH,83,
	0,PC_ENV_SPEED,-30,
	3,PC_NOTE_CUT,0,
	0,PATCH_END
};

const char Grab1[] PROGMEM ={
 	0,PC_WAVE,2,
	0,PC_ENV_VOL,120,
	0,PC_ENV_SPEED,-2,
	0,PC_PITCH,85,
	1,PC_PITCH,87,
	1,PC_PITCH,89,
	1,PC_PITCH,92,
	1,PC_PITCH,94,
	1,PC_PITCH,96,
	1,PC_PITCH,85,
	1,PC_PITCH,87,
	1,PC_PITCH,89,
	1,PC_PITCH,92,
	1,PC_PITCH,94,
	1,PC_PITCH,96,
	1,PC_PITCH,99,
	0,PC_ENV_SPEED,-30,
	4,PC_NOTE_CUT,0,
	0,PATCH_END
};


const char Smash[] PROGMEM ={
	0,PC_ENV_SPEED,-4,
	0,PC_ENV_VOL,140,
	0,PC_WAVE,4,
	//0,PC_SLIDE_SPEED,18,
	//0,PC_SLIDE,-18,
	0,PC_TREMOLO_RATE,128,
	0,PC_TREMOLO_LEVEL,128,


	0,PC_PITCH,49,
	1,PC_PITCH,48,
	1,PC_PITCH,47,
	1,PC_PITCH,46,
	1,PC_PITCH,45,
	1,PC_PITCH,44,
	1,PC_PITCH,43,
	1,PC_PITCH,42,

	1,PC_PITCH,60,
	1,PC_PITCH,58,
	1,PC_PITCH,56,
	1,PC_PITCH,54,
	1,PC_PITCH,52,
	1,PC_PITCH,50,
	1,PC_PITCH,48,
	1,PC_PITCH,46,
	1,PC_PITCH,44,
	1,PC_PITCH,43,
	1,PC_PITCH,42,
	1,PC_PITCH,40,
	1,PC_PITCH,38,
	1,PC_PITCH,36,

	1,PC_PITCH,33,
	1,PC_PITCH,31,
	1,PC_PITCH,30,
	1,PC_PITCH,27,
	1,PC_PITCH,25,
	1,PC_PITCH,23,
	1,PC_PITCH,21,
	1,PC_PITCH,19,
	1,PC_PITCH,17,
	1,PC_PITCH,15,
8,PC_NOTE_CUT,0,
	0,PATCH_END
};


const char Jump1[] PROGMEM ={
 	0,PC_WAVE,1,//5
	0,PC_ENV_VOL,23,
	0,PC_TREMOLO_RATE,127,
	0,PC_TREMOLO_LEVEL,173,
	0,PC_ENV_SPEED,7,
	0,PC_PITCH,69,
	5,PC_ENV_SPEED,0,
	2,PC_PITCH,68,
	4,PC_PITCH,70,
	0,PC_TREMOLO_RATE,131,
	0,PC_TREMOLO_LEVEL,199,
	2,PC_PITCH,71,
	2,PC_PITCH,72,
	2,PC_PITCH,73,
	2,PC_PITCH,74,
	2,PC_PITCH,75,
	0,PC_ENV_SPEED,-15,
	2,PC_PITCH,76,
	2,PC_PITCH,78,
	2,PC_PITCH,79,
	2,PC_PITCH,80,
	2,PC_PITCH,81,
	0,PC_TREMOLO_RATE,141,
	0,PC_TREMOLO_LEVEL,233,
	8,PC_NOTE_CUT,0,
	0,PATCH_END


/*smb3 shell click
 	0,PC_WAVE,2,
	0,PC_ENV_VOL,140,
	0,PC_PITCH,72,
	6,PC_PITCH,77,
	0,PC_ENV_SPEED,-15,
	5,PC_NOTE_CUT,0,
	0,PATCH_END
*/
/*
	0,PC_WAVE,1,//5
	0,PC_ENV_VOL,80,
	0,PC_PITCH,69,
	3,PC_PITCH,68,//7 old timing
	2,PC_PITCH,70,//4
	1,PC_PITCH,71,//2
	1,PC_PITCH,72,//2...and onward
	1,PC_PITCH,73,
	1,PC_PITCH,74,
	1,PC_PITCH,75,
	1,PC_PITCH,76,
	0,PC_ENV_VOL,-30,//not original
	1,PC_PITCH,78,
	1,PC_PITCH,79,
	1,PC_PITCH,80,
	1,PC_PITCH,81,
	0,PC_ENV_VOL,-30,	
	8,PC_NOTE_CUT,0,
	0,PATCH_END
*/
};


const char Jump2[] PROGMEM ={

 	0,PC_WAVE,2,
	0,PC_ENV_VOL,140,
	0,PC_PITCH,72,
	6,PC_PITCH,77,
	0,PC_ENV_SPEED,-15,
	5,PC_NOTE_CUT,0,
	0,PATCH_END

};


const char PauseFx[] PROGMEM ={
 	0,PC_WAVE,2,
	0,PC_ENV_VOL,128,
	0,PC_PITCH,88,
	6,PC_PITCH,84,
	6,PC_PITCH,88,
	6,PC_PITCH,84,
	0,PC_ENV_SPEED,-10,
	13,PC_NOTE_CUT,0,
	0,PATCH_END
};


const char Stomp[] PROGMEM ={
  	0,PC_WAVE,3,
	0,PC_ENV_VOL,138,
	0,PC_TREMOLO_RATE,128,
	0,PC_TREMOLO_LEVEL,128,
	0,PC_PITCH,61,
	1,PC_PITCH,60,
	1,PC_ENV_VOL,0,
	1,PC_ENV_VOL,128,
	1,PC_PITCH,64,
	2,PC_ENV_VOL,0,
	1,PC_ENV_VOL,128,

	1,PC_PITCH,66,
	1,PC_PITCH,65,
	1,PC_ENV_VOL,0,
	1,PC_ENV_VOL,128,

	1,PC_PITCH,68,
	1,PC_PITCH,67,
	3,PC_ENV_VOL,0,

	//1,PC_PITCH,69,
	//1,PC_ENV_VOL,0,
	//1,PC_ENV_VOL,96,
/*
	0,PC_ENV_SPEED,-4,
	8,PC_ENV_VOL,140,//15,PC_ENV_VOL,128,
	0,PC_WAVE,4,
	//0,PC_SLIDE_SPEED,18,
	//0,PC_SLIDE,-18,

//original, now spin and actual stomp sound are separate
	0,PC_PITCH,51,
	2,PC_PITCH,49,
	2,PC_PITCH,47,
	2,PC_PITCH,45,
	2,PC_PITCH,43,
	2,PC_PITCH,41,
	2,PC_PITCH,39,
	3,PC_PITCH,37,
	3,PC_PITCH,35,
	3,PC_PITCH,33,
	3,PC_PITCH,31,
	4,PC_PITCH,29,
	4,PC_PITCH,27,
	4,PC_PITCH,25,
	5,PC_PITCH,23,
	5,PC_PITCH,21,

//new//////////////////////////

	1,PC_PITCH,49,
	1,PC_PITCH,48,
	1,PC_PITCH,47,
	1,PC_PITCH,46,
	1,PC_PITCH,45,
	1,PC_PITCH,44,
	1,PC_PITCH,43,
	1,PC_PITCH,42,

	1,PC_PITCH,60,
	1,PC_PITCH,58,
	1,PC_PITCH,56,
	1,PC_PITCH,54,
	1,PC_PITCH,52,
	1,PC_PITCH,50,
	1,PC_PITCH,48,
	1,PC_PITCH,46,
	1,PC_PITCH,44,
	1,PC_PITCH,43,
	1,PC_PITCH,42,
	1,PC_PITCH,40,
	1,PC_PITCH,38,
	1,PC_PITCH,36,

	1,PC_PITCH,33,
	1,PC_PITCH,31,
	1,PC_PITCH,30,
	1,PC_PITCH,27,
	1,PC_PITCH,25,
	1,PC_PITCH,23,
	1,PC_PITCH,21,
	1,PC_PITCH,19,
	1,PC_PITCH,17,
	1,PC_PITCH,15,
*/




	//8,PC_NOTE_CUT,0,
	0,PC_NOTE_CUT,0,
	0,PATCH_END
};

const char TitleInstrument0[] PROGMEM ={
0,PC_WAVE,2,
0,PC_ENV_VOL,78,
0,PC_TREMOLO_RATE,199,
0,PC_TREMOLO_LEVEL,211,
//0,PC_ENV_SPEED,2,
//7,PC_ENV_SPEED,1,
//1,PC_ENV_SPEED,0,
0,PC_ENV_SPEED,8,
1,PC_ENV_SPEED,-2,
0,PC_NOTE_HOLD,0,
0,PC_ENV_SPEED,-4,
1,PC_ENV_SPEED,-8,
2,PC_ENV_SPEED,-10,
//0,PC_NOTE_HOLD,0,
16,PC_NOTE_CUT,0,
0,PATCH_END
  };

const char TitleInstrument1[] PROGMEM ={
0,PC_WAVE,0,
0,PC_ENV_VOL,31,
0,PC_TREMOLO_RATE,206,
0,PC_TREMOLO_LEVEL,204,
//0,PC_ENV_SPEED,2,
1,PC_ENV_SPEED,7,
1,PC_ENV_SPEED,14,
1,PC_ENV_SPEED,3,
1,PC_ENV_SPEED,-10,
4,PC_ENV_SPEED,-15,
15,PC_NOTE_CUT,0,
0,PATCH_END

};


const char TitleInstrument2[] PROGMEM ={
0,PC_WAVE,1,//5
0,PC_ENV_VOL,100,
0,PC_TREMOLO_RATE,121,
0,PC_TREMOLO_LEVEL,168,
//0,PC_ENV_SPEED,2,
//7,PC_ENV_SPEED,1,
//1,PC_ENV_SPEED,0,
0,PC_ENV_SPEED,-10,
4,PC_ENV_SPEED,-15,
//0,PC_NOTE_HOLD,0,
5,PATCH_END
};

const char TitleInstrument3[] PROGMEM ={
0,PC_WAVE,3,
0,PC_ENV_VOL,81,
0,PC_TREMOLO_RATE,100,
0,PC_TREMOLO_LEVEL,211,
//0,PC_ENV_SPEED,2,
//7,PC_ENV_SPEED,1,
//1,PC_ENV_SPEED,0,
0,PC_ENV_SPEED,-10,
4,PC_ENV_SPEED,-20,
//0,PC_NOTE_HOLD,0,
11,PATCH_END
};


const char TitleDrum0[] PROGMEM ={
  	0,PC_NOISE_PARAMS,11,
  	0,PC_ENV_VOL,60,
  	0,PC_ENV_SPEED,-20, 
  	4,PC_NOTE_CUT,0,
  	0,PATCH_END
  }; 
const char TitleDrum1[] PROGMEM ={
  	0,PC_NOISE_PARAMS,11,
  	0,PC_ENV_VOL,60,
  	0,PC_ENV_SPEED,-20, 
  	4,PC_NOTE_CUT,0,
  	0,PATCH_END
  };


const char TitleDrum2[] PROGMEM ={
  	0,PC_NOISE_PARAMS,11,
  	0,PC_ENV_VOL,60,
  	0,PC_ENV_SPEED,-20, 
  	4,PC_NOTE_CUT,0,
  	0,PATCH_END
};


const char TitleDrum3[] PROGMEM ={
  	0,PC_NOISE_PARAMS,11,
  	0,PC_ENV_VOL,40,
  	0,PC_ENV_SPEED,-20, 
  	4,PC_NOTE_CUT,0,
  	0,PATCH_END
};


const char StageInstrument0[] PROGMEM ={
0,PC_WAVE,2,
0,PC_ENV_VOL,78,
0,PC_TREMOLO_RATE,199,
0,PC_TREMOLO_LEVEL,211,
//0,PC_ENV_SPEED,2,
//7,PC_ENV_SPEED,1,
//1,PC_ENV_SPEED,0,
0,PC_ENV_SPEED,8,
1,PC_ENV_SPEED,-2,
0,PC_NOTE_HOLD,0,
0,PC_ENV_SPEED,-4,
1,PC_ENV_SPEED,-8,
2,PC_ENV_SPEED,-10,
//0,PC_NOTE_HOLD,0,
16,PC_NOTE_CUT,0,
0,PATCH_END
  };

const char StageInstrument1[] PROGMEM ={
0,PC_WAVE,0,
0,PC_ENV_VOL,31,
0,PC_TREMOLO_RATE,206,
0,PC_TREMOLO_LEVEL,204,
//0,PC_ENV_SPEED,2,
1,PC_ENV_SPEED,7,
1,PC_ENV_SPEED,14,
1,PC_ENV_SPEED,3,
1,PC_ENV_SPEED,-10,
4,PC_ENV_SPEED,-15,
15,PC_NOTE_CUT,0,
0,PATCH_END
 };


const char StageInstrument2[] PROGMEM ={
0,PC_WAVE,1,//5
0,PC_ENV_VOL,100,
0,PC_TREMOLO_RATE,121,
0,PC_TREMOLO_LEVEL,168,
//0,PC_ENV_SPEED,2,
//7,PC_ENV_SPEED,1,
//1,PC_ENV_SPEED,0,
0,PC_ENV_SPEED,-10,
4,PC_ENV_SPEED,-15,
//0,PC_NOTE_HOLD,0,
5,PATCH_END
};

const char StageInstrument3[] PROGMEM ={
0,PC_WAVE,1,//5
0,PC_ENV_VOL,100,
0,PC_TREMOLO_RATE,121,
0,PC_TREMOLO_LEVEL,168,
//0,PC_ENV_SPEED,2,
//7,PC_ENV_SPEED,1,
//1,PC_ENV_SPEED,0,
0,PC_ENV_SPEED,-10,
4,PC_ENV_SPEED,-15,
//0,PC_NOTE_HOLD,0,
5,PATCH_END
};


const char StageDrum0[] PROGMEM ={
  	0,PC_NOISE_PARAMS,11,
  	0,PC_ENV_VOL,60,
  	0,PC_ENV_SPEED,-20, 
  	4,PC_NOTE_CUT,0,
  	0,PATCH_END
};


const char StageDrum1[] PROGMEM ={
  	0,PC_NOISE_PARAMS,11,
  	0,PC_ENV_VOL,40,
  	0,PC_ENV_SPEED,-20, 
  	4,PC_NOTE_CUT,0,
  	0,PATCH_END
};
 
const char StageDrum2[] PROGMEM ={
  	0,PC_NOISE_PARAMS,11,
  	0,PC_ENV_VOL,40,
  	0,PC_ENV_SPEED,-20, 
  	4,PC_NOTE_CUT,0,
  	0,PATCH_END
  };


const char StageDrum3[] PROGMEM ={
  	0,PC_NOISE_PARAMS,11,
  	0,PC_ENV_VOL,40,
  	0,PC_ENV_SPEED,-20, 
  	4,PC_NOTE_CUT,0,
  	0,PATCH_END
};





const struct PatchStruct patches[] PROGMEM = {
{2,RibbitWave,NULL,sizeof(RibbitWave)-1,sizeof(RibbitWave)-1},
{1,NULL,SplashNoise,0,0,},//{2,SplashWave,NULL,sizeof(SplashWave)-1,sizeof(SplashWave)-1},
{0,NULL,Tongue1,0,0},
{0,NULL,Tongue2,0,0},
{0,NULL,Grab1,0,0},
{0,NULL,Smash,0,0},
{0,NULL,Jump1,0,0},
{0,NULL,Jump2,0,0},
{0,NULL,PauseFx,0,0},
{0,NULL,Stomp,0,0},

{0,NULL,TitleInstrument0,0,0},
{0,NULL,TitleInstrument1,0,0},
{0,NULL,TitleInstrument2,0,0},
{0,NULL,TitleInstrument3,0,0},
{0,NULL,TitleDrum0,0,0},
{0,NULL,TitleDrum1,0,0},
{0,NULL,TitleDrum2,0,0},
{0,NULL,TitleDrum3,0,0},

{0,NULL,StageInstrument0,0,0},
{0,NULL,StageInstrument1,0,0},
{0,NULL,StageInstrument2,0,0},
{0,NULL,StageInstrument3,0,0},
{0,NULL,StageDrum0,0,0},
{0,NULL,StageDrum1,0,0},
{0,NULL,StageDrum2,0,0},
{0,NULL,StageDrum3,0,0},





};

