const uint8_t map_data[] PROGMEM = {
//up to 7 tunnels per level
//(postion: linear map units, type:h or v 0 or 1 , enemy1+enemy2+enemy3 0b11000+0b001100+0b000011) - note only level 1 has tunnels longer than 3, this is down by overlapping tunnels and checking the special case
//up to 5 rocks per level
//(position: linear map units - 255 = no rock)

#define MAP_STORED_SIZE	26
//Level 1
25	,1	,0b000000,
13	,1	,0b000100,//overlap previous tunnel, drawing routine checks for this case
20	,0	,0b000001,
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27,93,110,255,255,//rocks

//Level 2
32,		0,	0b001000,//Fygar
49,		0,	0b000100,//Pooka
73,		1,	0b000100,//Pooka
89,		0,	0b000100,//Pooka
116,	0,	0b001000,//Fygar
255,0,0,
255,0,0,

14,31,82,99,255,

//Level 3
37,		0,	0b000100,
88,		1,	0b000100,
20,		0,	0b001000,
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14,57,87,106,255,

//Level 4
14,	0,	0b000101,//the original version had this tunnel with 2 Pookas overlapping in the middle spot, changed
18,	1,	0b000100,
69,	1,	0b001000,
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20,37,45,74,106,

//Level 5
25,	0,	0b000100,
19,	1,	0b010000,
56,	1,	0b001000,
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18,34,50,100,116,

//Level 6
14,	0,	0b000100,
38,	1,	0b001000,
80,	0,	0b001000,
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18,57,89,110,255,

//Level 7
16,	1,	0b010001,
32,	0,	0b000110,
85,	0,	0b010010,
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19,37,58,93,255,

//Level 8
25,	0,	0b001000,
28,	1,	0b010100,
43,	0,	0b000100,
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38,58,76,101,255,

//Level 9
27,	1,	0b010000,
43,	0,	0b010100,//the original had 2 overlapping in middle spot
58,	1,	0b000100,
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18,34,61,80,100,

//Level 10
38,	1,	0b001000,
22,	1,	0b010100,
42,	0,	0b001001,//the original had 1 fygar and 1 pooka in the middle spot
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14,49,82,114,255,

//Level 11
26,	0,	0b011000,
32,	1,	0b010010,//original had 1 fygar+1 pooka in the middle spot
49,	0,	0b000100,
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13,21,88,106,255,

//Level 12(last level before 4 level repeat loop)
25,	0,	0b011000,
34,	1,	0b000001,
42,	0,	0b000100,
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19,69,73,116,255,

//Level 13
39,	1,	0b000100,
31,	0,	0b010001,
57,	1,	0b000001,
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13,18,86,103,255,

//Level 14
18,	0,	0b010100,
34,	1,	0b000100,
27,	1,	0b011000,
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13,33,74,103,255,

//Level 15
16,	1,	0b000101,
20,	0,	0b000100,
49,	0,	0b100010,
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19,25,80,98,255,

//Level 16
25,	0,	0b011000,
34,	1,	0b000001,
42,	0,	0b000101,//original version had 2 pookas in middle spot
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19,69,73,116,255,
};