/*
 * Transformation file: ../data/graphics/ddgametiles.xml
 * Source image: ../data/graphics/ddgametiles.png
 * Tile width: 8px
 * Tile height: 8px
 * Output format: mode13-extended
 */
#define GAME_TILES_SIZE 104
const char vector_table_filler[144] __attribute__ ((section (".uze_progmem_origin")))={};
const char game_tiles[] __attribute__ ((section (".uze_progmem_origin")))={
 0x0, 0x0, 0x0, 0x0, 0x0, 0x0, 0x0, 0x0, 0x0, 0x0, 0x0, 0x0, 0x0, 0x0, 0x0, 0x0, 0x0, 0x0, 0x0, 0x0, 0x0, 0x0, 0x0, 0x0, 0x0, 0x0, 0x0, 0x0, 0x0, 0x0, 0x0, 0x0,		 //tile:0
 0x0, 0x0, 0x0, 0x0, 0x0, 0x0, 0x0, 0x0, 0x0, 0x0, 0x0, 0x0, 0x0, 0x0, 0x0, 0x0, 0x0, 0x0, 0x0, 0x0, 0x0, 0x0, 0x0, 0x0, 0x0, 0x0, 0x0, 0x0, 0x0, 0x0, 0x0, 0x0,		 //tile:1
 0x18, 0x18, 0x18, 0x18, 0x18, 0xbb, 0x18, 0x18, 0x18, 0x18, 0x18, 0x6d, 0x18, 0xc, 0x60, 0x6d, 0x18, 0xd, 0xb5, 0xc, 0x6d, 0xd, 0x10, 0xd, 0x7a, 0xc1, 0xf, 0x27, 0x6d, 0xf, 0xb5, 0x27,		 //tile:2
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 0x0, 0x2, 0x2, 0xc6, 0x1, 0xc6, 0x0, 0x2, 0x1, 0xc6, 0x0, 0x2, 0x0, 0x2, 0x2, 0x2, 0x0, 0x0, 0x0, 0x2, 0x0, 0x0, 0x1, 0xc6, 0x0, 0x2, 0x2, 0x0, 0x0, 0x0, 0x0, 0x0,		 //tile:103
};

