/*
 * Transformation file: ../data/graphics/ddulogo.xml
 * Source image: ../data/graphics/ddulogo.png
 * Tile width: 8px
 * Tile height: 8px
 * Output format: mode13-extended
 */
#define ULOGO_MAP_WIDTH 9
#define ULOGO_MAP_HEIGHT 12
const char ulogo_map[] PROGMEM ={
9,12
,0x0,0x0,0x1,0x0,0x2,0x3,0x4,0x0,0x0,0x0,0x0,0x5,0x6,0x7,0x8,0x9,0xa,0x0,0x0,0x0
,0xb,0xc,0xd,0xe,0xf,0x0,0x0,0x0,0x10,0x11,0x12,0x13,0x14,0x15,0x16,0x0,0x0,0x17,0x18,0x19
,0x1a,0x1b,0x1c,0x1d,0x0,0x0,0x1e,0x1f,0x20,0x21,0x22,0x23,0x24,0x0,0x25,0x26,0x27,0x28,0x29,0x2a
,0x2b,0x2c,0x2d,0x2e,0x2f,0x30,0x31,0x32,0x33,0x34,0x35,0x36,0x0,0x37,0x38,0x39,0x3a,0x3b,0x3c,0x3d
,0x0,0x3e,0x3f,0x40,0x41,0x42,0x43,0x44,0x45,0x46,0x47,0x48,0x49,0x4a,0x4b,0x4c,0x4d,0x4e,0x4f,0x50
,0x51,0x52,0x53,0x54,0x55,0x56,0x57,0x58};

#define ULOGO_TILES_SIZE 89
const char vector_table_filler[144] __attribute__ ((section (".uze_progmem_origin")))={};
const char ulogo_tiles[] __attribute__ ((section (".uze_progmem_origin")))={
 0x0, 0x0, 0x0, 0x0, 0x0, 0x0, 0x0, 0x0, 0x0, 0x0, 0x0, 0x0, 0x0, 0x0, 0x0, 0x0, 0x0, 0x0, 0x0, 0x0, 0x0, 0x0, 0x0, 0x0, 0x0, 0x0, 0x0, 0x0, 0x0, 0x0, 0x0, 0x0,		 //tile:0
 0x0, 0x0, 0x0, 0x0, 0x0, 0x0, 0x0, 0x0, 0x0, 0x0, 0x0, 0x0, 0x0, 0x0, 0x0, 0x0, 0x0, 0x0, 0x0, 0x0, 0x0, 0x0, 0x0, 0x0, 0x0, 0x0, 0x0, 0x0, 0x0, 0x0, 0x0, 0x0,		 //tile:1
 0x0, 0x0, 0x0, 0x0, 0x0, 0x0, 0x0, 0x0, 0x0, 0x0, 0x0, 0x0, 0x0, 0x0, 0x0, 0x0, 0x0, 0x0, 0x0, 0x0, 0x0, 0x0, 0x0, 0x0, 0x0, 0x0, 0x0, 0x0, 0x0, 0x0, 0x0, 0x0,		 //tile:2
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 0xd6, 0xd5, 0x0, 0x0, 0x0, 0x0, 0x0, 0x0, 0x0, 0x0, 0x0, 0x0, 0x0, 0x0, 0x0, 0x0, 0x0, 0x0, 0x0, 0x0, 0x0, 0x0, 0x0, 0x0, 0x0, 0x0, 0x0, 0x0, 0x0, 0x0, 0x0, 0x0,		 //tile:88
};

