/*
 * Transformation file: ../data/graphics/ddenemypanel.xml
 * Source image: ../data/graphics/ddenemypanel.png
 * Tile width: 8px
 * Tile height: 8px
 * Output format: mode13-extended
 */
#define ENEMY_PANEL_MAP_WIDTH 30
#define ENEMY_PANEL_MAP_HEIGHT 5
const char enemy_panel_map[] PROGMEM ={
30,5
,0x0,0x1,0x2,0x3,0x4,0x5,0x5,0x5,0x5,0x5,0x5,0x5,0x5,0x5,0x5,0x5,0x5,0x5,0x5,0x5
,0x5,0x5,0x5,0x5,0x5,0x5,0x5,0x5,0x5,0x5,0x6,0x7,0x8,0x9,0xa,0xb,0xc,0xd,0x5,0x5
,0x5,0x5,0x5,0x5,0x5,0x5,0x5,0x5,0x5,0x5,0x5,0x5,0x5,0x5,0xe,0xf,0x10,0x11,0x5,0x5
,0x5,0x12,0x13,0x14,0x15,0x16,0x17,0x18,0x5,0x5,0x5,0x5,0x5,0x5,0x5,0x5,0x5,0x5,0x5,0x5
,0x5,0x5,0x5,0x5,0x5,0x19,0x1a,0x1b,0x1c,0x5,0x5,0x1d,0x1e,0x1f,0x5,0x5,0x5,0x5,0x5,0x5
,0x5,0x5,0x5,0x5,0x5,0x5,0x5,0x5,0x5,0x5,0x5,0x5,0x5,0x5,0x20,0x21,0x22,0x23,0x24,0x5
,0x5,0x25,0x26,0x27,0x28,0x5,0x5,0x5,0x5,0x5,0x5,0x5,0x5,0x5,0x5,0x5,0x5,0x5,0x5,0x5
,0x5,0x5,0x5,0x5,0x29,0x2a,0x2b,0x2c,0x2d,0x5};

#define ENEMY_PANEL_TILES_SIZE 46
const char vector_table_filler[144] __attribute__ ((section (".uze_progmem_origin")))={};
const char enemy_panel_tiles[] __attribute__ ((section (".uze_progmem_origin")))={
 0x0, 0x0, 0x0, 0x0, 0x0, 0x0, 0x0, 0x0, 0x0, 0x0, 0x0, 0x0, 0x0, 0x0, 0x0, 0x0, 0x0, 0x0, 0x0, 0x0, 0x0, 0x0, 0x0, 0x0, 0x0, 0x0, 0x0, 0x0, 0x0, 0x0, 0x0, 0x0,		 //tile:0
 0x0, 0x0, 0x0, 0x0, 0x0, 0x0, 0x0, 0x0, 0x0, 0x0, 0x0, 0x0, 0x0, 0x0, 0x0, 0x0, 0x0, 0x0, 0x0, 0x0, 0x0, 0x0, 0x0, 0xa, 0x0, 0x0, 0x0, 0xcd, 0x0, 0x0, 0x0, 0xcd,		 //tile:1
 0x0, 0x0, 0x0, 0x0, 0x0, 0x0, 0x0, 0x0, 0x0, 0x0, 0x0, 0x0, 0x0, 0xa, 0xa, 0xa, 0xa, 0xa, 0xa, 0xa, 0xa, 0xa, 0xa, 0xa, 0xa, 0xa, 0xa, 0xa, 0xa, 0xa, 0xa, 0xa,		 //tile:2
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 0x0, 0x0, 0x0, 0x0, 0x0, 0x0, 0x0, 0x0, 0x0, 0x0, 0x0, 0x0, 0x0, 0x0, 0x0, 0x0, 0x0, 0x0, 0x0, 0x0, 0x0, 0x0, 0x0, 0x0, 0x0, 0x0, 0x0, 0x0, 0x0, 0x0, 0x0, 0x0,		 //tile:45
};

