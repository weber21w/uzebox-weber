/*
 * Transformation file: ../data/graphics/ddsprites.xml
 * Source image: ../data/graphics/ddsprites.png
 * Tile width: 8px
 * Tile height: 8px
 * Output format: mode13-extended
 */
#define SPRITE_TILES_SIZE 291
const char vector_table_filler[144] __attribute__ ((section (".uze_progmem_origin")))={};
const char sprite_tiles[] __attribute__ ((section (".uze_progmem_origin")))={
 0x0, 0x1, 0x2, 0x0, 0x0, 0xc6, 0x1, 0xc6, 0x1, 0xc6, 0x0, 0x2, 0x1, 0xc6, 0x0, 0x2, 0x1, 0xc6, 0x0, 0x2, 0x0, 0x2, 0x0, 0xc6, 0x0, 0x1, 0x2, 0x0, 0x0, 0x0, 0x0, 0x0,		 //tile:0
 0x0, 0x0, 0x2, 0x0, 0x0, 0x1, 0x2, 0x0, 0x0, 0x0, 0x2, 0x0, 0x0, 0x0, 0x2, 0x0, 0x0, 0x0, 0x2, 0x0, 0x0, 0x0, 0x2, 0x0, 0x0, 0x2, 0x2, 0x2, 0x0, 0x0, 0x0, 0x0,		 //tile:1
 0x0, 0x2, 0x2, 0xc6, 0x1, 0xc6, 0x0, 0x2, 0x0, 0x0, 0x1, 0x2, 0x0, 0x1, 0x2, 0xc6, 0x0, 0x2, 0x2, 0x0, 0x1, 0x2, 0x0, 0x0, 0x1, 0x2, 0x2, 0x2, 0x0, 0x0, 0x0, 0x0,		 //tile:2
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 0x26, 0x26, 0xcc, 0x0, 0x26, 0x8, 0xcc, 0x0, 0x8, 0xb6, 0x0, 0x0, 0x8, 0xb6, 0xcc, 0x0, 0xb6, 0x26, 0xcc, 0x0, 0xb6, 0x26, 0x0, 0x0, 0x8, 0xd0, 0x0, 0x0, 0x0, 0x0, 0x0, 0x0,		 //tile:290
};

