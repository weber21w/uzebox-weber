/*
 * Transformation file: ../data/graphics/ddtitle.xml
 * Source image: ../data/graphics/ddtitle.png
 * Tile width: 8px
 * Tile height: 8px
 * Output format: mode13-extended
 */
#define TITLE_MAP_WIDTH 30
#define TITLE_MAP_HEIGHT 23
const char title_map[] PROGMEM ={
30,23
,0x0,0x0,0x0,0x0,0x0,0x26,0x27,0x28,0x29,0x2a,0x2b,0x2c,0x2d,0x2e,0x2f,0x26,0x27,0x28,0x29,0x0
,0x0,0x0,0x2d,0x2e,0x2f,0x0,0x0,0x0,0x0,0x0,0x0,0x0,0x0,0x0,0x0,0x30,0x31,0x32,0x33,0x34
,0x35,0x36,0x37,0x38,0x39,0x30,0x31,0x32,0x33,0x3a,0x0,0x3b,0x37,0x38,0x39,0x0,0x0,0x0,0x0,0x0
,0x0,0x0,0x0,0x0,0x0,0x3c,0x3d,0x3e,0x3f,0x40,0x41,0x42,0x43,0x44,0x45,0x3c,0x3d,0x3e,0x3f,0x46
,0x47,0x48,0x43,0x44,0x45,0x0,0x0,0x0,0x0,0x0,0x0,0x0,0x0,0x0,0x0,0x49,0x4a,0x4b,0x4c,0x4d
,0x4e,0x4f,0x4b,0x50,0x51,0x49,0x4a,0x4b,0x4c,0x52,0x53,0x54,0x4b,0x50,0x51,0x0,0x0,0x0,0x0,0x0
,0x0,0x0,0x0,0x0,0x0,0x55,0x56,0x57,0x58,0x59,0x5a,0x5b,0x5c,0x5d,0x5e,0x55,0x56,0x57,0x5f,0x60
,0x61,0x62,0x5c,0x5d,0x5e,0x0,0x0,0x0,0x0,0x0,0x0,0x0,0x0,0x0,0x0,0x63,0x64,0x65,0x66,0x0
,0x0,0x67,0x68,0x69,0x6a,0x63,0x64,0x65,0x66,0x6b,0x6c,0x6d,0x68,0x69,0x6a,0x0,0x0,0x0,0x0,0x0
,0x0,0x0,0x0,0x0,0x0,0x0,0x0,0x0,0x0,0x0,0x0,0x0,0x0,0x0,0x0,0x0,0x0,0x0,0x0,0x0
,0x0,0x6e,0x6f,0x70,0x71,0x72,0x0,0x0,0x0,0x0,0x0,0x0,0x0,0x0,0x0,0x0,0x0,0x0,0x0,0x0
,0x0,0x0,0x0,0x0,0x0,0x0,0x0,0x0,0x0,0x0,0x0,0x0,0x0,0x0,0x0,0x0,0x0,0x0,0x0,0x0
,0x0,0x0,0x0,0x0,0x0,0x0,0x0,0x0,0x0,0x0,0x0,0x0,0x0,0x0,0x0,0x0,0x0,0x0,0x0,0x0
,0x0,0x0,0x0,0x0,0x0,0x0,0x0,0x0,0x0,0x0,0x0,0x0,0x0,0x0,0x0,0x0,0x0,0x0,0x0,0x0
,0x0,0x0,0x0,0x0,0x0,0x0,0x0,0x0,0x0,0x0,0x0,0x0,0x0,0x0,0x0,0x0,0x0,0x0,0x0,0x0
,0x0,0x0,0x0,0x0,0x0,0x0,0x0,0x0,0x0,0x0,0x0,0x0,0x0,0x0,0x0,0x0,0x0,0x0,0x0,0x0
,0x0,0x0,0x0,0x0,0x0,0x0,0x0,0x0,0x0,0x0,0x0,0x0,0x0,0x0,0x0,0x0,0x0,0x0,0x0,0x0
,0x0,0x0,0x0,0x0,0x0,0x0,0x0,0x0,0x0,0x0,0x0,0x0,0x0,0x0,0x0,0x0,0x0,0x0,0x0,0x0
,0x0,0x0,0x0,0x0,0x0,0x0,0x0,0x0,0x0,0x73,0x74,0x75,0x76,0x76,0x0,0x76,0x77,0x78,0x74,0x77
,0x79,0x0,0x0,0x0,0x0,0x0,0x0,0x0,0x0,0x0,0x0,0x0,0x0,0x0,0x0,0x0,0x0,0x0,0x0,0x7a
,0x7b,0x7c,0x7d,0x7d,0x0,0x7d,0x7e,0x7f,0x7b,0x7e,0x80,0x0,0x0,0x0,0x0,0x0,0x0,0x0,0x0,0x0
,0x0,0x0,0x0,0x0,0x0,0x0,0x0,0x0,0x0,0x0,0x0,0x0,0x0,0x0,0x0,0x0,0x0,0x0,0x0,0x0
,0x0,0x0,0x0,0x0,0x0,0x0,0x0,0x0,0x0,0x0,0x0,0x0,0x0,0x0,0x0,0x0,0x0,0x0,0x0,0x0
,0x0,0x0,0x0,0x0,0x0,0x0,0x0,0x0,0x0,0x0,0x0,0x0,0x0,0x0,0x0,0x0,0x0,0x0,0x0,0x0
,0x0,0x0,0x0,0x0,0x0,0x0,0x0,0x0,0x0,0x0,0x0,0x0,0x0,0x0,0x0,0x0,0x0,0x0,0x0,0x0
,0x0,0x0,0x0,0x0,0x0,0x0,0x0,0x0,0x0,0x0,0x0,0x0,0x0,0x0,0x0,0x0,0x0,0x0,0x0,0x0
,0x0,0x0,0x0,0x0,0x0,0x0,0x0,0x0,0x0,0x0,0x0,0x0,0x0,0x0,0x0,0x0,0x0,0x0,0x0,0x0
,0x0,0x0,0x0,0x0,0x0,0x0,0x0,0x0,0x0,0x0,0x0,0x0,0x0,0x0,0x0,0x0,0x0,0x0,0x0,0x0
,0x0,0x0,0x0,0x0,0x0,0x0,0x0,0x0,0x0,0x0,0x0,0x0,0x0,0x0,0x0,0x0,0x0,0x0,0x0,0x0
,0x0,0x0,0x0,0x0,0x0,0x0,0x0,0x0,0x0,0x0,0x0,0x0,0x0,0x0,0x0,0x0,0x0,0x0,0x0,0x0
,0x0,0x0,0x0,0x0,0x0,0x0,0x0,0x0,0x0,0x0,0x0,0x17,0x10,0x10,0x0,0x22,0x10,0xd,0x10,0x1d
,0x0,0x0,0x0,0x0,0x0,0x0,0x0,0x0,0x0,0x0,0x0,0x0,0x0,0x0,0x0,0x0,0x0,0x0,0x0,0x0
,0x0,0x0,0x0,0x0,0x0,0x0,0x0,0x0,0x0,0x0,0x0,0x0,0x0,0x0,0x0,0x0,0x0,0x0,0x0,0x0
,0x0,0x0,0x0,0x0,0x0,0x0,0x0,0x0,0x0,0x4,0x2,0x3,0x9,0x0,0x12,0x1b,0x17,0x0,0x21,0x5
,0x1,0x2,0x0,0x0,0x0,0x0,0x0,0x0,0x0,0x0};

#define TITLE_TILES_SIZE 129
const char vector_table_filler[144] __attribute__ ((section (".uze_progmem_origin")))={};
const char title_tiles[] __attribute__ ((section (".uze_progmem_origin")))={
 0x0, 0x0, 0x0, 0x0, 0x0, 0x0, 0x0, 0x0, 0x0, 0x0, 0x0, 0x0, 0x0, 0x0, 0x0, 0x0, 0x0, 0x0, 0x0, 0x0, 0x0, 0x0, 0x0, 0x0, 0x0, 0x0, 0x0, 0x0, 0x0, 0x0, 0x0, 0x0,		 //tile:0
 0x0, 0x0, 0x0, 0x0, 0x0, 0x0, 0x0, 0x0, 0x0, 0x0, 0x0, 0x0, 0x0, 0x0, 0x0, 0x0, 0x0, 0x0, 0x0, 0x0, 0x0, 0x1, 0xc6, 0x0, 0x0, 0x1, 0xc6, 0x0, 0x0, 0x0, 0x0, 0x0,		 //tile:1
 0x0, 0x1, 0x2, 0x0, 0x0, 0xc6, 0x1, 0xc6, 0x1, 0xc6, 0x0, 0x2, 0x1, 0xc6, 0x0, 0x2, 0x1, 0xc6, 0x0, 0x2, 0x0, 0x2, 0x0, 0xc6, 0x0, 0x1, 0x2, 0x0, 0x0, 0x0, 0x0, 0x0,		 //tile:2
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 0x0, 0xcf, 0xc, 0x0, 0x0, 0xcf, 0xd0, 0x0, 0x0, 0xcf, 0xd0, 0x0, 0x0, 0x0, 0x0, 0x0, 0x0, 0xcf, 0xd0, 0x0, 0x0, 0xc, 0xc, 0x0, 0x0, 0xc, 0xc, 0x0, 0x0, 0xcf, 0xd0, 0x0,		 //tile:128
};

#define GAME_PALETTE_SIZE 7
const unsigned char game_palette[] PROGMEM={
 0x0, 0xf6, 0x81, 0xad, 0x1f, 0x88, 0x7
};
