//ddgameover.mid -f60
const char song6[] PROGMEM ={
0x00,0xc0,0x0b,0x00,0xc1,0x0c,0x00,0xc2,0x00,0x00,0xc3,0x00,0x00,0xb0,0x07,0x7f,0x00,0xb1,0x07,0x7f,0x00,0xb2,0x07,0x7f,0x00,0xb3,0x07,0x64,0x02,0x90,0x4d,0x7f,
0x00,0xb0,0x0b,0x7f,0x00,0x91,0x48,0x7f,0x00,0xb1,0x0b,0x7f,0x06,0x90,0x4e,0x7f,0x00,0xb0,0x0b,0x7f,0x06,0x90,0x4f,0x7f,0x00,0xb0,0x0b,0x7f,0x06,0x90,0x50,0x7f,
0x00,0xb0,0x0b,0x7f,0x00,0x91,0x47,0x7f,0x00,0xb1,0x0b,0x7f,0x0c,0x90,0x51,0x7f,0x00,0xb0,0x0b,0x7f,0x06,0x90,0x52,0x7f,0x00,0xb0,0x0b,0x7f,0x00,0x91,0x46,0x7f,
0x00,0xb1,0x0b,0x7f,0x0c,0x90,0x53,0x7f,0x00,0xb0,0x0b,0x7f,0x06,0x91,0x45,0x7f,0x00,0xb1,0x0b,0x7f,0x0c,0x90,0x4f,0x7f,0x00,0xb0,0x0b,0x7f,0x06,0x90,0x54,0x7f,
0x00,0xb0,0x0b,0x7f,0x00,0x91,0x44,0x7f,0x00,0xb1,0x0b,0x7f,0x12,0x90,0x4f,0x7f,0x00,0xb0,0x0b,0x7f,0x00,0x91,0x43,0x7f,0x00,0xb1,0x0b,0x7f,0x0c,0x90,0x54,0x7f,
0x00,0xb0,0x0b,0x7f,0x00,0x91,0x3c,0x7f,0x00,0xb1,0x0b,0x7f,0x0e,0xff,0x2f,0x00 };
