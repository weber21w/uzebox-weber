//ddlastenemy.mid -f60
const char song3[] PROGMEM ={
0x00,0xc0,0x07,0x00,0xc1,0x08,0x00,0xc2,0x00,0x00,0xc3,0x03,0x00,0xb0,0x07,0x7f,0x00,0xb1,0x07,0x7f,0x00,0xb2,0x07,0x7f,0x00,0xb3,0x07,0x64,0x02,0x90,0x4f,0x7f,
0x00,0xb0,0x0b,0x7f,0x00,0x91,0x3c,0x7f,0x00,0xb1,0x0b,0x7f,0x08,0x90,0x4f,0x7f,0x00,0xb0,0x0b,0x7f,0x00,0x91,0x37,0x7f,0x00,0xb1,0x0b,0x7f,0x08,0x90,0x4c,0x7f,
0x00,0xb0,0x0b,0x7f,0x08,0x90,0x4f,0x7f,0x00,0xb0,0x0b,0x7f,0x00,0x91,0x37,0x7f,0x00,0xb1,0x0b,0x7f,0x08,0x90,0x51,0x7f,0x00,0xb0,0x0b,0x7f,0x00,0x91,0x3c,0x7f,
0x00,0xb1,0x0b,0x7f,0x08,0x90,0x53,0x7f,0x00,0xb0,0x0b,0x7f,0x00,0x91,0x37,0x7f,0x00,0xb1,0x0b,0x7f,0x08,0x90,0x54,0x7f,0x00,0xb0,0x0b,0x7f,0x08,0x90,0x56,0x7f,
0x00,0xb0,0x0b,0x7f,0x00,0x91,0x37,0x7f,0x00,0xb1,0x0b,0x7f,0x08,0x90,0x58,0x7f,0x00,0xb0,0x0b,0x7f,0x00,0x91,0x3c,0x7f,0x00,0xb1,0x0b,0x7f,0x08,0x90,0x58,0x7f,
0x00,0xb0,0x0b,0x7f,0x00,0x91,0x37,0x7f,0x00,0xb1,0x0b,0x7f,0x08,0x90,0x58,0x7f,0x00,0xb0,0x0b,0x7f,0x08,0x90,0x58,0x7f,0x00,0xb0,0x0b,0x7f,0x00,0x91,0x37,0x7f,
0x00,0xb1,0x0b,0x7f,0x10,0x91,0x37,0x7f,0x00,0xb1,0x0b,0x7f,0x08,0x91,0x37,0x7f,0x00,0xb1,0x0b,0x7f,0x08,0x91,0x37,0x7f,0x00,0xb1,0x0b,0x7f,0x3a,0xff,0x2f,0x00,
 };
