//-f60
const char song2[] PROGMEM = {
0x00,0xc0,0x00,0x00,0xc1,0x00,0x00,0xc2,0x00,0x00,0xc3,0x00,0x00,0xb0,0x07,0x7f,0x00,0xb1,0x07,0x7f,0x00,0xb2,0x07,0x7f,0x00,0xb3,0x07,0x64,0x02,0x90,0x4c,0x7f,
0x00,0xb0,0x0b,0x7f,0x06,0x90,0x4d,0x7f,0x00,0xb0,0x0b,0x7f,0x06,0x90,0x4e,0x7f,0x00,0xb0,0x0b,0x7f,0x06,0x90,0x4f,0x7f,0x00,0xb0,0x0b,0x7f,0x00,0x91,0x37,0x7f,
0x00,0xb1,0x0b,0x7f,0x0c,0x90,0x4c,0x7f,0x00,0xb0,0x0b,0x7f,0x06,0x90,0x4d,0x7f,0x00,0xb0,0x0b,0x7f,0x00,0x91,0x38,0x7f,0x00,0xb1,0x0b,0x7f,0x0c,0x90,0x4a,0x7f,
0x00,0xb0,0x0b,0x7f,0x06,0x90,0x4c,0x7f,0x00,0xb0,0x0b,0x7f,0x00,0x91,0x39,0x7f,0x00,0xb1,0x0b,0x7f,0x0c,0x90,0x48,0x7f,0x00,0xb0,0x0b,0x7f,0x06,0x90,0x4a,0x7f,
0x00,0xb0,0x0b,0x7f,0x00,0x91,0x3b,0x7f,0x00,0xb1,0x0b,0x7f,0x0c,0x90,0x47,0x7f,0x00,0xb0,0x0b,0x7f,0x06,0x90,0x48,0x7f,0x00,0xb0,0x0b,0x7f,0x00,0x91,0x3c,0x7f,
0x00,0xb1,0x0b,0x7f,0x12,0x90,0x54,0x7f,0x00,0xb0,0x0b,0x7f,0x0a,0x91,0x3c,0x7f,0x00,0xb1,0x0b,0x7f,0x02,0x90,0x48,0x7f,0x00,0xb0,0x0b,0x7f,0x81,0x6e,0xff,0x2f,
0x00 };
