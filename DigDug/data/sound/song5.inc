//dd1up.mid -f60
const char song5[] PROGMEM = {
0x00,0xc0,0x09,0x00,0xc1,0x0a,0x00,0xc2,0x00,0x00,0xc3,0x00,0x00,0xb0,0x07,0x7f,0x00,0xb1,0x07,0x7f,0x00,0xb2,0x07,0x7f,0x00,0xb3,0x07,0x64,0x02,0x90,0x48,0x7f,
0x00,0xb0,0x0b,0x7f,0x00,0x91,0x54,0x7f,0x00,0xb1,0x0b,0x7f,0x07,0x90,0x4a,0x7f,0x00,0xb0,0x0b,0x7f,0x00,0x91,0x56,0x7f,0x00,0xb1,0x0b,0x7f,0x07,0x90,0x4c,0x7f,
0x00,0xb0,0x0b,0x7f,0x00,0x91,0x58,0x7f,0x00,0xb1,0x0b,0x7f,0x07,0x90,0x45,0x7f,0x00,0xb0,0x0b,0x7f,0x00,0x91,0x51,0x7f,0x00,0xb1,0x0b,0x7f,0x07,0x90,0x43,0x7f,
0x00,0xb0,0x0b,0x7f,0x00,0x91,0x4f,0x7f,0x00,0xb1,0x0b,0x7f,0x0e,0x90,0x51,0x7f,0x00,0xb0,0x0b,0x7f,0x00,0x91,0x5d,0x7f,0x00,0xb1,0x0b,0x7f,0x0e,0x90,0x4f,0x7f,
0x00,0xb0,0x0b,0x7f,0x00,0x91,0x5b,0x7f,0x00,0xb1,0x0b,0x7f,0x81,0x72,0xff,0x2f,0x00 };
