//-f60
const char song0[] PROGMEM = {
0x00,0xc0,0x02,0x00,0xc1,0x03,0x00,0xc2,0x00,0x00,0xc3,0x00,0x00,0xb0,0x07,0x7f,0x00,0xb1,0x07,0x7f,0x00,0xb2,0x07,0x7f,0x00,0xb3,0x07,0x64,0x02,0x90,0x4e,0x7f,
0x00,0xb0,0x0b,0x7f,0x08,0x90,0x4f,0x7f,0x00,0xb0,0x0b,0x7f,0x08,0x90,0x4f,0x7f,0x00,0xb0,0x0b,0x7f,0x08,0x90,0x4f,0x7f,0x00,0xb0,0x0b,0x7f,0x08,0x90,0x42,0x7f,
0x00,0xb0,0x0b,0x7f,0x08,0x90,0x43,0x7f,0x00,0xb0,0x0b,0x7f,0x08,0x90,0x43,0x7f,0x00,0xb0,0x0b,0x7f,0x08,0x90,0x43,0x7f,0x00,0xb0,0x0b,0x7f,0x08,0x90,0x36,0x7f,
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0x00,0xb1,0x0b,0x7f,0x81,0x06,0xff,0x2f,0x00 };
