const char PasswordSong[] PROGMEM = {//password.mid -s0 -e9216 f7
0x00,0xc0,0x18,0x00,0xc1,0x19,0x00,0xc2,0x19,0x00,0xc3,0x19,0x00,0xb0,0x07,0x6e,0x00,0x90,0x26,0x64,0x00,0xb1,0x07,0x69,0x00,0x91,0x26,0x64,0x00,0xb3,0x07,0x5a,
0x00,0x93,0x16,0x64,0x00,0xff,0x06,0x01,0x53,0x0b,0x90,0x26,0x64,0x00,0x91,0x26,0x64,0x00,0x93,0x16,0x64,0x06,0x90,0x2a,0x64,0x00,0x91,0x2a,0x64,0x00,0x93,0x12,
0x64,0x0c,0x90,0x2a,0x64,0x00,0x91,0x2a,0x64,0x00,0x93,0x16,0x64,0x06,0x90,0x2b,0x64,0x00,0x91,0x2b,0x64,0x00,0x93,0x16,0x64,0x06,0x90,0x2b,0x64,0x00,0x91,0x2b,
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0xff,0x2f,0x00 };

