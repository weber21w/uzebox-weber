const char Lolo3Song[] PROGMEM ={//lolo3.mid s0 e36864 -f7
0x00,0xc0,0x08,0x00,0xc1,0x09,0x00,0xc2,0x0a,0x00,0xc3,0x00,0x00,0xb0,0x07,0x7f,0x00,0x90,0x41,0x64,0x00,0xb1,0x07,0x7f,0x00,0x91,0x3c,0x64,0x00,0xb2,0x07,0x7f,
0x00,0x92,0x35,0x64,0x00,0xb3,0x07,0x7f,0x00,0x93,0x19,0x64,0x00,0xff,0x06,0x01,0x53,0x05,0x90,0x41,0x64,0x00,0x91,0x3c,0x64,0x06,0x90,0x41,0x64,0x00,0x91,0x3c,
0x64,0x00,0x92,0x39,0x64,0x00,0x93,0x19,0x64,0x06,0x90,0x41,0x64,0x00,0x91,0x3c,0x64,0x00,0x92,0x35,0x64,0x00,0x93,0x17,0x64,0x0c,0x90,0x45,0x64,0x00,0x91,0x41,
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0xff,0x2f,0x00 };

