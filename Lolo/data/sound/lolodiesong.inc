const char LoloDieSong[] PROGMEM = {//lolodie.mid -s0 -e32000 f57
0x00,0xc0,0x00,0x00,0xc1,0x01,0x00,0xc2,0x02,0x00,0xc3,0x03,0x00,0x90,0x4f,0x7f,0x00,0x91,0x4e,0x7f,0x00,0xff,0x06,0x01,0x53,0x01,0x91,0x4f,0x7f,0x01,0x90,0x50,
0x7f,0x00,0x92,0x4f,0x5a,0x01,0x91,0x50,0x7f,0x01,0x90,0x51,0x7f,0x00,0x92,0x50,0x5a,0x01,0x91,0x51,0x7f,0x01,0x90,0x52,0x7f,0x00,0x92,0x51,0x5a,0x01,0x91,0x52,
0x7f,0x01,0x92,0x52,0x5a,0x05,0x90,0x4d,0x7f,0x01,0x91,0x4c,0x7f,0x01,0x90,0x4d,0x7f,0x00,0x92,0x4d,0x5a,0x01,0x91,0x4c,0x7f,0x01,0x90,0x4b,0x7f,0x00,0x92,0x4d,
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0x06,0x01,0x45,0x00,0xff,0x2f,0x00 };

