const char GiveUpSong[] PROGMEM ={//giveup.mid -f38
0x00,0xc0,0x01,0x00,0xc1,0x00,0x00,0xc2,0x02,0x00,0xb0,0x07,0x7f,0x00,0xb1,0x07,0x7f,0x00,0xb2,0x07,0x7f,0x00,0x90,0x5b,0x7f,0x00,0xb0,0x0b,0x7f,0x00,0xb1,0x0b,
0x7f,0x00,0x91,0x52,0x7f,0x00,0x92,0x3c,0x5a,0x00,0x93,0x10,0x7f,0x00,0xff,0x06,0x01,0x53,0x06,0x90,0x5d,0x7f,0x00,0xb0,0x0b,0x7f,0x00,0xb1,0x0b,0x7f,0x00,0x91,
0x54,0x7f,0x06,0x90,0x60,0x7f,0x00,0xb0,0x0b,0x7f,0x00,0xb1,0x0b,0x7f,0x00,0x91,0x58,0x7f,0x00,0x92,0x3c,0x5a,0x03,0x3c,0x5a,0x03,0x90,0x5e,0x7f,0x00,0xb0,0x0b,
0x7f,0x00,0xb1,0x0b,0x7f,0x00,0x91,0x56,0x7f,0x00,0x92,0x3c,0x5a,0x00,0x93,0x10,0x7f,0x06,0x90,0x5d,0x7f,0x00,0xb0,0x0b,0x7f,0x00,0xb1,0x0b,0x7f,0x00,0x91,0x54,
0x7f,0x06,0x90,0x5b,0x7f,0x00,0xb0,0x0b,0x7f,0x00,0xb1,0x0b,0x7f,0x00,0x91,0x52,0x7f,0x00,0x92,0x3c,0x5a,0x05,0x90,0x59,0x7f,0x00,0xb0,0x0b,0x7f,0x00,0xb1,0x0b,
0x7f,0x00,0x91,0x51,0x7f,0x00,0x92,0x35,0x5a,0x0c,0x90,0x30,0x7f,0x00,0xb0,0x0b,0x7f,0x00,0xb1,0x0b,0x7f,0x00,0x91,0x30,0x7f,0x06,0x90,0x35,0x7f,0x00,0xb0,0x0b,
0x7f,0x00,0xb1,0x0b,0x7f,0x00,0x91,0x35,0x7f,0x91,0x75,0xff,0x06,0x01,0x45,0x00,0xff,0x2f,0x00 };
