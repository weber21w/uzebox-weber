const char Eggerland2Song[] PROGMEM ={
0x00,0xc0,0x04,0x00,0xc1,0x05,0x00,0xc2,0x06,0x00,0xc3,0x07,0x00,0xb0,0x07,0x6e,0x00,0x90,0x48,0x64,0x00,0xb1,0x07,0x64,0x00,0x91,0x39,0x64,0x00,0xb2,0x07,0x64,
0x00,0x92,0x29,0x64,0x00,0xff,0x06,0x01,0x53,0x13,0x91,0x3c,0x64,0x00,0x92,0x2d,0x64,0x0d,0x90,0x41,0x64,0x07,0x4a,0x64,0x00,0x91,0x41,0x64,0x00,0x92,0x2e,0x64,
0x0d,0x90,0x4d,0x64,0x06,0x4c,0x64,0x00,0x91,0x3c,0x64,0x00,0x92,0x30,0x64,0x0d,0x90,0x48,0x64,0x07,0x4d,0x64,0x00,0x91,0x45,0x64,0x00,0x92,0x35,0x64,0x0d,0x90,
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0x41,0x64,0x00,0x92,0x2e,0x64,0x02,0xff,0x2f,0x00 };

