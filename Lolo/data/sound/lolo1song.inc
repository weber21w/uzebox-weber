const char Lolo1Song[] PROGMEM ={//lolo1stage S0,E11520,F27
0x00,0xc0,0x00,0x00,0xc1,0x01,0x00,0xc2,0x02,0x00,0xc3,0x00,0x00,0x90,0x43,0x64,0x00,0x91,0x3b,0x64,0x00,0x92,0x2b,0x64,0x00,0x93,0x0e,0x64,0x00,0xff,0x06,0x01,
0x53,0x0e,0x90,0x3e,0x64,0x00,0x91,0x3b,0x64,0x00,0x92,0x2b,0x64,0x00,0x93,0x0c,0x64,0x07,0x90,0x42,0x64,0x00,0x91,0x3c,0x64,0x00,0x92,0x32,0x64,0x00,0x93,0x10,
0x64,0x07,0x90,0x40,0x64,0x08,0x42,0x64,0x00,0x93,0x0c,0x64,0x07,0x90,0x43,0x64,0x00,0x91,0x3b,0x64,0x00,0x92,0x37,0x64,0x00,0x93,0x0e,0x64,0x0e,0x90,0x3e,0x64,
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0x2b,0x64,0x00,0x93,0x0c,0x64,0x07,0x91,0x3c,0x64,0x00,0x92,0x32,0x64,0x00,0x93,0x10,0x64,0x0a,0xff,0x2f,0x00 };




