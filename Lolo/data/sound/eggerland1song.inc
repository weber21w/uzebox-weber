const char Eggerland1Song[] PROGMEM ={//eggerland.mid s0 e3840 f24
0x00,0xc0,0x00,0x00,0xc1,0x01,0x00,0xc2,0x02,0x00,0xc3,0x03,0x00,0xb0,0x07,0x6e,0x00,0x90,0x43,0x64,0x00,0xb1,0x07,0x69,0x00,0x91,0x40,0x64,0x00,0xb2,0x07,0x6e,
0x00,0x92,0x30,0x64,0x00,0xb3,0x07,0x64,0x00,0x93,0x0e,0x64,0x00,0xff,0x06,0x01,0x53,0x10,0x90,0x48,0x64,0x00,0x91,0x40,0x64,0x00,0x93,0x0c,0x64,0x06,0x92,0x30,
0x64,0x05,0x93,0x0e,0x64,0x06,0x90,0x4a,0x64,0x00,0x91,0x41,0x64,0x00,0x92,0x2b,0x64,0x00,0x93,0x0e,0x64,0x0b,0x90,0x4c,0x64,0x00,0x91,0x43,0x64,0x00,0x92,0x30,
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0x05,0x93,0x0e,0x64,0x06,0x90,0x4a,0x64,0x00,0x91,0x41,0x64,0x00,0x92,0x2b,0x64,0x00,0x93,0x0e,0x64,0x06,0xff,0x2f,0x00 };

