const char patch00[] PROGMEM ={//lolo 1 music patches
 	0,PC_WAVE,2,
	0,PC_ENV_VOL,124,
	//0,PC_TREMOLO_RATE,123,
	//0,PC_TREMOLO_LEVEL,66,
 	0,PC_ENV_SPEED,-25,
	6,PC_NOTE_CUT,0,
	0,PATCH_END
  };

  const char patch01[] PROGMEM ={ 
//0,PC_ENV_VOL,0, 
	0,PC_WAVE,2,
	0,PC_ENV_VOL,114,
	0,PC_TREMOLO_RATE,111,
	0,PC_TREMOLO_LEVEL,88,
 	0,PC_ENV_SPEED,-15,
	13,PC_NOTE_CUT,0,
	0,PATCH_END
  };

  const char patch02[] PROGMEM ={
//0,PC_ENV_VOL,0, 
  	0,PC_WAVE,0,
	0,PC_ENV_VOL,102,
	//0,PC_ENV_SPEED,14,
	0,PC_TREMOLO_RATE,180,
	0,PC_TREMOLO_LEVEL,77,
  	0,PC_ENV_SPEED,10,
	//0,PC_NOTE_HOLD,0,
  	1,PC_ENV_SPEED,-14,
	20,PC_NOTE_CUT,0,
  	0,PATCH_END
  };

  const char patch03[] PROGMEM ={	
0,PC_ENV_VOL,0,   
//	0,PC_NOISE_PARAMS,1,
  	//0,PC_ENV_VOL,0x80,
  //	0,PC_ENV_SPEED,-30, 
  	8,PC_NOTE_CUT,0,
  	0,PATCH_END
  };

const char patch04[] PROGMEM ={//lolo 2 music patches
 	0,PC_WAVE,4,
	0,PC_ENV_VOL,77,
	0,PC_TREMOLO_RATE,128,
	0,PC_TREMOLO_LEVEL,56,
 	//1,PC_ENV_SPEED,-11,
	//1,PC_ENV_SPEED,-25,
 	1,PC_ENV_SPEED,-35,
	8,PC_NOTE_CUT,0,
	0,PATCH_END
  };

  const char patch05[] PROGMEM ={ 
 	0,PC_WAVE,2,
	0,PC_ENV_VOL,77,
	0,PC_TREMOLO_RATE,90,
	0,PC_TREMOLO_LEVEL,66,
 	//1,PC_ENV_SPEED,-4,
	1,PC_ENV_SPEED,-15,
 	//1,PC_ENV_SPEED,-19,
	12,PC_NOTE_CUT,0,
	0,PATCH_END
  };

  const char patch06[] PROGMEM ={	
 	0,PC_WAVE,4,
	0,PC_ENV_VOL,94,
	//0,PC_TREMOLO_RATE,180,
	//0,PC_TREMOLO_LEVEL,88,
	//0,PC_ENV_SPEED,11,
 	//1,PC_ENV_SPEED,3,
	//1,PC_ENV_SPEED,-7,
	1,PC_ENV_SPEED,-19,
 	//1,PC_ENV_SPEED,-22,
	8,PC_NOTE_CUT,0,
	0,PATCH_END
  };

  const char patch07[] PROGMEM ={	
  	0,PC_NOISE_PARAMS,1,
  	0,PC_ENV_VOL,50,
  	0,PC_ENV_SPEED,-30, 
  	8,PC_NOTE_CUT,0,
  	0,PATCH_END
  };


const char patch08[] PROGMEM ={//lolo 3 music patches
 	0,PC_WAVE,4,
	0,PC_ENV_VOL,77,
	0,PC_TREMOLO_RATE,128,
	0,PC_TREMOLO_LEVEL,56,
 	//1,PC_ENV_SPEED,-11,
	//1,PC_ENV_SPEED,-25,
 	1,PC_ENV_SPEED,-35,
	8,PC_NOTE_CUT,0,
	0,PATCH_END
  };

const char patch09[] PROGMEM ={ 
 	0,PC_WAVE,2,
	0,PC_ENV_VOL,77,
	0,PC_TREMOLO_RATE,90,
	0,PC_TREMOLO_LEVEL,66,
 	//1,PC_ENV_SPEED,-4,
	1,PC_ENV_SPEED,-15,
 	//1,PC_ENV_SPEED,-19,
	12,PC_NOTE_CUT,0,
	0,PATCH_END
  };

const char patch10[] PROGMEM ={	
 	0,PC_WAVE,4,
	0,PC_ENV_VOL,94,
	//0,PC_TREMOLO_RATE,180,
	//0,PC_TREMOLO_LEVEL,88,
	//0,PC_ENV_SPEED,11,
 	//1,PC_ENV_SPEED,3,
	//1,PC_ENV_SPEED,-7,
	1,PC_ENV_SPEED,-19,
 	//1,PC_ENV_SPEED,-22,
	8,PC_NOTE_CUT,0,
	0,PATCH_END
  };

const char patch11[] PROGMEM ={	
  	0,PC_NOISE_PARAMS,5,
  	0,PC_ENV_VOL,0x0,
  	0,PC_ENV_SPEED,-30, 
  	8,PC_NOTE_CUT,0,
  	0,PATCH_END
  };



const char patch12[] PROGMEM ={	
  0,PC_NOISE_PARAMS,1,
  0,PC_ENV_VOL,0x60,
  0,PC_ENV_SPEED,-30, 
  6,PC_NOTE_CUT,0,
  0,PATCH_END
  }; 
const char patch13[] PROGMEM ={//dummy Lolo 1 stage drums
  0,PC_NOISE_PARAMS,1,
  0,PC_ENV_VOL,0x90,
  0,PC_ENV_SPEED,-30, 
  8,PC_NOTE_CUT,0,
  0,PATCH_END
  }; 
const char patch14[] PROGMEM ={	
  0,PC_NOISE_PARAMS,1,
  0,PC_ENV_VOL,0x90,
  0,PC_ENV_SPEED,-30, 
  8,PC_NOTE_CUT,0,
  0,PATCH_END
  }; 
const char patch15[] PROGMEM ={//dummy Lolo 1 stage drums
  0,PC_NOISE_PARAMS,1,
  0,PC_ENV_VOL,0x60,
  0,PC_ENV_SPEED,-30, 
  8,PC_NOTE_CUT,0,
  0,PATCH_END
  }; 

const char patch16[] PROGMEM ={	
  0,PC_NOISE_PARAMS,1,
  0,PC_ENV_VOL,0x0,
  0,PC_ENV_SPEED,-30, 
  8,PC_NOTE_CUT,0,
  0,PATCH_END
  }; 
const char patch17[] PROGMEM ={//dummy Lolo 1 stage drums
  0,PC_NOISE_PARAMS,1,
  0,PC_ENV_VOL,0x0,
  0,PC_ENV_SPEED,-30, 
  8,PC_NOTE_CUT,0,
  0,PATCH_END
  };

const char patch18[] PROGMEM ={	//lolo 2 drum 1
  	0,PC_NOISE_PARAMS,1,
  	0,PC_ENV_VOL,0x30,
  	0,PC_ENV_SPEED,-30, 
  	8,PC_NOTE_CUT,0,
  	0,PATCH_END
  };

const char patch19[] PROGMEM ={//dummy
  	0,PATCH_END
  };


const char patch20[] PROGMEM ={//Lolo 2 drum 2
  	0,PC_NOISE_PARAMS,7,
  	0,PC_ENV_VOL,0x20,
  	0,PC_ENV_SPEED,-30, 
  	8,PC_NOTE_CUT,0,
  	0,PATCH_END
  };


const char patch21[] PROGMEM ={//dummy Lolo 1 stage drums
  	0,PC_ENV_VOL,0x0,
  	0,PC_ENV_SPEED,-30, 
  	8,PC_NOTE_CUT,0,
  	0,PATCH_END

  };

const char patch22[] PROGMEM ={	
  	0,PC_NOISE_PARAMS,1,
  	0,PC_ENV_VOL,0x0,
  	0,PC_ENV_SPEED,-30, 
  	8,PC_NOTE_CUT,0,
  	0,PATCH_END
  };

const char patch23[] PROGMEM ={//Lolo 3 snare drum
  	0,PC_NOISE_PARAMS,1,
  	0,PC_ENV_VOL,0x30,
  	0,PC_ENV_SPEED,-30, 
  	8,PC_NOTE_CUT,0,
  	0,PATCH_END

  };


const char patch24[] PROGMEM ={//Lolo 3 dummy
  	0,PC_NOISE_PARAMS,1,
 	0,PC_WAVE,4,
 	0,PC_ENV_SPEED,-35,
	8,PATCH_END
  };

const char patch25[] PROGMEM ={//Lolo 3 hi hat
  	0,PC_NOISE_PARAMS,4,
  	0,PC_ENV_VOL,0x24,
  	0,PC_ENV_SPEED,-30, 
  	8,PC_NOTE_CUT,0,
  	0,PATCH_END

  };


const char patch26[] PROGMEM ={	
  	0,PC_NOISE_PARAMS,1,
  	0,PC_ENV_VOL,0x90,
  	0,PC_ENV_SPEED,-30, 
  	8,PC_NOTE_CUT,0,
  	0,PATCH_END
  };




//SOUND EFFECTS 

const char patch27[] PROGMEM ={//heart pickup
	0,PC_WAVE,4,              
	0,PC_PITCH,69,            
	1,PC_PITCH,73,            
	1,PC_PITCH,70,            
	1,PC_PITCH,74,
	1,PC_PITCH,71,
	1,PC_PITCH,75,
	1,PC_PITCH,72,
	1,PC_PITCH,76,
	1,PC_PITCH,73,
	1,PC_PITCH,77,
	1,PC_NOTE_CUT,0,         
	0,PATCH_END
};

const char patch28[] PROGMEM ={//heart shot pickup
	0,PC_WAVE,4,              
	0,PC_PITCH,69+12,            
	1,PC_PITCH,73+12,            
	1,PC_PITCH,70+12,            
	1,PC_PITCH,74+12,
	1,PC_PITCH,71+12,
	1,PC_PITCH,75+12,
	1,PC_PITCH,72+12,
	1,PC_PITCH,76+12,
	1,PC_PITCH,73+12,
	1,PC_PITCH,77+12,
	1,PC_NOTE_CUT,0,         
	0,PATCH_END
};

const char patch29[] PROGMEM ={//lolo shoot
	0,PC_WAVE,4,      
	0,PC_ENV_VOL,127,        
	0,PC_PITCH,80,      
	1,PC_PITCH,83,            
	1,PC_PITCH,84,            
	1,PC_PITCH,80,            
	1,PC_PITCH,81,            
	1,PC_PITCH,80,            
	1,PC_PITCH,81,            
	1,PC_PITCH,79,            
	1,PC_PITCH,78,            
	1,PC_PITCH,73,            
	1,PC_PITCH,75,            
	1,PC_PITCH,72,            
	1,PC_PITCH,70,            
	1,PC_PITCH,66,            
	1,PC_PITCH,68,
	1,PC_PITCH,65,            
	1,PC_PITCH,64,            
	1,PC_PITCH,59,            
	1,PC_PITCH,61,            
	1,PC_PITCH,58,                        
	1,PC_NOTE_CUT,0,         
	0,PATCH_END
};


const char patch30[] PROGMEM ={//lolo shoot
  0,PC_WAVE,4,      
0,PC_ENV_VOL,127,        
  0,PC_PITCH,80,      
  1,PC_NOTE_CUT,0,         
  0,PATCH_END
};



const struct PatchStruct patches[] PROGMEM = {
{0,NULL,patch00,0,0},//lolo 1 lead1
{0,NULL,patch01,0,0},//lolo 1 lead2
{0,NULL,patch02,0,0},//lolo 1 bass
{1,NULL,patch03,0,0},//lolo 1 noise
{0,NULL,patch04,0,0},//lolo 2 lead1
{0,NULL,patch05,0,0},//lolo 2 lead2
{0,NULL,patch06,0,0},//lolo 2 bass
{1,NULL,patch07,0,0},//lolo 2 noise
{0,NULL,patch08,0,0},//lolo 3 lead1
{0,NULL,patch09,0,0},//lolo 3 lead2
{0,NULL,patch10,0,0},//lolo 3 bass
{1,NULL,patch11,0,0},//lolo 3 noise

{0,NULL,patch12,0,0},//lolo 3 noise
{0,NULL,patch13,0,0},//lolo 3 noise
{0,NULL,patch14,0,0},//lolo 3 noise
{0,NULL,patch15,0,0},//lolo 3 noise
{0,NULL,patch16,0,0},//lolo 3 noise
{0,NULL,patch17,0,0},//lolo 3 noise

{0,NULL,patch18,0,0},//lolo 3 noise
{0,NULL,patch19,0,0},//lolo 3 noise
{0,NULL,patch20,0,0},//lolo 3 noise
{0,NULL,patch21,0,0},//lolo 3 noise
{0,NULL,patch22,0,0},//lolo 3 noise
{0,NULL,patch23,0,0},//lolo 3 noise

{0,NULL,patch24,0,0},//lolo 3 noise
{0,NULL,patch25,0,0},//lolo 3 noise
{0,NULL,patch26,0,0},//lolo 3 noise
{0,NULL,patch27,0,0},//lolo 3 noise
{0,NULL,patch28,0,0},//lolo 3 noise
{0,NULL,patch29,0,0},//lolo 3 noise


//sound effects

{0,NULL,patch29,0,0},//lolo 3 noise

{0,NULL,patch11,0,0},//heart pickup
{0,NULL,patch11,0,0},//heart shot pickup

{0,NULL,patch04,0,0},//dummy
{0,NULL,patch05,0,0},//dummy

};

