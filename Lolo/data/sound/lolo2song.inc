const char Lolo2Song[] PROGMEM = {//lolo2song.mid -s0 -e5760 -f30
0x00,0xc0,0x00,0x00,0xc1,0x01,0x00,0xc2,0x02,0x00,0xc3,0x03,0x00,0xb0,0x07,0x69,0x00,0x90,0x3e,0x7f,0x00,0xb1,0x07,0x69,0x00,0x91,0x39,0x64,0x00,0xb2,0x07,0x64,
0x00,0x92,0x26,0x64,0x00,0xb3,0x07,0x5a,0x00,0x93,0x12,0x64,0x00,0xff,0x06,0x01,0x53,0x08,0x92,0x26,0x64,0x08,0x90,0x3e,0x7f,0x00,0x91,0x3b,0x64,0x00,0x92,0x26,
0x64,0x00,0x93,0x14,0x64,0x09,0x90,0x42,0x7f,0x00,0x91,0x3c,0x64,0x00,0x92,0x26,0x64,0x00,0x93,0x14,0x64,0x08,0x90,0x40,0x7f,0x09,0x42,0x7f,0x00,0x91,0x39,0x64,
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0x64,0x08,0x90,0x3e,0x7f,0x00,0x91,0x39,0x64,0x00,0x92,0x26,0x64,0x00,0x93,0x12,0x64,0x00,0xff,0x06,0x01,0x45,0x08,0x92,0x26,0x64,0x09,0xff,0x2f,0x00 };

