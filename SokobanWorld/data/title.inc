/* tile 0 */

  0x00,0x00,0x00,0x82,0x82,0x82,0x82,0x82,
  0x00,0x00,0x82,0x07,0x07,0x07,0x07,0x07,
  0x00,0x82,0x07,0x07,0x07,0x07,0x07,0x07,
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  0x00,0x00,0x82,0x27,0x27,0x27,0x27,0x82,
/* tile 1 */

  0x82,0x82,0x00,0x00,0x00,0x00,0x00,0x00,
  0x82,0x07,0x82,0x82,0x00,0x00,0x00,0x00,
  0x82,0x07,0x07,0x07,0x82,0x00,0x00,0x00,
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  0x27,0x27,0x82,0x00,0x00,0x00,0x00,0x00,
/* tile 2 */

  0x00,0x00,0x00,0x00,0x00,0x00,0x82,0x82,
  0x00,0x00,0x00,0x00,0x00,0x82,0x07,0x07,
  0x00,0x00,0x00,0x82,0x82,0x07,0x07,0x07,
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  0x82,0x82,0x27,0x27,0x27,0x27,0x27,0x27,
/* tile 3 */

  0x82,0x82,0x82,0x82,0x00,0x00,0x00,0x00,
  0x07,0x82,0x07,0x07,0x82,0x00,0x00,0x00,
  0x07,0x82,0x07,0x07,0x07,0x82,0x00,0x00,
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  0x82,0x27,0x27,0x27,0x27,0x27,0x27,0x82,
/* tile 4 */

  0x00,0x00,0x00,0x00,0x00,0x82,0x82,0x82,
  0x00,0x00,0x00,0x00,0x82,0x07,0x07,0x07,
  0x00,0x00,0x00,0x00,0x82,0x07,0x07,0x07,
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  0x00,0x00,0x00,0x82,0x27,0x27,0x27,0x27,
/* tile 5 */

  0x82,0x82,0x82,0x82,0x82,0x82,0x82,0x00,
  0x07,0x82,0x07,0x07,0x07,0x07,0x07,0x82,
  0x07,0x82,0x07,0x07,0x07,0x07,0x82,0x00,
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  0x82,0x27,0x27,0x27,0x82,0x00,0x00,0x00,
/* tile 6 */

  0x00,0x00,0x00,0x00,0x00,0x82,0x82,0x82,
  0x00,0x00,0x00,0x00,0x82,0x07,0x07,0x07,
  0x00,0x00,0x00,0x00,0x82,0x07,0x07,0x07,
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  0x00,0x00,0x00,0x82,0x27,0x27,0x27,0x82,
/* tile 7 */

  0x82,0x82,0x82,0x82,0x00,0x00,0x00,0x00,
  0x82,0x07,0x07,0x07,0x82,0x00,0x00,0x00,
  0x82,0x07,0x07,0x07,0x07,0x82,0x00,0x00,
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  0x27,0x27,0x27,0x27,0x82,0x00,0x00,0x00,
/* tile 8 */

  0x00,0x00,0x00,0x00,0x00,0x00,0x82,0x82,
  0x00,0x00,0x00,0x00,0x00,0x82,0x07,0x07,
  0x00,0x00,0x00,0x00,0x00,0x82,0x07,0x07,
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  0x00,0x00,0x00,0x82,0x82,0x27,0x27,0x82,
/* tile 9 */

  0x82,0x82,0x00,0x00,0x00,0x00,0x00,0x00,
  0x82,0x07,0x82,0x00,0x00,0x00,0x00,0x00,
  0x82,0x07,0x82,0x00,0x00,0x00,0x00,0x00,
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  0x27,0x27,0x27,0x82,0x82,0x00,0x00,0x00,
/* tile 10 */

  0x00,0x00,0x00,0x00,0x00,0x82,0x82,0x82,
  0x00,0x00,0x00,0x00,0x82,0x07,0x07,0x07,
  0x00,0x00,0x00,0x00,0x82,0x07,0x07,0x07,
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  0x00,0x00,0x82,0x27,0x27,0x82,0x27,0x27,
/* tile 11 */

  0x82,0x00,0x82,0x82,0x82,0x82,0x82,0x00,
  0x07,0x82,0x07,0x07,0x07,0x07,0x07,0x82,
  0x07,0x82,0x07,0x07,0x07,0x07,0x07,0x82,
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  0x27,0x27,0x82,0x27,0x82,0x82,0x00,0x00,
/* tile 12 */

  0x00,0x00,0x00,0x82,0x27,0x27,0x82,0x27,
  0x00,0x00,0x00,0x00,0x82,0x27,0x82,0x27,
  0x00,0x00,0x00,0x82,0x2F,0x2F,0x82,0x2F,
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  0x00,0x00,0x00,0x82,0x82,0x82,0x82,0x82,
/* tile 13 */

  0x27,0x27,0x27,0x82,0x00,0x00,0x00,0x00,
  0x27,0x27,0x27,0x27,0x82,0x00,0x00,0x00,
  0x2F,0x2F,0x2F,0x2F,0x2F,0x82,0x00,0x00,
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  0x82,0x82,0x82,0x00,0x00,0x00,0x00,0x00,
/* tile 14 */

  0x82,0x27,0x27,0x27,0x27,0x27,0x27,0x82,
  0x82,0x27,0x27,0x27,0x27,0x27,0x27,0x82,
  0x82,0x2F,0x2F,0x2F,0x2F,0x2F,0x2F,0x82,
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  0x00,0x00,0x00,0x00,0x82,0x82,0x82,0x82,
/* tile 15 */

  0x27,0x27,0x27,0x27,0x27,0x27,0x27,0x82,
  0x27,0x27,0x27,0x27,0x27,0x27,0x82,0x82,
  0x2F,0x2F,0x2F,0x2F,0x2F,0x2F,0x82,0x00,
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  0x82,0x82,0x00,0x00,0x00,0x00,0x00,0x00,
/* tile 16 */

  0x00,0x00,0x82,0x27,0x27,0x27,0x27,0x82,
  0x00,0x00,0x82,0x27,0x27,0x27,0x27,0x82,
  0x00,0x00,0x82,0x2F,0x2F,0x2F,0x2F,0x82,
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  0x00,0x00,0x82,0x82,0x82,0x82,0x82,0x82,
/* tile 17 */

  0x27,0x27,0x82,0x82,0x00,0x00,0x00,0x00,
  0x27,0x27,0x82,0x00,0x00,0x00,0x00,0x00,
  0x2F,0x2F,0x2F,0x82,0x00,0x00,0x00,0x00,
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  0x82,0x82,0x82,0x82,0x82,0x00,0x00,0x00,
/* tile 18 */

  0x00,0x00,0x00,0x82,0x27,0x27,0x82,0x27,
  0x00,0x00,0x00,0x82,0x27,0x27,0x82,0x27,
  0x00,0x00,0x00,0x82,0x2F,0x2F,0x82,0x2F,
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  0x00,0x00,0x82,0x82,0x82,0x82,0x82,0x82,
/* tile 19 */

  0x27,0x27,0x82,0x82,0x00,0x00,0x00,0x00,
  0x27,0x27,0x27,0x27,0x82,0x00,0x00,0x00,
  0x2F,0x2F,0x2F,0x2F,0x2F,0x82,0x00,0x00,
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  0x82,0x82,0x82,0x82,0x00,0x00,0x00,0x00,
/* tile 20 */

  0x00,0x00,0x00,0x82,0x27,0x27,0x82,0x27,
  0x00,0x00,0x00,0x82,0x27,0x27,0x82,0x27,
  0x00,0x00,0x00,0x82,0x2F,0x2F,0x82,0x2F,
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  0x00,0x00,0x00,0x82,0x82,0x82,0x82,0x82,
/* tile 21 */

  0x27,0x27,0x27,0x27,0x82,0x00,0x00,0x00,
  0x27,0x27,0x27,0x27,0x82,0x00,0x00,0x00,
  0x2F,0x2F,0x2F,0x2F,0x82,0x00,0x00,0x00,
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  0x82,0x82,0x82,0x82,0x82,0x00,0x00,0x00,
/* tile 22 */

  0x00,0x00,0x82,0x27,0x27,0x82,0x27,0x27,
  0x00,0x00,0x82,0x27,0x27,0x82,0x27,0x27,
  0x00,0x82,0x2F,0x2F,0x2F,0x82,0x2F,0x2F,
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  0x00,0x00,0x82,0x82,0x82,0x00,0x00,0x82,
/* tile 23 */

  0x27,0x27,0x82,0x27,0x82,0x00,0x00,0x00,
  0x27,0x27,0x82,0x82,0x82,0x00,0x00,0x00,
  0x2F,0x2F,0x2F,0x82,0x82,0x00,0x00,0x00,
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  0x82,0x82,0x00,0x00,0x00,0x00,0x00,0x00,
/* tile 24 */

  0x00,0x00,0x00,0x00,0x00,0x00,0x00,0x00,
  0x00,0x00,0x00,0x00,0x00,0x00,0x00,0x00,
  0x00,0x00,0x00,0x00,0x00,0x00,0x00,0x00,
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  0x00,0x00,0x00,0x00,0x00,0x00,0x00,0x00,
/* tile 25 */

  0x82,0x82,0x82,0x82,0x82,0x00,0x82,0x82,
  0x82,0x07,0x07,0x07,0x07,0x82,0x07,0x07,
  0x82,0x07,0x07,0x07,0x07,0x82,0x07,0x07,
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  0x00,0x82,0x27,0x27,0x27,0x27,0x82,0x27,
/* tile 26 */

  0x82,0x82,0x00,0x82,0x82,0x82,0x82,0x82,
  0x07,0x07,0x82,0x07,0x07,0x07,0x07,0x82,
  0x07,0x07,0x82,0x07,0x07,0x07,0x07,0x82,
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  0x27,0x27,0x27,0x82,0x27,0x82,0x82,0x00,
/* tile 27 */

  0x00,0x00,0x00,0x00,0x00,0x00,0x82,0x82,
  0x00,0x00,0x00,0x00,0x00,0x82,0x07,0x07,
  0x00,0x00,0x00,0x00,0x00,0x82,0x07,0x07,
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  0x00,0x00,0x00,0x00,0x82,0x27,0x27,0x27,
/* tile 28 */

  0x82,0x82,0x00,0x00,0x00,0x00,0x00,0x00,
  0x07,0x07,0x82,0x00,0x00,0x00,0x00,0x00,
  0x07,0x07,0x82,0x00,0x00,0x00,0x00,0x00,
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  0x27,0x82,0x00,0x00,0x00,0x00,0x00,0x00,
/* tile 29 */

  0x82,0x82,0x82,0x82,0x82,0x00,0x00,0x00,
  0x07,0x82,0x07,0x07,0x07,0x82,0x00,0x00,
  0x07,0x82,0x07,0x07,0x07,0x07,0x82,0x00,
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  0x82,0x27,0x27,0x27,0x27,0x27,0x27,0x82,
/* tile 30 */

  0x00,0x82,0x27,0x27,0x27,0x27,0x82,0x27,
  0x00,0x82,0x27,0x27,0x27,0x27,0x82,0x27,
  0x00,0x82,0x2F,0x2F,0x2F,0x2F,0x82,0x2F,
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  0x00,0x00,0x00,0x82,0x82,0x82,0x00,0x00,
/* tile 31 */

  0x27,0x27,0x27,0x82,0x27,0x82,0x00,0x00,
  0x27,0x27,0x27,0x82,0x82,0x82,0x00,0x00,
  0x2F,0x2F,0x2F,0x2F,0x82,0x82,0x00,0x00,
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  0x82,0x82,0x82,0x00,0x00,0x00,0x00,0x00,
/* tile 32 */

  0x00,0x00,0x82,0x27,0x27,0x27,0x82,0x27,
  0x00,0x00,0x82,0x27,0x27,0x27,0x82,0x27,
  0x00,0x00,0x82,0x2F,0x2F,0x2F,0x82,0x2F,
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  0x00,0x00,0x82,0x82,0x82,0x82,0x82,0x82,
/* tile 33 */

  0x00,0x00,0x00,0x82,0x27,0x27,0x27,0x27,
  0x00,0x00,0x00,0x82,0x27,0x27,0x27,0x27,
  0x00,0x00,0x00,0x82,0x2F,0x2F,0x2F,0x2F,
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  0x00,0x00,0x00,0x82,0x82,0x82,0x82,0x82,
/* tile 34 */

  0x82,0x00,0x00,0x00,0x00,0x00,0x00,0x00,
  0x82,0x00,0x82,0x82,0x82,0x00,0x00,0x00,
  0x82,0x82,0x2F,0x2F,0x82,0x00,0x00,0x00,
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  0x82,0x82,0x82,0x00,0x00,0x00,0x00,0x00,
/* tile 35 */

  0x00,0x00,0x82,0x27,0x27,0x27,0x27,0x82,
  0x00,0x00,0x82,0x27,0x27,0x27,0x27,0x82,
  0x00,0x00,0x82,0x2F,0x2F,0x2F,0x2F,0x82,
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  0x00,0x00,0x82,0x82,0x82,0x82,0x82,0x82,
/* tile 36 */

  0x27,0x27,0x27,0x27,0x27,0x27,0x27,0x82,
  0x27,0x27,0x27,0x27,0x27,0x27,0x27,0x82,
  0x2F,0x2F,0x2F,0x2F,0x2F,0x2F,0x82,0x00,
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  0x82,0x00,0x00,0x00,0x00,0x00,0x00,0x00,