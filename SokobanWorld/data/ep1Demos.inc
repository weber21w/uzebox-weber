#define NUMDEMOS 50

const char Demos[] PROGMEM = {
58,116,193,0,17,

95,117,41,55,242,55,164,10,160,181,240,85,151,114,35,127,163,10,202,92,117,41,55,242,3,17,
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149,194,255,115,161,170,170,86,149,53,0,32,255,255,207,133,106,169,140,154,242,255,255,115,170,150,154,53,192,168,41,255,255,223,200,169,150,90,61,3,41,252,207,169,170,154,245,13,148,10,252,255,191,106,149,89,9,0,148,10,252,255,55,114,106,169,169,213,243,37,0,148,10,252,255,15,17,
////
42,212,15,0,154,252,85,165,130,214,140,170,42,246,255,87,189,37,0,163,170,250,255,87,165,220,0,163,170,201,248,247,63,12,95,85,170,88,93,2,48,170,138,253,255,195,96,85,0,252,85,165,138,213,37,0,163,170,254,255,3,104,45,124,85,0,252,85,165,138,213,37,0,163,106,50,126,255,131,50,87,5,192,95,85,170,88,93,2,48,170,98,255,127,253,165,154,0,163,170,255,63,192,95,138,85,192,95,165,250,95,170,2,163,154,140,247,63,252,40,86,5,252,85,170,255,165,42,48,170,2,17,
/////
34,240,63,124,151,254,165,244,160,131,104,169,102,13,242,175,86,61,67,122,41,32,111,253,253,240,165,42,106,61,41,124,211,255,165,0,17,

247,252,223,189,34,92,28,194,87,129,164,170,166,252,255,223,64,169,170,96,103,202,255,255,92,168,170,42,207,217,255,223,144,170,10,128,85,246,255,207,169,170,0,106,202,63,87,217,255,55,114,170,10,160,246,92,217,255,115,170,10,104,217,255,255,170,10,168,246,115,217,255,141,156,170,170,128,252,115,149,253,223,144,170,166,9,128,252,115,149,253,207,169,106,166,53,32,255,255,171,90,138,214,32,255,127,35,167,90,38,90,3,242,255,115,170,101,93,2,32,255,175,90,214,128,252,141,156,90,169,125,3,200,63,17,
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63,0,0,170,104,255,55,242,89,105,165,0,84,245,192,128,138,246,63,151,13,170,61,119,85,149,10,3,91,89,63,0,128,240,137,157,87,95,14,170,149,245,3,0,32,87,85,53,2,95,38,0,200,85,223,15,166,94,10,0,85,255,167,168,245,140,94,10,128,104,86,101,3,0,127,87,90,14,60,136,102,149,53,0,140,104,255,102,85,15,60,136,182,86,245,240,85,169,48,38,0,140,104,255,105,85,15,255,207,12,90,157,234,165,0,85,87,15,195,168,94,10,0,17,

};
