const char GameTiles[] PROGMEM ={
/* tile 0 */

  0x5B,0x5B,0x52,0x5B,0x5B,0x52,0x52,0x09,
  0x5B,0x52,0xA4,0x52,0x52,0xA4,0xA4,0x52,
  0x52,0xA4,0x5B,0x52,0xA4,0x5B,0x5B,0x5B,
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  0x52,0x5B,0x5B,0x5B,0x52,0xA4,0xA4,0x52,
/* tile 1 */

  0x09,0x52,0xA4,0xA4,0x5B,0x52,0x5B,0x5B,
  0x52,0xA4,0x5B,0x5B,0x5B,0x52,0x5B,0x5B,
  0x52,0xA4,0x5B,0x5B,0x5B,0x5B,0x52,0x52,
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  0x5B,0x5B,0x52,0x5B,0x5B,0x5B,0x52,0x52,
/* tile 2 */

  0x52,0x5B,0x5B,0x52,0xA4,0x5B,0x5B,0x5B,
  0xA4,0x52,0x52,0x52,0x5B,0x5B,0x5B,0x52,
  0xA4,0x5B,0x5B,0x52,0x5B,0x5B,0x52,0xA4,
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  0x5B,0x5B,0x52,0x5B,0x5B,0x5B,0x52,0x5B,
/* tile 3 */

  0x52,0x52,0x52,0x5B,0x5B,0x5B,0x5B,0x52,
  0xA4,0xA4,0xA4,0x52,0x5B,0x5B,0x5B,0x52,
  0x5B,0x5B,0x5B,0x52,0x52,0x5B,0x5B,0x52,
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  0x5B,0x5B,0x52,0x52,0x52,0x52,0xA4,0x5B,
/* tile 4 */

  0x00,0x00,0x00,0x00,0x00,0x00,0x00,0x00,
  0x00,0x00,0x89,0x89,0x89,0x89,0x89,0x00,
  0x00,0x89,0x92,0x92,0x92,0x92,0x89,0x92,
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  0x00,0x00,0x9B,0x9B,0x92,0x92,0x92,0x92,
/* tile 5 */

  0x00,0x00,0x00,0x00,0x00,0x00,0x00,0x00,
  0x89,0x89,0x89,0x89,0x89,0x89,0x89,0x89,
  0x92,0x92,0x92,0x92,0x92,0x92,0x92,0x92,
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  0x92,0x92,0x92,0x92,0x92,0x92,0x92,0x92,
/* tile 6 */

  0x00,0x92,0x92,0x92,0x92,0x92,0x92,0x92,
  0x00,0x89,0x92,0x92,0x92,0x92,0x92,0x92,
  0x00,0x89,0x92,0x92,0x92,0x92,0x92,0x92,
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  0x00,0x89,0x92,0x92,0x92,0x92,0x92,0x92,
/* tile 7 */

  0x92,0x92,0x92,0x92,0x92,0x92,0x89,0x89,
  0x92,0x92,0x92,0x92,0x89,0x89,0x9B,0x9B,
  0x92,0x92,0x92,0x89,0x9B,0x9B,0x92,0x92,
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  0x89,0x9B,0x92,0x92,0x92,0x92,0x92,0x92,
/* tile 8 */

  0x00,0x00,0x00,0x00,0x00,0x00,0x00,0x00,
  0x00,0x00,0x89,0x89,0x89,0x89,0x89,0x00,
  0x00,0x89,0x92,0x92,0x92,0x92,0x89,0x92,
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  0x00,0x00,0x9B,0x9B,0x92,0x3F,0x3F,0x3F,
/* tile 9 */

  0x00,0x00,0x00,0x00,0x00,0x00,0x00,0x00,
  0x89,0x89,0x89,0x89,0x89,0x89,0x89,0x89,
  0x92,0x92,0x92,0x92,0x92,0x92,0x92,0x92,
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  0x3F,0x3F,0x3F,0x92,0x92,0x92,0x92,0x92,
/* tile 10 */

  0x00,0x92,0x92,0x92,0x92,0x3F,0x3F,0x3F,
  0x00,0x89,0x92,0x92,0x92,0x92,0x3F,0x3F,
  0x00,0x89,0x92,0x92,0x92,0x92,0x92,0x3F,
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  0x00,0x89,0x92,0x92,0x92,0x92,0x92,0x92,
/* tile 11 */

  0x3F,0x3F,0x3F,0x92,0x92,0x92,0x89,0x89,
  0x3F,0x3F,0x92,0x92,0x89,0x89,0x9B,0x9B,
  0x3F,0x92,0x92,0x89,0x9B,0x9B,0x92,0x92,
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  0x89,0x9B,0x92,0x92,0x92,0x92,0x92,0x92,
/* tile 12 */

  0x09,0x09,0x09,0x09,0x09,0x09,0x09,0x09,
  0x09,0x2E,0x2E,0x2E,0x2E,0x2E,0x2E,0x2E,
  0x09,0x2E,0x1C,0x1C,0x1C,0x1C,0x1C,0x1C,
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  0x09,0x2E,0x1C,0x1C,0x1C,0x1C,0x2E,0x1C,
/* tile 13 */

  0x09,0x09,0x09,0x09,0x09,0x09,0x09,0x09,
  0x2E,0x2E,0x2E,0x2E,0x2E,0x2E,0x13,0x09,
  0x1C,0x1C,0x1C,0x2E,0x1C,0x2E,0x13,0x09,
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  0x13,0x1C,0x1C,0x1C,0x1C,0x2E,0x13,0x09,
/* tile 14 */

  0x09,0x2E,0x1C,0x1C,0x1C,0x2E,0x1C,0x13,
  0x09,0x2E,0x13,0x13,0x2E,0x1C,0x13,0x13,
  0x09,0x2E,0x1C,0x2E,0x1C,0x13,0x1C,0x1C,
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  0x09,0x09,0x09,0x09,0x09,0x09,0x09,0x09,
/* tile 15 */

  0x1C,0x1C,0x1C,0x1C,0x1C,0x2E,0x13,0x09,
  0x13,0x13,0x13,0x13,0x13,0x2E,0x13,0x09,
  0x1C,0x1C,0x1C,0x1C,0x1C,0x2E,0x13,0x09,
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  0x09,0x09,0x09,0x09,0x09,0x09,0x09,0x09,
/* tile 16 */

  0x01,0x01,0x01,0x01,0x01,0x01,0x01,0x01,
  0x01,0x17,0x17,0x17,0x17,0x17,0x17,0x17,
  0x01,0x17,0x06,0x06,0x06,0x06,0x06,0x06,
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  0x01,0x17,0x06,0x06,0x06,0x06,0x17,0x06,
/* tile 17 */

  0x01,0x01,0x01,0x01,0x01,0x01,0x01,0x01,
  0x17,0x17,0x17,0x17,0x17,0x17,0x02,0x01,
  0x06,0x06,0x06,0x17,0x06,0x17,0x02,0x01,
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  0x02,0x06,0x06,0x06,0x06,0x17,0x02,0x01,
/* tile 18 */

  0x01,0x17,0x06,0x06,0x06,0x17,0x06,0x02,
  0x01,0x17,0x02,0x02,0x17,0x06,0x02,0x02,
  0x01,0x17,0x06,0x17,0x06,0x02,0x06,0x06,
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  0x01,0x01,0x01,0x01,0x01,0x01,0x01,0x01,
/* tile 19 */

  0x06,0x06,0x06,0x06,0x06,0x17,0x02,0x01,
  0x02,0x02,0x02,0x02,0x02,0x17,0x02,0x01,
  0x06,0x06,0x06,0x06,0x06,0x17,0x02,0x01,
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  0x01,0x01,0x01,0x01,0x01,0x01,0x01,0x01,
/* tile 20 */

  0x53,0x53,0x53,0x53,0x53,0x53,0x53,0x53,
  0x53,0xAE,0xAE,0xAE,0xAE,0xAE,0xAE,0xAE,
  0x53,0xAE,0xAE,0xAE,0xAE,0xAE,0xAE,0xAE,
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  0x53,0xAE,0xAE,0xA5,0xA5,0xA5,0xA5,0xA5,
/* tile 21 */

  0x53,0x53,0x53,0x53,0x53,0x53,0x53,0x53,
  0xAE,0xAE,0xAE,0xAE,0xAE,0xAE,0xA5,0x53,
  0xAE,0xAE,0xAE,0xAE,0xAE,0xA5,0x5C,0x53,
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  0xAE,0x5C,0x5C,0xA5,0xA5,0x5C,0x5C,0x53,
/* tile 22 */

  0x53,0xAE,0xAE,0xAE,0xA5,0xA5,0xA5,0xAE,
  0x53,0xAE,0xAE,0xA5,0xAE,0xAE,0xAE,0xA5,
  0x53,0xAE,0xAE,0xAE,0xA5,0xA5,0xA5,0xA5,
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  0x53,0x53,0x53,0x53,0x53,0x53,0x53,0x53,
/* tile 23 */

  0xAE,0xA5,0x5C,0x5C,0x5C,0x53,0x53,0x53,
  0xA5,0xAE,0xA5,0x5C,0x5C,0x53,0x53,0x53,
  0xA5,0x5C,0x5C,0xA5,0xA5,0x5C,0x5C,0x53,
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  0x53,0x53,0x53,0x53,0x53,0x53,0x53,0x53,
/* tile 24 */

  0x1B,0x5C,0x1B,0x5C,0x5C,0x5C,0x5C,0x13,
  0x1B,0x1B,0x5C,0x1B,0x5C,0x5C,0x5C,0x13,
  0x1B,0x5C,0x5C,0x5C,0x1B,0x5C,0x5C,0x13,
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  0x5C,0x5C,0x1B,0x5C,0x5C,0x13,0x1B,0x5C,
/* tile 25 */

  0x1B,0x5C,0x1B,0x5C,0x5C,0x5C,0x5C,0x13,
  0x1B,0x1B,0x5C,0x1B,0x5C,0x5C,0x5C,0x13,
  0x1B,0x5C,0x5C,0x1B,0x1B,0x5C,0x5C,0x13,
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  0x5C,0x5C,0x1B,0x5C,0x5C,0x13,0x1B,0x5C,
/* tile 26 */

  0x5C,0x5C,0x5C,0x5C,0x13,0x1B,0x13,0x1B,
  0x5C,0x5C,0x5C,0x13,0x1B,0x13,0x1B,0x5C,
  0x5C,0x5C,0x13,0x13,0x1B,0x1B,0x5C,0x1B,
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  0x13,0x1B,0x1B,0x5C,0x1B,0x5C,0x5C,0x5C,
/* tile 27 */

  0x5C,0x5C,0x5C,0x5C,0x13,0x1B,0x13,0x1B,
  0x1B,0x5C,0x1B,0x13,0x1B,0x5C,0x1B,0x5C,
  0x5C,0x5C,0x13,0x13,0x1B,0x1B,0x5C,0x1B,
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  0x13,0x1B,0x1B,0x5C,0x1B,0x5C,0x5C,0x1B,
/* tile 28 */

  0x01,0x01,0x01,0x01,0x01,0x01,0x01,0x01,
  0x01,0x18,0x18,0x18,0x18,0x10,0x01,0x01,
  0x01,0x18,0x10,0x10,0x10,0x10,0x10,0x01,
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  0x10,0x10,0x01,0x01,0x01,0x10,0x10,0x10,
/* tile 29 */

  0x01,0x01,0x01,0x01,0x01,0x01,0x01,0x01,
  0x18,0x18,0x18,0x18,0x18,0x18,0x10,0x10,
  0x18,0x10,0x10,0x10,0x10,0x10,0x10,0x10,
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  0x10,0x10,0x01,0x10,0x10,0x10,0x10,0x01,
/* tile 30 */

  0x01,0x01,0x01,0x01,0x01,0x01,0x01,0x01,
  0x18,0x10,0x18,0x10,0x10,0x01,0x18,0x18,
  0x10,0x10,0x10,0x10,0x10,0x01,0x18,0x10,
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  0x01,0x01,0x10,0x10,0x10,0x10,0x10,0x10,
/* tile 31 */

  0x01,0x01,0x01,0x01,0x01,0x01,0x01,0x01,
  0x18,0x18,0x10,0x10,0x01,0x10,0x18,0x18,
  0x10,0x10,0x10,0x10,0x01,0x10,0x18,0x10,
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  0x01,0x01,0x01,0x10,0x10,0x10,0x10,0x01,
/* tile 32 */

  0x01,0x01,0x01,0x01,0x01,0x01,0x01,0x01,
  0x01,0x18,0x18,0x18,0x18,0x10,0x01,0x01,
  0x01,0x18,0x10,0x10,0x10,0x10,0x10,0x01,
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  0x10,0x10,0x01,0x01,0x01,0x37,0x37,0x37,
/* tile 33 */

  0x01,0x01,0x01,0x01,0x01,0x01,0x01,0x01,
  0x18,0x18,0x18,0x18,0x18,0x18,0x10,0x10,
  0x18,0x10,0x10,0x10,0x10,0x10,0x10,0x10,
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  0x37,0x37,0x37,0x10,0x10,0x10,0x10,0x01,
/* tile 34 */

  0x01,0x01,0x01,0x01,0x01,0x37,0x37,0x37,
  0x18,0x10,0x18,0x10,0x10,0x01,0x37,0x37,
  0x10,0x10,0x10,0x10,0x10,0x01,0x18,0x37,
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  0x01,0x01,0x10,0x10,0x10,0x10,0x10,0x10,
/* tile 35 */

  0x37,0x37,0x37,0x01,0x01,0x01,0x01,0x01,
  0x37,0x37,0x10,0x10,0x01,0x10,0x18,0x18,
  0x37,0x10,0x10,0x10,0x01,0x10,0x18,0x10,
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  0x01,0x01,0x01,0x10,0x10,0x10,0x10,0x01,
/* tile 36 */

  0x00,0x00,0x00,0x00,0x00,0x00,0x00,0x00,
  0x00,0x76,0x76,0x76,0x76,0x76,0x76,0x76,
  0x00,0x76,0x1B,0x1B,0x6D,0x6D,0x1B,0x1B,
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  0x00,0x76,0x1B,0x24,0x1B,0x6D,0x6D,0x1B,
/* tile 37 */

  0x00,0x00,0x00,0x00,0x00,0x00,0x00,0x00,
  0x76,0x76,0x76,0x76,0x76,0x6D,0x1B,0x00,
  0x1B,0x6D,0x6D,0x1B,0x6D,0x24,0x1B,0x00,
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  0x24,0x24,0x24,0x6D,0x6D,0x24,0x1B,0x00,
/* tile 38 */

  0x00,0x76,0x24,0x24,0x24,0x6D,0x6D,0x1B,
  0x00,0x76,0x6D,0x6D,0x6D,0x6D,0x6D,0x1B,
  0x00,0x76,0x1B,0x1B,0x1B,0x6D,0x1B,0x6D,
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  0x00,0x00,0x00,0x00,0x00,0x00,0x00,0x00,
/* tile 39 */

  0x24,0x24,0x24,0x1B,0x6D,0x24,0x1B,0x00,
  0x1B,0x24,0x24,0x24,0x6D,0x24,0x1B,0x00,
  0x1B,0x6D,0x24,0x24,0x6D,0x24,0x1B,0x00,
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  0x00,0x00,0x00,0x00,0x00,0x00,0x00,0x00,
/* tile 40 */

  0x01,0x01,0x01,0x01,0x01,0x01,0x01,0x01,
  0x01,0x17,0x17,0x17,0x17,0x17,0x17,0x17,
  0x01,0x17,0x01,0x01,0x06,0x06,0x01,0x01,
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  0x01,0x17,0x01,0x02,0x01,0x06,0x06,0x01,
/* tile 41 */

  0x01,0x01,0x01,0x01,0x01,0x01,0x01,0x01,
  0x17,0x17,0x17,0x17,0x17,0x06,0x01,0x01,
  0x01,0x06,0x06,0x01,0x06,0x02,0x01,0x01,
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  0x02,0x02,0x02,0x06,0x06,0x02,0x01,0x01,
/* tile 42 */

  0x01,0x17,0x02,0x02,0x02,0x06,0x06,0x01,
  0x01,0x17,0x06,0x06,0x06,0x06,0x06,0x01,
  0x01,0x17,0x01,0x01,0x01,0x06,0x01,0x06,
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  0x01,0x01,0x01,0x01,0x01,0x01,0x01,0x01,
/* tile 43 */

  0x02,0x02,0x02,0x01,0x06,0x02,0x01,0x01,
  0x01,0x02,0x02,0x02,0x06,0x02,0x01,0x01,
  0x01,0x06,0x02,0x02,0x06,0x02,0x01,0x01,
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  0x01,0x01,0x01,0x01,0x01,0x01,0x01,0x01,
/* tile 44 */

  0x26,0x26,0x26,0x26,0x1C,0x01,0x26,0x26,
  0x26,0x26,0x26,0x26,0x1C,0x01,0x26,0x26,
  0x26,0x26,0x1C,0x1C,0x13,0x01,0x26,0x1C,
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  0x01,0x01,0x01,0x01,0x01,0x01,0x01,0x01,
/* tile 45 */

  0x26,0x26,0x26,0x26,0x26,0x26,0x1C,0x01,
  0x26,0x26,0x26,0x26,0x26,0x1C,0x13,0x01,
  0x1C,0x1C,0x1C,0x1C,0x1C,0x13,0x13,0x01,
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  0x01,0x01,0x01,0x01,0x01,0x01,0x01,0x01,
/* tile 46 */

  0x26,0x26,0x26,0x26,0x26,0x26,0x26,0x26,
  0x26,0x26,0x1C,0x1C,0x1C,0x1C,0x1C,0x1C,
  0x26,0x26,0x1C,0x1C,0x1C,0x1C,0x1C,0x1C,
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  0x01,0x01,0x01,0x01,0x01,0x01,0x01,0x01,
/* tile 47 */

  0x26,0x1C,0x01,0x26,0x26,0x26,0x1C,0x01,
  0x1C,0x13,0x01,0x26,0x1C,0x1C,0x13,0x01,
  0x1C,0x13,0x01,0x26,0x1C,0x13,0x13,0x01,
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  0x01,0x01,0x01,0x01,0x01,0x01,0x01,0x01,
/* tile 48 */

  0x0B,0x0B,0x0B,0x0B,0x0A,0x0B,0x0B,0x14,
  0x0B,0x0B,0x14,0x0B,0x0B,0x0B,0x0B,0x0A,
  0x14,0x0B,0x0A,0x0A,0x0B,0x0B,0x0B,0x0B,
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  0x0B,0x0A,0x0B,0x0A,0x14,0x0B,0x0B,0x0B,
/* tile 49 */

  0x0A,0x0B,0x0B,0x0B,0x0A,0x0B,0x0B,0x14,
  0x0B,0x0B,0x14,0x0B,0x0B,0x0B,0x0B,0x0A,
  0x14,0x0B,0x0A,0x0B,0x0B,0x0B,0x0B,0x0A,
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  0x0B,0x0A,0x0B,0x0B,0x14,0x0B,0x0B,0x0B,
/* tile 50 */

  0x0B,0x0B,0x0A,0x0B,0x0A,0x0B,0x0B,0x14,
  0x0B,0x0B,0x14,0x0B,0x0B,0x0B,0x0B,0x0A,
  0x14,0x0B,0x0A,0x0B,0x0B,0x0B,0x0B,0x0B,
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  0x0B,0x0A,0x0B,0x0B,0x14,0x0B,0x0B,0x0B,
/* tile 51 */

  0x0B,0x0B,0x0B,0x0B,0x0A,0x0B,0x0A,0x14,
  0x0B,0x0B,0x14,0x0B,0x0B,0x0B,0x0B,0x0A,
  0x14,0x0B,0x0A,0x0B,0x0B,0x0B,0x0B,0x0B,
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  0x0B,0x0A,0x0B,0x0B,0x14,0x0A,0x0B,0x0B,
/* tile 52 */

  0x00,0x00,0x00,0x00,0x00,0x00,0x00,0x00,
  0x00,0x08,0x08,0x08,0x08,0x08,0x08,0x08,
  0x00,0x08,0x11,0x11,0x11,0x11,0x11,0x11,
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  0x00,0x08,0x11,0x11,0x11,0x11,0x11,0x11,
/* tile 53 */

  0x00,0x00,0x00,0x00,0x00,0x00,0x00,0x00,
  0x08,0x08,0x08,0x08,0x08,0x08,0x08,0x08,
  0x11,0x11,0x11,0x11,0x11,0x11,0x11,0x11,
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  0x11,0x11,0x11,0x11,0x11,0x11,0x11,0x11,
/* tile 54 */

  0x00,0x08,0x11,0x12,0x12,0x12,0x12,0x12,
  0x00,0x08,0x11,0x12,0x11,0x11,0x11,0x12,
  0x00,0x08,0x11,0x12,0x12,0x12,0x12,0x12,
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  0x00,0x08,0x11,0x11,0x11,0x11,0x11,0x11,
/* tile 55 */

  0x11,0x12,0x12,0x12,0x12,0x12,0x11,0x11,
  0x11,0x12,0x11,0x11,0x11,0x12,0x11,0x11,
  0x11,0x12,0x12,0x12,0x12,0x12,0x11,0x11,
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  0x11,0x11,0x11,0x11,0x11,0x11,0x11,0x11,
/* tile 56 */

  0x00,0x00,0x00,0x00,0x00,0x00,0x00,0x00,
  0x00,0x08,0x08,0x08,0x08,0x08,0x08,0x08,
  0x00,0x08,0x11,0x11,0x11,0x11,0x11,0x11,
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  0x00,0x08,0x11,0x11,0x11,0x3F,0x3F,0x3F,
/* tile 57 */

  0x00,0x00,0x00,0x00,0x00,0x00,0x00,0x00,
  0x08,0x08,0x08,0x08,0x08,0x08,0x08,0x08,
  0x11,0x11,0x11,0x11,0x11,0x11,0x11,0x11,
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  0x3F,0x3F,0x3F,0x11,0x11,0x11,0x11,0x11,
/* tile 58 */

  0x00,0x08,0x11,0x12,0x12,0x3F,0x3F,0x3F,
  0x00,0x08,0x11,0x12,0x11,0x11,0x3F,0x3F,
  0x00,0x08,0x11,0x12,0x12,0x12,0x12,0x3F,
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  0x00,0x08,0x11,0x11,0x11,0x11,0x11,0x11,
/* tile 59 */

  0x3F,0x3F,0x3F,0x12,0x12,0x12,0x11,0x11,
  0x3F,0x3F,0x11,0x11,0x11,0x12,0x11,0x11,
  0x3F,0x12,0x12,0x12,0x12,0x12,0x11,0x11,
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  0x11,0x11,0x11,0x11,0x11,0x11,0x11,0x11,
/* tile 60 */

  0x08,0x08,0x08,0x08,0x08,0x08,0x08,0x08,
  0x08,0xF6,0xF6,0xF6,0xF6,0xF6,0xF6,0xF6,
  0x08,0xF6,0xAD,0xAD,0xAD,0xAD,0x5A,0x5A,
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  0x08,0xF6,0x5A,0x5A,0x5A,0xAD,0x08,0xAD,
/* tile 61 */

  0x08,0x08,0x08,0x08,0x08,0x08,0x08,0x08,
  0xF6,0xF6,0xF6,0xF6,0xF6,0xAD,0x5A,0x08,
  0x5A,0xAD,0xAD,0xAD,0xAD,0xAD,0x5A,0x08,
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  0x08,0xAD,0x5A,0x5A,0x5A,0xAD,0x5A,0x08,
/* tile 62 */

  0x08,0xF6,0x5A,0xAD,0x5A,0xAD,0x5A,0x08,
  0x08,0xF6,0xAD,0x5A,0xAD,0x5A,0xAD,0xAD,
  0x08,0xF6,0xAD,0x5A,0xAD,0xAD,0x5A,0x5A,
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  0x08,0x08,0x08,0x08,0x08,0x08,0x08,0x08,
/* tile 63 */

  0x5A,0xAD,0x5A,0xAD,0x5A,0xAD,0x5A,0x08,
  0xAD,0x5A,0xAD,0x5A,0xAD,0xAD,0x5A,0x08,
  0x5A,0xAD,0xAD,0x5A,0xAD,0xAD,0x5A,0x08,
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  0x08,0x08,0x08,0x08,0x08,0x08,0x08,0x08,
/* tile 64 */

  0x01,0x01,0x01,0x01,0x01,0x01,0x01,0x01,
  0x01,0x17,0x17,0x17,0x17,0x17,0x17,0x17,
  0x01,0x17,0x07,0x07,0x07,0x07,0x02,0x02,
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  0x01,0x17,0x02,0x02,0x02,0x07,0x02,0x07,
/* tile 65 */

  0x01,0x01,0x01,0x01,0x01,0x01,0x01,0x01,
  0x17,0x17,0x17,0x17,0x17,0x07,0x02,0x01,
  0x02,0x07,0x07,0x07,0x07,0x07,0x02,0x01,
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  0x02,0x07,0x02,0x02,0x02,0x07,0x02,0x01,
/* tile 66 */

  0x01,0x17,0x02,0x07,0x02,0x07,0x02,0x02,
  0x01,0x17,0x07,0x02,0x07,0x02,0x07,0x07,
  0x01,0x17,0x07,0x02,0x07,0x07,0x02,0x02,
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  0x01,0x01,0x01,0x01,0x01,0x01,0x01,0x01,
/* tile 67 */

  0x02,0x07,0x02,0x07,0x02,0x07,0x02,0x01,
  0x07,0x02,0x07,0x02,0x07,0x07,0x02,0x01,
  0x02,0x07,0x07,0x02,0x07,0x07,0x02,0x01,
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  0x01,0x01,0x01,0x01,0x01,0x01,0x01,0x01,
/* tile 68 */

  0x25,0x25,0x25,0x25,0x25,0x25,0x25,0x25,
  0x1C,0x25,0x25,0x25,0x25,0x25,0x25,0x25,
  0x1C,0x1C,0x1C,0x25,0x1C,0x25,0x25,0x25,
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  0x1C,0x1C,0x1C,0x25,0x1C,0x25,0x25,0x25,
/* tile 69 */

  0x25,0x25,0x25,0x25,0x25,0x25,0x1C,0x00,
  0x25,0x25,0x25,0x25,0x1C,0x1C,0x13,0x00,
  0x1C,0x1C,0x1C,0x1C,0x13,0x0A,0x00,0x00,
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  0x1C,0x13,0x1C,0x13,0x13,0x0A,0x00,0x00,
/* tile 70 */

  0x1C,0x1C,0x1C,0x25,0x1C,0x25,0x25,0x25,
  0x1C,0x1C,0x1C,0x25,0x1C,0x25,0x25,0x25,
  0x1C,0x1C,0x1C,0x25,0x1C,0x25,0x25,0x25,
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  0x00,0x00,0x00,0x00,0x00,0x00,0x00,0x00,
/* tile 71 */

  0x1C,0x13,0x1C,0x13,0x13,0x0A,0x00,0x00,
  0x1C,0x13,0x1C,0x13,0x13,0x0A,0x00,0x00,
  0x1C,0x13,0x1C,0x13,0x13,0x0A,0x00,0x00,
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  0x00,0x00,0x00,0x00,0x00,0x00,0x00,0x00,
/* tile 72 */

  0x51,0x5B,0x51,0x5B,0x51,0x51,0x5B,0x5B,
  0x5B,0x51,0x51,0x5B,0x51,0x51,0x51,0x5B,
  0x51,0x5B,0x5B,0x5B,0x51,0x51,0x5B,0x51,
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  0x51,0x5B,0x5B,0x5B,0x51,0x5B,0x51,0x5B,
/* tile 73 */

  0x51,0x51,0x5B,0x51,0x51,0x5B,0x51,0x51,
  0x51,0x51,0x5B,0x51,0x5B,0x5B,0x5B,0x51,
  0x5B,0x5B,0x5B,0x5B,0x5B,0x5B,0x5B,0x5B,
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  0x51,0x5B,0x5B,0x5B,0x5B,0x5B,0x5B,0x5B,
/* tile 74 */

  0x5B,0x51,0x51,0x5B,0x5B,0x51,0x5B,0x5B,
  0x5B,0x5B,0x51,0x51,0x5B,0x5B,0x5B,0x51,
  0x51,0x5B,0x5B,0x5B,0x5B,0x51,0x5B,0x5B,
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  0x51,0x5B,0x5B,0x51,0x51,0x5B,0x5B,0x51,
/* tile 75 */

  0x5B,0x5B,0x51,0x5B,0x5B,0x51,0x51,0x51,
  0x5B,0x51,0x5B,0x5B,0x51,0x51,0x5B,0x5B,
  0x5B,0x5B,0x5B,0x51,0x51,0x5B,0x5B,0x51,
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  0x5B,0x51,0x51,0x5B,0x51,0x5B,0x5B,0x51,
/* tile 76 */

  0x49,0x49,0x49,0x49,0x49,0x49,0x49,0x49,
  0xDA,0xDA,0xDA,0xDA,0xDA,0xDA,0xDA,0xDA,
  0xDA,0xDA,0xDA,0xDA,0xDA,0xDA,0xDA,0xDA,
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  0xDA,0xDA,0xEB,0xF4,0xF4,0xF4,0xEB,0xF4,
/* tile 77 */

  0x49,0x49,0x49,0x49,0x49,0x49,0x49,0x49,
  0xDA,0xDA,0xDA,0xDA,0xDA,0xDA,0xDA,0x49,
  0xDA,0xDA,0xDA,0xDA,0xDA,0xDA,0xDA,0x49,
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  0xF4,0xEB,0xEB,0xEB,0xF4,0xF4,0xF4,0x49,
/* tile 78 */

  0xDA,0xDA,0xEB,0xF4,0xF4,0xEB,0xF4,0xF4,
  0xDA,0xDA,0xEB,0xF4,0xEB,0xF4,0xF4,0xEB,
  0xDA,0xDA,0xEB,0xEB,0xF4,0xF4,0xEB,0xEB,
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  0xDA,0xDA,0xEB,0xEB,0xF4,0xF4,0xF4,0xEB,
/* tile 79 */

  0xEB,0xEB,0xEB,0xF4,0xF4,0xF4,0xEB,0x49,
  0xEB,0xEB,0xF4,0xF4,0xF4,0xEB,0xEB,0x49,
  0xEB,0xF4,0xF4,0xF4,0xEB,0xEB,0xEB,0x49,
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  0xEB,0xEB,0xEB,0xEB,0xEB,0xEB,0xEB,0x49,
/* tile 80 */

  0x49,0x49,0x49,0x49,0x49,0x49,0x49,0x49,
  0xDA,0xDA,0xDA,0xDA,0xDA,0xDA,0xDA,0xDA,
  0xDA,0xDA,0xDA,0xDA,0xDA,0xDA,0xDA,0xDA,
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  0xDA,0xDA,0xEB,0xF4,0x3F,0x3F,0x3F,0x3F,
/* tile 81 */

  0x49,0x49,0x49,0x49,0x49,0x49,0x49,0x49,
  0xDA,0xDA,0xDA,0xDA,0xDA,0xDA,0xDA,0x49,
  0xDA,0xDA,0xDA,0xDA,0xDA,0xDA,0xDA,0x49,
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  0x3F,0x3F,0xEB,0xEB,0xF4,0xF4,0xF4,0x49,
/* tile 82 */

  0xDA,0xDA,0xEB,0xF4,0x3F,0x3F,0x3F,0x3F,
  0xDA,0xDA,0xEB,0xF4,0xEB,0x3F,0x3F,0x3F,
  0xDA,0xDA,0xEB,0xEB,0xF4,0xF4,0x3F,0x3F,
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  0xDA,0xDA,0xEB,0xEB,0xF4,0xF4,0xF4,0xEB,
/* tile 83 */

  0x3F,0x3F,0xEB,0xF4,0xF4,0xF4,0xEB,0x49,
  0x3F,0xEB,0xF4,0xF4,0xF4,0xEB,0xEB,0x49,
  0xEB,0xF4,0xF4,0xF4,0xEB,0xEB,0xEB,0x49,
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  0xEB,0xEB,0xEB,0xEB,0xEB,0xEB,0xEB,0x49,
/* tile 84 */

  0x49,0x49,0x49,0x49,0x49,0x49,0x49,0x49,
  0x49,0xFF,0xFF,0xFF,0xFF,0xFF,0xFF,0xFF,
  0x49,0xFF,0xAD,0xAD,0xAD,0xAD,0xAD,0xAD,
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  0x49,0xAD,0x9B,0x9B,0x9B,0x9B,0x9B,0x9B,
/* tile 85 */

  0x49,0x49,0x49,0x49,0x49,0x49,0x49,0x49,
  0xFF,0xFF,0xFF,0xFF,0xFF,0xFF,0xAD,0x49,
  0x9B,0xAD,0xAD,0xAD,0xAD,0xAD,0x9B,0x49,
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  0x9B,0x9B,0x9B,0x9B,0x9B,0x9B,0x9B,0x49,
/* tile 86 */

  0x49,0xFF,0xAD,0xAD,0xAD,0xAD,0xAD,0xAD,
  0x49,0xFF,0xAD,0xAD,0xAD,0xAD,0xAD,0xAD,
  0x49,0xFF,0xAD,0xAD,0xAD,0xAD,0xAD,0xAD,
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  0x49,0x49,0x49,0x49,0x49,0x49,0x49,0x49,
/* tile 87 */

  0x9B,0xAD,0xAD,0xAD,0xAD,0xAD,0x9B,0x49,
  0x9B,0xAD,0xAD,0xAD,0xAD,0xAD,0x9B,0x49,
  0x9B,0xAD,0xAD,0xAD,0xAD,0xAD,0x9B,0x49,
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  0x49,0x49,0x49,0x49,0x49,0x49,0x49,0x49,
/* tile 88 */

  0x01,0x01,0x01,0x01,0x01,0x01,0x01,0x01,
  0x01,0x17,0x17,0x17,0x17,0x17,0x17,0x17,
  0x01,0x17,0x06,0x06,0x06,0x06,0x06,0x06,
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  0x01,0x06,0x02,0x02,0x02,0x02,0x02,0x02,
/* tile 89 */

  0x01,0x01,0x01,0x01,0x01,0x01,0x01,0x01,
  0x17,0x17,0x17,0x17,0x17,0x17,0x06,0x01,
  0x02,0x06,0x06,0x06,0x06,0x06,0x02,0x01,
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  0x02,0x02,0x02,0x02,0x02,0x02,0x02,0x01,
/* tile 90 */

  0x01,0x17,0x06,0x06,0x06,0x06,0x06,0x06,
  0x01,0x17,0x06,0x06,0x06,0x06,0x06,0x06,
  0x01,0x17,0x06,0x06,0x06,0x06,0x06,0x06,
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  0x01,0x01,0x01,0x01,0x01,0x01,0x01,0x01,
/* tile 91 */

  0x02,0x06,0x06,0x06,0x06,0x06,0x02,0x01,
  0x02,0x06,0x06,0x06,0x06,0x06,0x02,0x01,
  0x02,0x06,0x06,0x06,0x06,0x06,0x02,0x01,
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  0x01,0x01,0x01,0x01,0x01,0x01,0x01,0x01,
/* tile 92 */

  0xE4,0xE4,0xE4,0xE4,0xE4,0xE4,0xE4,0xE4,
  0xE4,0xE4,0xE4,0xDB,0xE4,0xDB,0xE4,0xDB,
  0xE4,0xE4,0xDB,0xE4,0xDB,0xDB,0xDB,0xE4,
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  0x89,0x89,0x89,0x89,0x89,0x89,0x89,0x89,
/* tile 93 */

  0xE4,0xE4,0xE4,0xE4,0xE4,0xE4,0xDB,0x89,
  0xE4,0xDB,0xE4,0xDB,0xE4,0xDB,0x92,0x89,
  0xDB,0xDB,0xDB,0xE4,0xDB,0x92,0x92,0x89,
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  0x89,0x89,0x89,0x89,0x89,0x89,0x89,0x89,
/* tile 94 */

  0xE4,0xE4,0xE4,0xE4,0xE4,0xE4,0xDB,0x89,
  0xE4,0xDB,0xE4,0xDB,0xE4,0xDB,0x92,0x89,
  0xDB,0xDB,0xDB,0xE4,0xDB,0x92,0x92,0x89,
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  0x89,0x89,0x89,0x89,0x89,0x89,0x89,0x89,
/* tile 95 */

  0xE4,0xE4,0xE4,0xE4,0xE4,0xE4,0xE4,0xE4,
  0xE4,0xE4,0xE4,0xDB,0xE4,0xDB,0xE4,0xDB,
  0xE4,0xE4,0xDB,0xE4,0xDB,0xDB,0xDB,0xE4,
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  0x89,0x89,0x89,0x89,0x89,0x89,0x89,0x89,
/* tile 96 */

  0x18,0x18,0x18,0x18,0x10,0x18,0x18,0x1A,
  0x18,0x10,0x1A,0x18,0x18,0x18,0x18,0x10,
  0x1A,0x18,0x10,0x18,0x10,0x18,0x18,0x1A,
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  0x18,0x10,0x1A,0x18,0x1A,0x18,0x18,0x10,
/* tile 97 */

  0x18,0x18,0x18,0x18,0x10,0x18,0x18,0x1A,
  0x18,0x18,0x1A,0x18,0x18,0x18,0x18,0x10,
  0x1A,0x18,0x10,0x18,0x18,0x18,0x18,0x18,
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  0x18,0x10,0x18,0x18,0x1A,0x18,0x18,0x18,
/* tile 98 */

  0x18,0x18,0x18,0x18,0x10,0x18,0x18,0x1A,
  0x18,0x18,0x1A,0x18,0x18,0x18,0x18,0x10,
  0x1A,0x18,0x10,0x18,0x18,0x18,0x10,0x18,
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  0x18,0x10,0x18,0x18,0x1A,0x18,0x18,0x18,
/* tile 99 */

  0x18,0x18,0x18,0x18,0x10,0x18,0x18,0x1A,
  0x18,0x10,0x1A,0x18,0x18,0x18,0x1A,0x10,
  0x1A,0x18,0x10,0x18,0x18,0x10,0x18,0x18,
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  0x18,0x10,0x18,0x18,0x1A,0x18,0x18,0x18,
/* tile 100 */

  0x00,0x00,0x00,0x00,0x00,0x00,0x00,0x00,
  0x00,0x52,0x52,0x52,0x52,0x52,0x52,0x52,
  0x00,0x52,0x49,0x49,0x49,0x49,0x49,0x49,
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  0x49,0x49,0x49,0x49,0x00,0x52,0x49,0x49,
/* tile 101 */

  0x00,0x00,0x00,0x00,0x00,0x00,0x00,0x00,
  0x49,0x52,0x52,0x52,0x52,0x52,0x52,0x52,
  0x00,0x52,0x49,0x49,0x49,0x49,0x49,0x49,
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  0x49,0x49,0x49,0x49,0x00,0x52,0x49,0x49,
/* tile 102 */

  0x49,0x00,0x00,0x00,0x00,0x00,0x00,0x00,
  0x49,0x52,0x52,0x52,0x52,0x52,0x52,0x52,
  0x00,0x52,0x49,0x49,0x49,0x49,0x49,0x49,
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  0x49,0x49,0x49,0x49,0x00,0x52,0x49,0x49,
/* tile 103 */

  0x00,0x00,0x00,0x00,0x49,0x00,0x00,0x00,
  0x49,0x52,0x52,0x52,0x52,0x52,0x52,0x52,
  0x00,0x52,0x49,0x49,0x49,0x49,0x49,0x49,
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  0x49,0x49,0x49,0x49,0x00,0x52,0x49,0x49,
/* tile 104 */

  0x00,0x00,0x00,0x00,0x00,0x00,0x00,0x00,
  0x49,0x52,0x52,0x52,0x52,0x52,0x52,0x52,
  0x00,0x52,0x49,0x49,0x49,0x49,0x49,0x49,
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  0x49,0x49,0x49,0x49,0x00,0x37,0x37,0x37,
/* tile 105 */

  0x00,0x00,0x00,0x00,0x00,0x00,0x00,0x00,
  0x49,0x52,0x52,0x52,0x52,0x52,0x52,0x52,
  0x00,0x52,0x49,0x49,0x49,0x49,0x49,0x49,
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  0x37,0x37,0x37,0x49,0x00,0x52,0x49,0x49,
/* tile 106 */

  0x00,0x00,0x00,0x00,0x00,0x37,0x37,0x37,
  0x49,0x52,0x52,0x52,0x52,0x52,0x37,0x37,
  0x00,0x52,0x49,0x49,0x49,0x49,0x49,0x37,
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  0x49,0x49,0x49,0x49,0x00,0x52,0x49,0x49,
/* tile 107 */

  0x37,0x37,0x37,0x00,0x00,0x00,0x00,0x00,
  0x37,0x37,0x52,0x52,0x52,0x52,0x52,0x52,
  0x37,0x52,0x49,0x49,0x49,0x49,0x49,0x49,
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  0x49,0x49,0x49,0x49,0x00,0x52,0x49,0x49,
/* tile 108 */

  0x0A,0x0A,0x0A,0x0A,0x0A,0x0A,0x0A,0x0A,
  0x0A,0x66,0x14,0x66,0x66,0x66,0x66,0x66,
  0x0A,0x14,0x0A,0x0A,0x0A,0x0A,0x0A,0x0A,
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  0x0A,0x66,0x0A,0x1D,0x14,0x1D,0x66,0x1D,
/* tile 109 */

  0x0A,0x0A,0x0A,0x0A,0x0A,0x0A,0x0A,0x0A,
  0x66,0x66,0x66,0x66,0x0A,0x66,0x14,0x0A,
  0x0A,0x0A,0x0A,0x0A,0x0A,0x14,0x0A,0x0A,
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  0x0A,0x1D,0x14,0x1D,0x0A,0x66,0x14,0x0A,
/* tile 110 */

  0x0A,0x66,0x0A,0x1D,0x14,0x66,0x1D,0x0A,
  0x0A,0x66,0x0A,0x1D,0x66,0x1D,0x0A,0x1D,
  0x0A,0x66,0x0A,0x66,0x1D,0x0A,0x14,0x1D,
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  0x0A,0x0A,0x0A,0x0A,0x0A,0x0A,0x0A,0x0A,
/* tile 111 */

  0x1D,0x66,0x14,0x1D,0x0A,0x66,0x14,0x0A,
  0x0A,0x1D,0x66,0x1D,0x0A,0x66,0x14,0x0A,
  0x14,0x0A,0x1D,0x66,0x0A,0x66,0x14,0x0A,
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  0x0A,0x0A,0x0A,0x0A,0x0A,0x0A,0x0A,0x0A,
/* tile 112 */

  0x01,0x01,0x01,0x01,0x01,0x01,0x01,0x01,
  0x01,0x17,0x02,0x17,0x17,0x17,0x17,0x17,
  0x01,0x02,0x01,0x01,0x01,0x01,0x01,0x01,
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  0x01,0x17,0x01,0x06,0x02,0x06,0x17,0x06,
/* tile 113 */

  0x01,0x01,0x01,0x01,0x01,0x01,0x01,0x01,
  0x17,0x17,0x17,0x17,0x01,0x17,0x02,0x01,
  0x01,0x01,0x01,0x01,0x01,0x02,0x01,0x01,
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  0x01,0x06,0x02,0x06,0x01,0x17,0x02,0x01,
/* tile 114 */

  0x01,0x17,0x01,0x06,0x02,0x17,0x06,0x01,
  0x01,0x17,0x01,0x06,0x17,0x06,0x01,0x06,
  0x01,0x17,0x01,0x17,0x06,0x01,0x02,0x06,
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  0x01,0x01,0x01,0x01,0x01,0x01,0x01,0x01,
/* tile 115 */

  0x06,0x17,0x02,0x06,0x01,0x17,0x02,0x01,
  0x01,0x06,0x17,0x06,0x01,0x17,0x02,0x01,
  0x02,0x01,0x06,0x17,0x01,0x17,0x02,0x01,
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  0x01,0x01,0x01,0x01,0x01,0x01,0x01,0x01,
/* tile 116 */

  0x64,0x64,0x64,0x64,0x64,0x64,0x64,0x64,
  0x64,0x64,0x64,0x64,0x64,0x64,0x64,0x64,
  0x64,0x64,0x5B,0x5B,0x5B,0x5B,0x5B,0x5B,
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  0x09,0x09,0x09,0x09,0x09,0x09,0x09,0x09,
/* tile 117 */

  0x64,0x64,0x64,0x64,0x64,0x64,0x64,0x12,
  0x64,0x64,0x64,0x64,0x64,0x5B,0x12,0x12,
  0x5B,0x5B,0x5B,0x5B,0x5B,0x5B,0x12,0x12,
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  0x09,0x09,0x09,0x09,0x09,0x09,0x09,0x12,
/* tile 118 */

  0x64,0x64,0x64,0x64,0x64,0x64,0x64,0x12,
  0x64,0x64,0x64,0x64,0x5B,0x5B,0x12,0x12,
  0x5B,0x5B,0x5B,0x5B,0x5B,0x5B,0x12,0x12,
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  0x09,0x09,0x09,0x09,0x09,0x09,0x09,0x12,
/* tile 119 */

  0x64,0x64,0x64,0x64,0x64,0x64,0x64,0x64,
  0x64,0x64,0x64,0x64,0x64,0x64,0x64,0x64,
  0x64,0x64,0x5B,0x5B,0x5B,0x5B,0x5B,0x5B,
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  0x09,0x09,0x09,0x09,0x09,0x09,0x09,0x09,
/* tile 120 */

  0xFF,0xFF,0xFF,0xFF,0xFF,0xFF,0xFF,0xFF,
  0xFF,0xFF,0xFF,0xFF,0xFF,0xFF,0xFF,0xFF,
  0x5B,0x5B,0x5B,0x5B,0x5B,0x5B,0x5B,0x5B,
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  0xC0,0xC0,0xC0,0xC0,0xC0,0xC0,0xC0,0xC0,
/* tile 121 */

  0xC0,0xC0,0xC0,0xC0,0xC0,0xC0,0xC0,0xC0,
  0xC0,0xC0,0xC0,0xC0,0xC0,0xC0,0xC0,0xC0,
  0xC0,0xC0,0xC0,0xC0,0xC0,0xC0,0xC0,0xC0,
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  0x5B,0x5B,0x5B,0x5B,0x5B,0x5B,0x5B,0x5B,
/* tile 122 */

  0xFF,0xFF,0x5B,0x80,0x80,0xC0,0xC0,0xC0,
  0xFF,0xFF,0x5B,0x80,0x80,0xC0,0xC0,0xC0,
  0xFF,0xFF,0x5B,0x80,0x80,0xC0,0xC0,0xC0,
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  0xFF,0xFF,0x5B,0x80,0x80,0xC0,0xC0,0xC0,
/* tile 123 */

  0xC0,0xC0,0xC0,0xC0,0xC0,0xFF,0xFF,0x5B,
  0xC0,0xC0,0xC0,0xC0,0xC0,0xFF,0xFF,0x5B,
  0xC0,0xC0,0xC0,0xC0,0xC0,0xFF,0xFF,0x5B,
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  0xC0,0xC0,0xC0,0xC0,0xC0,0xFF,0xFF,0x5B,
/* tile 124 */

  0xFF,0xFF,0x00,0x80,0x80,0xC0,0xC0,0xC0,
  0xFF,0x00,0xF6,0x00,0x00,0xC0,0xC0,0xC0,
  0xFF,0x00,0xF6,0xF6,0xF6,0x00,0xC0,0xC0,
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  0xFF,0xFF,0x5B,0x80,0x80,0xC0,0xC0,0xC0,
/* tile 125 */

  0x00,0x00,0xFF,0xFF,0xFF,0xFF,0xFF,0xFF,
  0x00,0xFF,0xFF,0xFF,0xFF,0xFF,0xFF,0xFF,
  0xFF,0xFF,0xFF,0xFF,0xFF,0x5B,0x5B,0x5B,
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  0xFF,0xFF,0x5B,0x80,0x80,0xC0,0xC0,0xC0,
/* tile 126 */

  0xFF,0xFF,0xFF,0xFF,0xFF,0x5B,0x00,0x00,
  0xFF,0xFF,0xFF,0xFF,0xFF,0x5B,0x5B,0x00,
  0x5B,0x5B,0x5B,0xFF,0xFF,0xFF,0x5B,0x5B,
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  0xC0,0xC0,0xC0,0xC0,0xC0,0xFF,0xFF,0x5B,
/* tile 127 */

  0xFF,0xFF,0x5B,0x80,0x80,0xC0,0xC0,0xC0,
  0xFF,0xFF,0x5B,0x80,0x80,0xC0,0xC0,0xC0,
  0xFF,0xFF,0x5B,0x80,0x80,0xC0,0xC0,0xC0,
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  0x00,0x00,0x5B,0x5B,0x5B,0x5B,0x5B,0x5B,
/* tile 128 */

  0xC0,0xC0,0xC0,0xC0,0xC0,0xFF,0xFF,0x5B,
  0xC0,0xC0,0xC0,0xC0,0xC0,0xFF,0xFF,0x5B,
  0xC0,0xC0,0xC0,0xC0,0xC0,0xFF,0xFF,0x5B,
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  0x5B,0x5B,0x5B,0x5B,0x5B,0x5B,0x00,0x00,
/* tile 129 */

  0x00,0x00,0x00,0x00,0x00,0x00,0x00,0x00,
  0x00,0x00,0x00,0x00,0x00,0x00,0x00,0x00,
  0x00,0x00,0x00,0x00,0x00,0x00,0x00,0x00,
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  0x00,0x00,0x00,0x00,0x00,0x00,0x00,0x00,
/* tile 130 */

  0xC0,0xC0,0xC0,0xC0,0xC0,0xC0,0xC0,0xC0,
  0xC0,0xC0,0xC0,0xC0,0xC0,0xC0,0xC0,0xC0,
  0xC0,0xC0,0xC0,0xC0,0xC0,0xC0,0xC0,0xC0,
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  0xC0,0xC0,0xC0,0xC0,0xC0,0xC0,0xC0,0xC0,
/* tile 131 */

  0xC0,0xC0,0xFF,0xFF,0xFF,0x80,0xC0,0xC0,
  0xC0,0xC0,0xFF,0xFF,0xFF,0x80,0xC0,0xC0,
  0xC0,0xC0,0xFF,0xFF,0xFF,0x80,0xC0,0xC0,
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  0xC0,0xC0,0xC0,0xC0,0xC0,0xC0,0xC0,0xC0,
/* tile 132 */

  0xC0,0xC0,0xC0,0xC0,0xC0,0xC0,0xC0,0xC0,
  0xC0,0xC0,0xC0,0xFF,0xC0,0xC0,0xC0,0xC0,
  0xC0,0xFF,0xC0,0xFF,0xC0,0xFF,0xC0,0xC0,
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  0xC0,0xC0,0xC0,0xC0,0xC0,0xC0,0xC0,0xC0,
/* tile 133 */

  0xC0,0xC0,0xC0,0xC0,0xC0,0xC0,0xC0,0xC0,
  0xC0,0xC0,0xC0,0xC0,0xC0,0xC0,0xC0,0xC0,
  0xC0,0xC0,0xC0,0xC0,0xC0,0xC0,0xC0,0xC0,
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  0xC0,0xC0,0xC0,0xC0,0xC0,0xC0,0xC0,0xC0,
/* tile 134 */

  0xC0,0xC0,0xFF,0xFF,0xFF,0xC0,0xC0,0xC0,
  0xC0,0xFF,0x80,0x80,0xFF,0xFF,0xC0,0xC0,
  0xFF,0xFF,0x80,0xC0,0x80,0xFF,0xFF,0xC0,
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  0xC0,0xC0,0xC0,0xC0,0xC0,0xC0,0xC0,0xC0,
/* tile 135 */

  0xC0,0xC0,0xC0,0xFF,0xFF,0xC0,0xC0,0xC0,
  0xC0,0xC0,0xFF,0xFF,0xFF,0x80,0xC0,0xC0,
  0xC0,0xC0,0xC0,0xFF,0xFF,0x80,0xC0,0xC0,
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  0xC0,0xC0,0x80,0x80,0x80,0x80,0x80,0x80,
/* tile 136 */

  0xC0,0xFF,0xFF,0xFF,0xFF,0xFF,0x80,0xC0,
  0xFF,0xFF,0xC0,0xC0,0xC0,0xFF,0xFF,0x80,
  0xC0,0xC0,0xC0,0xC0,0xFF,0xFF,0xFF,0x80,
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  0xC0,0x80,0x80,0x80,0x80,0x80,0x80,0x80,
/* tile 137 */

  0xC0,0xFF,0xFF,0xFF,0xFF,0xFF,0xFF,0xC0,
  0xC0,0xC0,0x80,0x80,0xFF,0xFF,0x80,0xC0,
  0xC0,0xC0,0xC0,0xFF,0xFF,0x80,0xC0,0xC0,
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  0xC0,0xC0,0x80,0x80,0x80,0x80,0xC0,0xC0,
/* tile 138 */

  0xC0,0xC0,0xC0,0xFF,0xFF,0xFF,0x80,0xC0,
  0xC0,0xC0,0xFF,0xFF,0xFF,0xFF,0x80,0xC0,
  0xC0,0xFF,0xFF,0x80,0xFF,0xFF,0x80,0xC0,
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  0xC0,0xC0,0xC0,0xC0,0xC0,0x80,0x80,0xC0,
/* tile 139 */

  0xFF,0xFF,0xFF,0xFF,0xFF,0xFF,0xC0,0xC0,
  0xFF,0xFF,0x80,0x80,0x80,0x80,0xC0,0xC0,
  0xFF,0xFF,0xFF,0xFF,0xFF,0xFF,0xC0,0xC0,
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  0xC0,0x80,0x80,0x80,0x80,0x80,0xC0,0xC0,
/* tile 140 */

  0xC0,0xC0,0xFF,0xFF,0xFF,0xFF,0xC0,0xC0,
  0xC0,0xFF,0xFF,0x80,0x80,0xC0,0xC0,0xC0,
  0xFF,0xFF,0x80,0xC0,0xC0,0xC0,0xC0,0xC0,
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  0xC0,0xC0,0x80,0x80,0x80,0x80,0xC0,0xC0,
/* tile 141 */

  0xFF,0xFF,0xFF,0xFF,0xFF,0xFF,0xFF,0xC0,
  0xFF,0xFF,0x80,0x80,0x80,0xFF,0xFF,0xC0,
  0xC0,0xC0,0xC0,0xC0,0xFF,0xFF,0x80,0xC0,
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  0xC0,0xC0,0xC0,0xC0,0xC0,0xC0,0xC0,0xC0,
/* tile 142 */

  0xC0,0xFF,0xFF,0xFF,0xFF,0xC0,0xC0,0xC0,
  0xFF,0xFF,0x80,0x80,0x80,0xFF,0xC0,0xC0,
  0xFF,0xFF,0xFF,0x80,0xC0,0xFF,0xC0,0xC0,
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  0xC0,0xC0,0xC0,0xC0,0xC0,0xC0,0xC0,0xC0,
/* tile 143 */

  0xC0,0xFF,0xFF,0xFF,0xFF,0xFF,0xC0,0xC0,
  0xFF,0xFF,0x80,0x80,0x80,0xFF,0xFF,0xC0,
  0xFF,0xFF,0x80,0xC0,0xC0,0xFF,0xFF,0xC0,
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  0xC0,0xC0,0x80,0x80,0x80,0xC0,0xC0,0xC0,
/* tile 144 */

  0xC0,0xC0,0xFF,0xFF,0xFF,0x80,0xC0,0xC0,
  0xC0,0xFF,0xFF,0x80,0xFF,0xFF,0x80,0xC0,
  0xFF,0xFF,0x80,0xC0,0x80,0xFF,0xFF,0xC0,
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  0x80,0x80,0x80,0xC0,0xC0,0xC0,0x80,0x80,
/* tile 145 */

  0xFF,0xFF,0xFF,0xFF,0xFF,0xFF,0xC0,0xC0,
  0xFF,0xFF,0x80,0x80,0x80,0xFF,0xFF,0xC0,
  0xFF,0xFF,0x80,0xC0,0xC0,0xFF,0xFF,0xC0,
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  0xC0,0x80,0x80,0x80,0x80,0x80,0xC0,0xC0,
/* tile 146 */

  0xC0,0xC0,0xFF,0xFF,0xFF,0xFF,0x80,0xC0,
  0xC0,0xFF,0xFF,0x80,0x80,0xFF,0xFF,0xC0,
  0xFF,0xFF,0x80,0xC0,0xC0,0xC0,0xC0,0xC0,
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  0xC0,0xC0,0x80,0x80,0x80,0x80,0xC0,0xC0,
/* tile 147 */

  0xFF,0xFF,0xFF,0xFF,0xFF,0x80,0xC0,0xC0,
  0xFF,0xFF,0x80,0x80,0xFF,0xFF,0x80,0xC0,
  0xFF,0xFF,0x80,0xC0,0xC0,0xFF,0xFF,0xC0,
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  0xC0,0x80,0x80,0x80,0x80,0xC0,0xC0,0xC0,
/* tile 148 */

  0xFF,0xFF,0xFF,0xFF,0xFF,0xFF,0xFF,0xC0,
  0xFF,0xFF,0x80,0x80,0x80,0x80,0xC0,0xC0,
  0xFF,0xFF,0x80,0xC0,0xC0,0xC0,0xC0,0xC0,
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  0xC0,0x80,0x80,0x80,0x80,0x80,0x80,0xC0,
/* tile 149 */

  0xFF,0xFF,0xFF,0xFF,0xFF,0xFF,0xFF,0xC0,
  0xFF,0xFF,0x80,0x80,0x80,0x80,0xC0,0xC0,
  0xFF,0xFF,0x80,0xC0,0xC0,0xC0,0xC0,0xC0,
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  0xC0,0xC0,0xC0,0xC0,0xC0,0xC0,0xC0,0xC0,
/* tile 150 */

  0xC0,0xC0,0xFF,0xFF,0xFF,0xFF,0xFF,0xC0,
  0xC0,0xFF,0xFF,0x80,0x80,0x80,0xC0,0xC0,
  0xFF,0xFF,0x80,0xC0,0xC0,0xC0,0xC0,0xC0,
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  0xC0,0xC0,0xC0,0xC0,0xC0,0xC0,0xC0,0xC0,
/* tile 151 */

  0xFF,0xFF,0xC0,0xC0,0xC0,0xFF,0xFF,0xC0,
  0xFF,0xFF,0x80,0xC0,0xC0,0xFF,0xFF,0x80,
  0xFF,0xFF,0x80,0xC0,0xC0,0xFF,0xFF,0x80,
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  0xC0,0x80,0x80,0xC0,0xC0,0xC0,0x80,0x80,
/* tile 152 */

  0xC0,0xFF,0xFF,0xFF,0xFF,0xFF,0xFF,0xC0,
  0xC0,0xC0,0xC0,0xFF,0xFF,0x80,0xC0,0xC0,
  0xC0,0xC0,0xC0,0xFF,0xFF,0x80,0xC0,0xC0,
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  0xC0,0xC0,0x80,0x80,0x80,0x80,0x80,0xC0,
/* tile 153 */

  0xC0,0xC0,0xC0,0xFF,0xFF,0xFF,0xFF,0x80,
  0xC0,0xC0,0xC0,0xC0,0xFF,0xFF,0x80,0xC0,
  0xC0,0xC0,0xC0,0xC0,0xFF,0xFF,0x80,0xC0,
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  0xC0,0xC0,0x80,0x80,0x80,0x80,0xC0,0xC0,
/* tile 154 */

  0xFF,0xFF,0xC0,0xC0,0xC0,0xFF,0xFF,0xC0,
  0xFF,0xFF,0x80,0xC0,0xFF,0xFF,0x80,0xC0,
  0xFF,0xFF,0x80,0xFF,0xFF,0x80,0xC0,0xC0,
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  0xC0,0x80,0x80,0xC0,0xC0,0x80,0x80,0xC0,
/* tile 155 */

  0xC0,0xFF,0xFF,0xC0,0xC0,0xC0,0xC0,0xC0,
  0xC0,0xFF,0xFF,0x80,0xC0,0xC0,0xC0,0xC0,
  0xC0,0xFF,0xFF,0x80,0xC0,0xC0,0xC0,0xC0,
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  0xC0,0xC0,0x80,0x80,0x80,0x80,0x80,0xC0,
/* tile 156 */

  0xFF,0xFF,0x80,0xC0,0xC0,0xFF,0xFF,0xC0,
  0xFF,0xFF,0xFF,0x80,0xFF,0xFF,0xFF,0x80,
  0xFF,0xFF,0xFF,0xFF,0xFF,0xFF,0xFF,0x80,
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  0xC0,0x80,0x80,0xC0,0xC0,0xC0,0x80,0x80,
/* tile 157 */

  0xFF,0xFF,0xC0,0xC0,0xC0,0xFF,0xFF,0xC0,
  0xFF,0xFF,0xFF,0x80,0xC0,0xFF,0xFF,0x80,
  0xFF,0xFF,0xFF,0xFF,0x80,0xFF,0xFF,0x80,
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  0xC0,0x80,0x80,0xC0,0xC0,0xC0,0x80,0x80,
/* tile 158 */

  0xC0,0xFF,0xFF,0xFF,0xFF,0xFF,0xC0,0xC0,
  0xFF,0xFF,0x80,0x80,0x80,0xFF,0xFF,0xC0,
  0xFF,0xFF,0x80,0xC0,0xC0,0xFF,0xFF,0xC0,
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  0xC0,0xC0,0x80,0x80,0x80,0x80,0xC0,0xC0,
/* tile 159 */

  0xFF,0xFF,0xFF,0xFF,0xFF,0xFF,0xC0,0xC0,
  0xFF,0xFF,0x80,0x80,0x80,0xFF,0xFF,0xC0,
  0xFF,0xFF,0x80,0xC0,0xC0,0xFF,0xFF,0xC0,
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  0xC0,0xC0,0xC0,0xC0,0xC0,0xC0,0xC0,0xC0,
/* tile 160 */

  0xC0,0xFF,0xFF,0xFF,0xFF,0xFF,0xC0,0xC0,
  0xFF,0xFF,0x80,0xC0,0xC0,0xFF,0xFF,0xC0,
  0xFF,0xFF,0x80,0xC0,0xC0,0xFF,0xFF,0xC0,
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  0xC0,0xC0,0xC0,0xC0,0xC0,0xC0,0xC0,0xC0,
/* tile 161 */

  0xFF,0xFF,0xFF,0xFF,0xFF,0xFF,0xC0,0xC0,
  0xFF,0xFF,0x80,0x80,0x80,0xFF,0xFF,0xC0,
  0xFF,0xFF,0x80,0xC0,0xC0,0xFF,0xFF,0xC0,
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  0xC0,0xC0,0xC0,0xC0,0xC0,0xC0,0xC0,0xC0,
/* tile 162 */

  0xC0,0xFF,0xFF,0xFF,0xFF,0x80,0xC0,0xC0,
  0xFF,0xFF,0x80,0x80,0xFF,0xFF,0xC0,0xC0,
  0xFF,0xFF,0x80,0xC0,0xC0,0xC0,0xC0,0xC0,
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  0xC0,0xC0,0xC0,0xC0,0xC0,0xC0,0xC0,0xC0,
/* tile 163 */

  0xFF,0xFF,0xFF,0xFF,0xFF,0xFF,0x80,0xC0,
  0xC0,0xC0,0xFF,0xFF,0x80,0xC0,0xC0,0xC0,
  0xC0,0xC0,0xFF,0xFF,0x80,0xC0,0xC0,0xC0,
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  0xC0,0xC0,0xC0,0xC0,0xC0,0xC0,0xC0,0xC0,
/* tile 164 */

  0xFF,0xFF,0x80,0xC0,0xC0,0xFF,0xFF,0x80,
  0xFF,0xFF,0x80,0xC0,0xC0,0xFF,0xFF,0x80,
  0xFF,0xFF,0x80,0xC0,0xC0,0xFF,0xFF,0x80,
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  0xC0,0xC0,0xC0,0xC0,0xC0,0xC0,0xC0,0xC0,
/* tile 165 */

  0xFF,0xFF,0x80,0xC0,0xC0,0xFF,0xFF,0x80,
  0xFF,0xFF,0x80,0xC0,0xC0,0xFF,0xFF,0x80,
  0xFF,0xFF,0x80,0xC0,0xC0,0xFF,0xFF,0x80,
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  0xC0,0xC0,0xC0,0xC0,0xC0,0xC0,0xC0,0xC0,
/* tile 166 */

  0xFF,0xFF,0xC0,0xC0,0xC0,0xFF,0xFF,0xC0,
  0xFF,0xFF,0x80,0xC0,0xC0,0xFF,0xFF,0x80,
  0xFF,0xFF,0x80,0xFF,0x80,0xFF,0xFF,0x80,
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  0xC0,0x80,0xC0,0xC0,0xC0,0xC0,0x80,0x80,
/* tile 167 */

  0xFF,0xFF,0x80,0xC0,0xC0,0xFF,0xFF,0x80,
  0xFF,0xFF,0xFF,0x80,0xFF,0xFF,0xFF,0x80,
  0xC0,0xFF,0xFF,0xFF,0xFF,0xFF,0x80,0xC0,
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  0xC0,0xC0,0xC0,0xC0,0xC0,0xC0,0xC0,0xC0,
/* tile 168 */

  0xC0,0xFF,0xFF,0x80,0xC0,0xFF,0xFF,0x80,
  0xC0,0xFF,0xFF,0x80,0xC0,0xFF,0xFF,0x80,
  0xC0,0xFF,0xFF,0x80,0xC0,0xFF,0xFF,0x80,
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  0xC0,0xC0,0xC0,0xC0,0x80,0x80,0xC0,0xC0,
/* tile 169 */

  0xFF,0xFF,0xFF,0xFF,0xFF,0xFF,0xFF,0x80,
  0xC0,0x80,0x80,0x80,0xFF,0xFF,0xFF,0x80,
  0xC0,0xC0,0xC0,0xFF,0xFF,0xFF,0x80,0xC0,
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  0xC0,0x80,0x80,0x80,0x80,0x80,0x80,0x80,



#include "title.inc"


};


#define ENDGAMETILES 119
#define MENUSTART ENDGAMETILES+1
#define BLANKT MENUSTART+9
#define FONTSTART BLANKT+1
#define TITLESTART FONTSTART+40
#define TITLERED 0x0F   //deleted color cycling stuff
#define TITLEGREEN 0x30
#define TITLETEAL 0xF0
#define TITLEBLUE 0xC0
#define TITLEYELLOW 0x37


const char colormap[] PROGMEM = {TITLERED,TITLEGREEN,TITLETEAL,TITLEYELLOW,TITLEBLUE};

const char TitleMap[] PROGMEM=//14x4
{
    1,  2,  3,  4,  5,  6,  3,  4,  7,  8,  9, 10, 11, 12,
   13, 14, 15, 16, 17, 18, 15, 16, 19, 20, 21, 22, 23, 24,
   25, 25, 26, 27,  3,  4,  7,  8, 28, 29,  5, 30, 25, 25,
   25, 25, 31, 32, 15, 16, 33, 18, 34, 35, 36, 37, 25, 25
};



#define NUMOUTEFFECTS 11
#define NUMINEFFECTS 11

const char ScreenFadeParms[] PROGMEM = {
//start frame, num frames, time between frames, reverse, time after effect, vertical flip

   23,17,3,0,5,0,//BLOCK OUT
   48, 8,4,0,4,0,//VERTICAL FILL
   39,17,3,1,5,0,//BLOCK OUT REVERSED
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   22,14,2,1,4,0,//DIAGONAL SLOPE REVERSE

};

const char ScreenFadeTable[] PROGMEM = {//bit patterns

////////////START CIRCLE OFFSET 0 LENGTH 9
   0b10000001,
   0b00000000,
   0b00000000,
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   0b00000000,

////////////END CIRCLE OUT

////////////START DIAGONAL SLOPE THING - OFFSET 9 LENGTH 14
   
   0b10000000,
   0b00000000,
   0b00000000,
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   0b00000011,

/////////END DIAGONAL/////////////

////////START BLOCK/////////////// OFFSET 23 LENGTH 17

   0b11110000,
   0b00000000,
   0b00000000,
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   0b00000000,

//////////END BLOCK/////

//////////START HORIZONTAL LINE//////////////OFFSET 40 LENGTH 8   (44,8 FOR REVERSE CASE)

   0b10000000,
   0b10000000,
   0b10000000,
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   0b00000001,

/////////////END HORIZONTAL LINE TO RIGHT  

////////////START VERTICAL LINE TO BOTTOM OFFSET 48 LENGTH 8

   0b11111111,
   0b00000000,
   0b00000000,
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   0b11111111,

////////////////////END VERTICAL

//////////////START PYRAMID 56 -  8 FRAMES

   0b00010000,
   0b00000000,
   0b00000000,
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   0b00000000,
};