#define NUM_LEVELS 14

const uint8_t lvldata[] PROGMEM = {
#define SK 0
#define RK 1
#define DR 2
#define PS 3
//#define DT DIRT 4+

//level 1
20,13,
 6, 0, 0, 0, 0, 0, 0, 0, 0, 0, 0, 0, 0, 0, 0, 0, 0, 0, 0, 9,
 7, 0, 0, 0, 0, 0, 0, 0, 0, 0, 0, 0, 0, 0, 0, 0, 0, 0, 0,10,
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 8, 0, 0, 0,18, 0, 0, 0, 0, 0, 0, 0,19, 0, 0, 0, 0, 0, 0, 9,
 7,DR, 0, 0,15, 0, 0, 0,20, 0,RK, 0,16, 0,RK, 0,PS, 0, 0,11,
21,12,13,14,60,14,13,14,60,13,14,13,60,13,14,12,14,13,12,24,
 5, 5, 5, 5, 5, 5, 5, 5, 5, 5, 5, 5, 5, 5, 5, 5, 5, 5, 5, 5,
 5, 5, 5, 5, 5, 5, 5, 5, 5, 5, 5, 5, 5, 5, 5, 5, 5, 5, 5, 5,
 5, 5, 5, 5, 5, 5, 5, 5, 5, 5, 5, 5, 5, 5, 5, 5, 5, 5, 5, 5,
 5, 5, 5, 5, 5, 5, 5, 5, 5, 5, 5, 5, 5, 5, 5, 5, 5, 5, 5, 5,

255,

//level 2
22,13,
 5, 6, 0, 0,42, 5, 5, 5, 5, 5,36, 0, 0, 0, 0, 0,42,39, 5, 5, 5, 5,
 5,36, 0, 0, 0,42,39,40,41,36, 0, 0, 0, 0, 0, 0, 0, 0,42, 5, 5, 5,
 5, 0, 0, 0, 0, 0, 0, 0, 0, 0, 0, 0, 0, 0, 0, 0, 0, 0, 0,42, 5, 5,
 5,DR, 0, 0, 0, 0, 0, 0, 0, 0, 0, 0, 0, 0, 0, 0, 0, 0, 0, 0,42, 5,
33,28, 0, 0, 0, 0, 0, 0, 0, 0, 0, 0, 0, 0, 0, 0, 0, 0, 0, 0, 0,11,
 5, 6, 0, 0, 0, 0, 0, 0, 0, 0, 0, 0, 0,19, 0, 0,RK, 0, 0, 0, 0,10,
 5, 6, 0, 0, 0, 0, 0, 0, 0, 0, 0, 0, 0,15,RK, 0,RK,RK,PS, 0, 0, 9,
 5,21,12,13,12,27, 0, 0, 0,30,13,12,14,60,12,14,12,13,14,13,12,24,
 5, 5, 5, 5, 5, 7, 0, 0,RK,11, 5, 5, 5, 5, 5, 5, 5, 5, 5, 5, 5, 5,
 5, 5, 5, 5, 5,21,14,13,12,24, 5, 5, 5, 5, 5, 5, 5, 5, 5, 5, 5, 5,
 5, 5, 5, 5, 5, 5, 5, 5, 5, 5, 5, 5, 5, 5, 5, 5, 5, 5, 5, 5, 5, 5,
 5, 5, 5, 5, 5, 5, 5, 5, 5, 5, 5, 5, 5, 5, 5, 5, 5, 5, 5, 5, 5, 5,
 5, 5, 5, 5, 5, 5, 5, 5, 5, 5, 5, 5, 5, 5, 5, 5, 5, 5, 5, 5, 5, 5,

255,

//level 3
19,13,
 5, 5, 5, 5, 5, 5, 5, 5, 5, 5, 5, 5, 5, 5, 5, 5, 5, 5, 5,
 5,41, 5, 5, 5,39,40,41,39,41,40,39,40,41,40,39,41,41, 5,
 6, 0,42, 5,36, 0, 0, 0, 0, 0, 0, 0, 0, 0, 0, 0, 0, 0, 9,
 6, 0, 0,45, 0, 0, 0, 0, 0, 0, 0, 0, 0, 0, 0, 0, 0, 0,10,
 6, 0, 0, 0, 0, 0, 0, 0, 0, 0, 0, 0, 0, 0, 0, 0, 0,RK,11,
 6, 0, 0, 0, 0, 0, 0, 0, 0, 0, 0, 0, 0, 0, 0, 0,RK,RK, 9,
 6, 0,32,13,27, 0, 0, 0, 0,PS, 0, 0, 0, 0,RK,30,13,12,25,
 6, 0, 9, 5, 6, 0, 0, 0, 0,18, 0, 0,31,13,12,26, 5, 5, 5,
 6, 0,11, 5, 7,RK,RK, 0,31,47, 0, 0,10, 5, 5, 5, 5, 5, 5,
 6,DR,10, 5,21,14,13,12,24, 6, 0,30,25, 5, 5, 5, 5, 5, 5,
22,13,24, 5, 5, 5, 5, 5, 5,21,13,26, 5, 5, 5, 5, 5, 5, 5,
 5, 5, 5, 5, 5, 5, 5, 5, 5, 5, 5, 5, 5, 5, 5, 5, 5, 5, 5,
 5, 5, 5, 5, 5, 5, 5, 5, 5, 5, 5, 5, 5, 5, 5, 5, 5, 5, 5,
255,

//level 4
24,16,
 5, 5, 5, 5, 5, 5, 5, 5, 5, 5, 5, 5, 5, 5, 5, 5, 5, 5,39, 5, 5, 5, 5, 5,
 5, 5, 5, 5, 5, 5, 5, 5, 5, 5, 5, 5, 5, 5, 5, 5, 5,36, 0,42, 5, 5, 5, 5,
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 5, 6, 0, 0, 0, 0, 0, 0, 0, 0, 0,42,36, 0, 0, 0, 0, 0, 0, 0, 0, 0, 0,11,
 5, 6, 0, 0, 0, 0, 0, 0, 0, 0, 0, 0, 0, 0, 0, 0, 0, 0, 0, 0, 0, 0,RK,10,
 5, 6, 0, 0, 0, 0, 0, 0, 0, 0, 0, 0, 0, 0, 0, 0, 0, 0, 0, 0, 0,RK,RK, 9,
 5, 6, 0, 0, 0, 0, 0, 0, 0, 0, 0, 0, 0, 0, 0, 0, 0,PS, 0, 0, 0,31,13,26,
 5,36, 0, 0, 0, 0,18, 0, 0, 0, 0, 0, 0, 0, 0, 0, 0,18, 0, 0, 0, 9, 5, 5,
 6,DR, 0, 0, 0, 0,16, 0,RK, 0, 0, 0, 0, 0, 0, 0, 0,67,12,13,14,26, 5, 5,
22,13,12,14,27, 0,15, 0,RK, 0, 0, 0,RK, 0, 0,31,12,26, 5, 5, 5, 5, 5, 5,
 5, 5, 5, 5, 6, 0,17, 0,RK, 0,18, 0,18,RK, 0, 9, 5, 5, 5, 5, 5, 5, 5, 5,
 5, 5, 5, 5, 7, 0,67,12,14,13,60,13,60,12,14,26, 5, 5, 5, 5, 5, 5, 5, 5,
 5, 5, 5, 5,21,13,26, 5, 5, 5, 5, 5, 5, 5, 5, 5, 5, 5, 5, 5, 5, 5, 5, 5,
255,

//level 5
22,14,
 5, 5, 5, 5, 5,40,40,39, 5, 5, 5, 5,40,39,41,40,41,39,41,40,39, 5,
 5,41,39,40,36, 0, 0, 0,42,39,40,36, 0, 0, 0, 0, 0, 0, 0, 0, 0,11,
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 8, 0, 0, 0, 0, 0,15, 0, 0, 0, 0, 0, 0, 0, 0, 0, 0, 0, 0, 0, 0,10,
 6, 0, 0, 0, 0, 0,16,RK,RK,RK,RK, 0, 0, 0, 0, 0, 0, 0, 0, 0, 0,11,
 6,DR, 0, 0, 0,31,60,14,13,14,12,27,PS, 0, 0, 0, 0, 0, 0, 0, 0, 9,
22,27, 0,31,13,26, 5, 5, 5, 5, 5,22,27, 0,18, 0, 0, 0, 0, 0,RK,10,
 5, 6, 0,10, 5, 5, 5, 5, 5, 5, 5, 5, 6, 0,58,27, 0, 0, 0,RK,RK, 9,
 5, 8, 0, 9, 5, 5, 5, 5, 5, 5, 5, 5, 7, 0,10, 6, 0, 0,RK,RK,RK,11,
 5,21,13,26, 5, 5, 5, 5, 5, 5, 5, 5, 8, 0, 9,23,13,14,13,14,12,26,
 5, 5, 5, 5, 5, 5, 5, 5, 5, 5, 5, 5,21,13,24, 5, 5, 5, 5, 5, 5, 5,
255,

//level 6
21,13,
 5, 5,39,40, 5, 5, 5, 5, 5, 5, 5, 5, 5, 5, 5, 5, 5,41,40,39, 5,
 5, 7, 0, 0,42,40,39,41,39,39,41,40,39,40,39,41,38, 0, 0, 0, 9,
 5,37, 0, 0, 0, 0, 0, 0, 0, 0, 0, 0, 0, 0, 0, 0, 0, 0, 0, 0,11,
 7,DR, 0, 0, 0, 0, 0, 0, 0, 0, 0, 0, 0, 0, 0, 0, 0, 0, 0, 0, 9,
23,29, 0, 0, 0, 0, 0, 0, 0, 0, 0, 0, 0, 0, 0, 0, 0, 0, 0, 0,10,
 5, 7, 0, 0, 0, 0, 0, 0, 0, 0, 0, 0, 0, 0, 0, 0, 0, 0,RK,RK, 9,
 5, 8,RK,RK, 0, 0, 0, 0, 0, 0, 0, 0,19, 0, 0,RK, 0, 0,31,14,25,
 5, 7,RK,RK,RK, 0, 0, 0, 0, 0, 0, 0,15,PS,RK,RK,RK, 0,11, 5, 5,
 5, 6,RK,RK,RK,RK, 0, 0, 0, 0, 0, 0,67,13,14,13,27, 0, 9, 5, 5,
 5,21,12,13,14,28, 0, 0, 0, 0,32,13,26, 5, 5, 5,21,14,26, 5, 5,
 5, 5, 5, 5, 5, 6, 0, 0, 0,RK, 9, 5, 5, 5, 5, 5, 5, 5, 5, 5, 5,
 5, 5, 5, 5, 5,23,27, 0,31,14,25, 5, 5, 5, 5, 5, 5, 5, 5, 5, 5,
 5, 5, 5, 5, 5, 5,22,14,26, 5, 5, 5, 5, 5, 5, 5, 5, 5, 5, 5, 5,
255,

//level 7
24,15,
 5, 5,39, 5, 5, 5,39,40,41,40,39, 5, 5, 5,40,39, 5, 5, 5,41,40,39, 5, 5,
 5, 8, 0,42, 5, 8, 0, 0, 0, 0, 0,43, 5, 6, 0, 0,43, 5, 6, 0, 0, 0,42, 5,
 5, 6, 0, 0,43, 7, 0, 0, 0, 0, 0, 0,42, 7, 0, 0, 0,42, 7, 0, 0, 0, 0,10,
 5, 7, 0, 0, 0,46, 0, 0, 0, 0, 0, 0, 0,45, 0, 0, 0, 0,46, 0, 0, 0, 0, 9,
 5, 6, 0, 0, 0, 0, 0, 0, 0, 0, 0, 0, 0, 0, 0, 0, 0, 0, 0, 0, 0, 0, 0,10,
 5, 8, 0, 0, 0, 0, 0, 0, 0, 0, 0, 0, 0, 0, 0, 0, 0, 0, 0, 0, 0, 0,RK,11,
 5, 6, 0, 0, 0, 0, 0, 0, 0, 0, 0, 0, 0, 0, 0, 0, 0, 0, 0, 0, 0, 0,RK,10,
 5,38, 0, 0, 0, 0, 0, 0, 0, 0, 0, 0, 0, 0, 0, 0, 0, 0, 0, 0, 0,RK,RK, 9,
 7,DR, 0, 0, 0,RK, 0, 0, 0, 0, 0, 0, 0, 0, 0, 0, 0, 0, 0, 0, 0,31,14,26,
21,27, 0, 0, 0,18, 0,RK, 0, 0, 0, 0, 0,20, 0, 0, 0, 0,32,27, 0, 9, 5, 5,
 5, 7, 0, 0, 0,16, 0,RK, 0, 0, 0, 0,32,68, 0,RK, 0,PS,10,22,13,25, 5, 5,
 5,22,29, 0, 0,15, 0,RK,RK,RK, 0, 0,11, 8, 0,RK,RK,RK, 9, 5, 5, 5, 5, 5,
 5, 5, 6, 0, 0,58,12,14,13,14,28, 0, 9,21,12,14,12,13,26, 5, 5, 5, 5, 5,
 5, 5,23,28, 0, 9, 5, 5, 5, 5,23,13,26, 5, 5, 5, 5, 5, 5, 5, 5, 5, 5, 5,
 5, 5, 5,21,13,25, 5, 5, 5, 5, 5, 5, 5, 5, 5, 5, 5, 5, 5, 5, 5, 5, 5, 5,
255,

//level 8
27,17,
 5,41,39,40, 5, 5, 5, 5, 5, 5, 5,39,40,41,39, 5, 5, 5,40,41,39,40,41,40,39, 5, 5,
 6, 0, 0, 0,42, 5, 5, 5, 5, 5,36, 0, 0, 0, 0, 9, 5,36, 0, 0, 0, 0, 0, 0, 0,42, 5,
 7, 0, 0, 0, 0,43, 5, 5, 5,37, 0, 0, 0, 0, 0,10,37, 0, 0, 0, 0, 0, 0, 0, 0, 0, 9,
 8,RK, 0, 0, 0, 0,44,40,38, 0, 0, 0, 0,18, 0,45, 0, 0, 0, 0, 0,31,53,27, 0, 0,10,
 6,RK,RK, 0, 0, 0, 0, 0, 0, 0, 0, 0,30,64, 0, 0, 0, 0, 0, 0,50,64, 0,16, 0, 0,11,
22,13,14,29, 0, 0, 0, 0, 0, 0, 0,50,63, 0, 0, 0, 0, 0, 0, 0, 0, 0, 0,15,DR, 0, 9,
 5, 5, 5,61,51, 0, 0, 0, 0, 0, 0, 0, 0, 0, 0, 0, 0,32,28, 0, 0, 0, 0,65,51, 0,11,
 5, 5, 7, 0, 0, 0, 0,RK, 0,18, 0, 0, 0, 0, 0, 0,31,24,22,29, 0, 0, 0, 0, 0, 0,10,
 5, 5,38, 0, 0, 0, 0,RK,32,60,29, 0, 0, 0, 0,49,25, 5, 5, 6, 0, 0, 0, 0, 0, 0, 9,
 5, 7, 0, 0, 0,50,54,53,24, 5,23,51, 0, 0, 0, 0,42, 5, 5,36, 0, 0, 0, 0, 0,RK,10,
 5,36, 0, 0, 0, 0, 0, 0,42, 5,38, 0, 0, 0, 0, 0, 0,43,38, 0, 0, 0, 0, 0,RK,RK,11,
 6, 0, 0, 0, 0, 0, 0, 0, 0,45, 0, 0, 0, 0, 0, 0, 0, 0, 0, 0, 0,49,54,53,54,53,24,
 7, 0, 0, 0, 0, 0, 0, 0, 0, 0, 0, 0, 0,RK, 0, 0, 0, 0, 0, 0, 0, 0, 0, 0, 0, 0,11,
 8, 0, 0, 0, 0,RK, 0, 0, 0, 0, 0, 0,50,54,52, 0, 0, 0, 0, 0, 0, 0, 0, 0, 0,RK, 9,
 7, 0, 0, 0,49,53,51, 0, 0, 0, 0, 0, 0, 0, 0, 0, 0, 0, 0, 0, 0, 0, 0, 0,RK,RK,10,
 6, 0, 0, 0, 0, 0, 0, 0, 0,RK, 0, 0, 0, 0, 0, 0, 0,RK, 0, 0,PS, 0, 0,RK,RK,RK,11,
21,13,12,13,14,13,14,12,13,14,14,12,13,14,12,13,14,13,12,14,13,12,13,12,14,13,25,
255,

//level 9
20,16,
 5, 5, 5, 5, 5, 5, 5, 5,39,40,41, 5, 5, 5, 5, 5, 5, 5, 5, 5,
 5, 5, 5, 5, 5, 5, 5,36, 0, 0, 0, 9, 5, 5, 5, 5, 5, 5, 5, 5,
 5, 5, 5, 5, 5, 5,37, 0, 0, 0, 0,42,39, 5, 5,39,40,41,39, 5,
 5, 5, 5, 5, 5,38, 0, 0, 0, 0, 0, 0, 0,43,36, 0, 0, 0, 0, 9,
 5, 5, 5, 5,36, 0, 0, 0, 0, 0,RK, 0, 0, 0, 0, 0, 0, 0, 0,11,
 5, 5, 5,37, 0, 0, 0, 0, 0, 0,RK,RK, 0, 0, 0, 0, 0, 0,RK, 9,
 5, 5,36, 0, 0, 0, 0, 0, 0, 0,49,53,51, 0, 0, 0, 0,RK,RK, 9,
 5,38, 0, 0, 0, 0, 0, 0, 0, 0, 0, 0, 0, 0,PS, 0,50,54,53,25,
 7, 0, 0, 0, 0, 0, 0, 0, 0, 0, 0, 0, 0, 0,RK, 0, 0, 0, 0,11,
 6,DR, 0, 0, 0, 0, 0, 0, 0, 0, 0, 0, 0,49,54,51, 0, 0, 0,10,
23,27, 0, 0, 0, 0,30,28, 0, 0, 0,18, 0, 0, 0, 0, 0, 0,RK, 9,
 5, 7, 0, 0, 0, 0, 9, 7,RK, 0, 0,67,28, 0, 0, 0,32,13,12,24,
 5, 8, 0, 0, 0, 0,10,21,12,14,13,25, 8, 0, 0,31,26, 5, 5, 5,
 5,22,13,29, 0, 0,11, 5, 5, 5, 5, 5, 7, 0,30,25, 5, 5, 5, 5,
 5, 5, 5, 7, 0,30,25, 5, 5, 5, 5, 5,23,14,24, 5, 5, 5, 5, 5,
 5, 5, 5,21,14,26, 5, 5, 5, 5, 5, 5, 5, 5, 5, 5, 5, 5, 5, 5,
255,

//level 10
27,19,
 5, 5, 5,39,40,41,39,40,41,40,39,41,39,40, 5,41,39,40,41,39,40,41,39,40, 5, 5, 5,
 5, 5, 7, 0, 0, 0, 0, 0, 0, 0, 0, 0, 0, 0,16, 0, 0, 0, 0, 0, 0, 0, 0, 0, 9, 5, 5,
 5,41,61,28,RK, 0, 0, 0, 0, 0, 0, 0,RK,RK,17,RK, 0, 0, 0,RK,RK,RK, 0,RK,11,39, 5,
 8, 0, 0,66,27, 0, 0,18, 0, 0, 0,50,53,54,69,51, 0, 0,RK,30,54,28, 0,32,64, 0,11,
 7, 0, 0, 0,16, 0, 0,65,27, 0, 0, 0, 0, 0, 0, 0, 0,49,53,64, 0,65,53,63, 0, 0, 9,
 6, 0, 0, 0,65,52, 0, 0,66,28,RK,RK,RK,RK, 0, 0, 0, 0, 0, 0, 0, 0, 0, 0, 0, 0,10,
 7,DR, 0, 0, 0, 0, 0, 0, 0,65,13,12,14,13,12,27, 0, 0, 0, 0, 0, 0, 0, 0, 0, 0,11,
21,28, 0, 0, 0, 0, 0, 0, 0, 0,44, 5, 5, 5,39,61,28, 0, 0, 0, 0, 0, 0, 0, 0,50,25,
 5, 7, 0, 0, 0, 0, 0,RK, 0, 0, 0,42, 5,36, 0, 0,66,28, 0, 0, 0, 0, 0, 0, 0, 0,11,
 5, 8, 0, 0, 0, 0, 0,18, 0, 0, 0, 0,45, 0, 0, 0, 0,65,52, 0, 0, 0, 0, 0, 0, 0, 9,
 5,22,14,12,27, 0, 0,67,51, 0, 0, 0, 0, 0, 0, 0, 0, 0, 0, 0, 0, 0,49,54,53,54,26,
 5, 5, 5, 5,61,53,54,63, 0, 0, 0, 0, 0, 0,PS, 0, 0, 0, 0, 0, 0, 0, 0, 0, 0, 0, 9,
 5, 5, 5, 8, 0, 0, 0, 0, 0, 0, 0, 0, 0, 0,18, 0, 0, 0, 0, 0, 0, 0, 0, 0, 0, 0,10,
 5, 5, 5, 7, 0, 0, 0, 0, 0, 0, 0, 0, 0,32,64, 0, 0, 0, 0,50,53,54,53,53,54,14,24,
 5, 5, 5, 6, 0, 0, 0, 0, 0, 0, 0, 0,49,63, 0, 0, 0, 0, 0, 0, 0, 0, 0, 0, 0,11, 5,
 5, 5, 5, 7, 0, 0, 0, 0, 0, 0, 0, 0, 0, 0,RK, 0, 0, 0, 0, 0, 0, 0, 0, 0,RK, 9, 5,
 5, 5, 5, 8,RK, 0, 0, 0, 0,31,12,13,14,12,13,14,12,14,13,29, 0, 0, 0,RK,RK,10, 5,
 5, 5, 5, 6,RK,RK, 0, 0,30,24, 5, 5, 5, 5, 5, 5, 5, 5, 5,21,27, 0,RK,RK,RK, 9, 5,
 5, 5, 5,22,12,13,14,13,26, 5, 5, 5, 5, 5, 5, 5, 5, 5, 5, 5,22,13,14,12,13,26, 5,
255,

//level 11
29,19,
 5,39,40, 5,39,40,41, 5,39,40,41,40,39,40,41,39,40,41,40,39,40,41,39,41,40,39,40,41, 5,
 7, 0, 0,45, 0, 0, 0,16, 0, 0, 0, 0, 0, 0, 0, 0, 0, 0, 0, 0, 0, 0, 0, 0, 0, 0, 0, 0, 9,
 8, 0, 0, 0, 0, 0,RK,15,RK,RK, 0, 0, 0, 0, 0, 0, 0, 0, 0, 0, 0, 0,49,53,54,53,29, 0,10,
 7,RK, 0, 0, 0,49,54,68, 0,RK,49,52, 0, 0, 0, 0, 0,RK, 0, 0,50,51, 0, 0,DR, 0,17, 0,11,
 6,RK,RK, 0, 0, 0, 0,67,53,51, 0, 0, 0,PS, 0, 0,RK, 0, 0, 0, 0, 0, 0, 0,55, 0,16, 0, 9,
21,53,51, 0, 0,RK,RK,16, 0, 0, 0, 0, 0,55, 0,RK, 0, 0, 0, 0, 0, 0, 0, 0, 0, 0,45, 0,10,
 8, 0, 0, 0,50,54,53,63, 0, 0, 0, 0, 0, 0,18, 0, 0,50,53,52, 0, 0, 0,31,53,52, 0, 0,11,
 6,RK, 0, 0, 0, 0, 0, 0, 0, 0, 0, 0, 0, 0,15, 0,18, 0, 0, 0, 0, 0, 0,45, 0, 0,RK, 0,10,
 8,RK,RK, 0, 0, 0, 0, 0, 0, 0,31,14,52, 0,16, 0,17,RK, 0, 0, 0, 0,55, 0, 0,31,54,53,24,
23,54,53,52, 0,RK, 0, 0, 0,49,62,38, 0, 0,17, 0,67,52,RK, 0, 0,55, 0,RK, 0,45, 0, 0, 9,
 7, 0, 0, 0, 0, 0, 0, 0, 0, 0, 0, 0,RK, 0,65,53,64, 0, 0,RK,18, 0, 0, 0,55, 0, 0, 0,10,
 6, 0, 0, 0,RK, 0, 0, 0, 0, 0,RK,RK, 0,18, 0, 0, 0,50,54,53,63, 0, 0, 0, 0, 0, 0, 0,11,
 8, 0, 0, 0, 0,49,54,53,54,53,54,54,53,64, 0, 0, 0, 0, 0, 0, 0, 0,49,53,54,53,29, 0,10,
 6, 0, 0, 0, 0, 0, 0, 0, 0, 0, 0, 0, 0, 0, 0,RK, 0, 0, 0,RK,50,52, 0, 0, 0, 0,17, 0, 9,
22,53,14,27, 0, 0, 0, 0, 0, 0, 0, 0, 0, 0, 0,RK, 0, 0, 0,55, 0, 0, 0, 0,RK,RK,16, 0,10,
 8,RK,42, 8, 0, 0, 0,18, 0, 0, 0, 0,18, 0, 0, 0, 0, 0, 0, 0, 0, 0, 0,50,53,54,64, 0,11,
21,52,RK,65,13,52, 0,17, 0, 0, 0, 0,15, 0, 0, 0,RK,RK,RK, 0,RK, 0, 0, 0, 0, 0, 0, 0, 9,
 7,RK,18,RK,17,RK,32,68, 0, 0, 0, 0,16, 0, 0, 0, 0, 0, 0, 0, 0,RK,RK,RK, 0, 0, 0, 0,10,
23,13,60,13,60,14,24,21,12,13,14,12,60,14,13,12,14,12,13,14,12,13,14,12,13,14,12,14,25,
255,

//level 12
15,13,
 5, 5, 5, 5,39,40,41,40,39,40,41, 5, 5, 5, 5,
 5, 5, 5,36, 0, 0, 0,DR, 0, 0, 0,42, 5, 5, 5,
 5, 5,37, 0, 0, 0,49,53,52, 0, 0, 0,43,39, 5,
 5,38, 0, 0, 0, 0, 0, 0, 0, 0, 0, 0, 0, 0,10,
 8, 0, 0, 0, 0, 0, 0,PS, 0, 0, 0, 0, 0, 0, 9,
 7,RK, 0,RK, 0,RK, 0,RK, 0,RK, 0,RK, 0,RK,10,
 6, 0,RK, 0,RK, 0,RK, 0,RK, 0,RK, 0,RK, 0,11,
 7, 0, 0, 0, 0, 0, 0, 0, 0, 0, 0, 0, 0, 0, 9,
21,27, 0, 0, 0, 0, 0, 0, 0, 0, 0, 0, 0,31,26,
 5,23,28, 0, 0, 0, 0, 0, 0, 0, 0, 0,30,24, 5,
 5, 5,22,29, 0, 0, 0, 0, 0, 0, 0,32,25, 5, 5,
 5, 5, 5,21,12,13,14,12,13,14,13,24, 5, 5, 5,
 5, 5, 5, 5, 5, 5, 5, 5, 5, 5, 5, 5, 5, 5, 5, 
255,

//level 13
15,19,
 5, 5, 5, 5, 5,39,40,41,39, 5, 5, 5, 5, 5, 5,
 5, 5, 5, 5, 8, 0, 0, 0, 0, 9, 5, 5, 5, 5, 5,
 5, 5, 5, 5,36, 0, 0, 0, 0,43,41,40, 5, 5, 5,
 5, 5, 5, 7,PS, 0, 0, 0, 0, 0, 0, 0, 9, 5, 5,
 5, 5, 5,23,13,53,54,52, 0, 0, 0, 0,10, 5, 5,
 5, 5, 5, 5, 6, 0, 0, 0, 0, 0, 0,DR,11, 5, 5,
 5, 5, 5, 5, 7, 0, 0, 0, 0,49,53,54,26, 5, 5,
 5, 5, 5, 5, 8, 0, 0, 0, 0, 0, 0, 0, 9, 5, 5,
 5, 5, 5, 5,22,54,53,51, 0, 0, 0, 0,10, 5, 5,
 5, 5, 5, 5, 8, 0, 0, 0, 0, 0,RK,RK,11, 5, 5,
 5, 5, 5, 5, 7, 0, 0, 0, 0,50,54,53,25, 5, 5,
 5, 5, 5, 5, 6,RK,RK, 0, 0, 0, 0, 0, 9, 5, 5,
 5, 5, 5, 5,22,53,54,52, 0, 0, 0, 0,10, 5, 5,
 5, 5, 5, 5, 7, 0, 0, 0, 0, 0,RK,RK,11, 5, 5,
 5, 5, 5, 5, 6, 0, 0, 0, 0,49,53,54,24, 5, 5,
 5, 5, 5, 5, 8,RK,RK, 0, 0, 0, 0, 0,11, 5, 5,
 5, 5, 5, 5,22,13,14,29, 0, 0, 0, 0,10, 5, 5,
 5, 5, 5, 5, 5, 5, 5, 6, 0,RK,RK,RK, 9, 5, 5,
 5, 5, 5, 5, 5, 5, 5,21,13,12,13,14,26, 5, 5,
255,

//level 14
15,15,
 5,40,39,40,41,40,39,40, 5, 5, 5, 5, 5, 5, 5,
 6, 0, 0, 0, 0, 0, 0, 0,10, 5, 5, 5, 5, 5, 5,
 7,RK, 0, 0, 0, 0, 0,RK,43, 5, 5, 5, 5, 5, 5,
 8, 0,RK, 0, 0, 0,RK, 0, 0,42, 5, 5, 5, 5, 5,
21,52, 0,RK, 0, 0, 0,RK, 0, 0,43, 5, 5, 5, 5,
 6,DR, 0, 0,49,53,54,53,51, 0, 0,42,40,39, 5,
22,29, 0, 0, 0, 0, 0,PS, 0, 0, 0, 0, 0, 0,11,
 5, 7, 0,55, 0,RK,RK,RK, 0,55, 0, 0, 0,RK,10,
 5, 8, 0, 0,55, 0, 0, 0,55, 0, 0, 0,RK,RK, 9,
 5, 7, 0, 0, 0,55, 0,55, 0, 0, 0,32,14,13,25,
 5,21,27, 0, 0, 0,55, 0, 0, 0,31,26, 5, 5, 5,
 5, 5,22,28, 0, 0, 0, 0, 0,32,25, 5, 5, 5, 5,
 5, 5, 5,23,29, 0, 0, 0,31,24, 5, 5, 5, 5, 5,
 5, 5, 5, 5,21,27, 0,30,25, 5, 5, 5, 5, 5, 5,
 5, 5, 5, 5, 5,22,13,26, 5, 5, 5, 5, 5, 5, 5,
255,
};



