const char levelclear_song[] PROGMEM = {
0x00,0xc0,0x10,0x00,0xc1,0x11,0x00,0xc2,0x12,0x00,0xc3,0x0b,0x00,0xb0,0x07,0x76,0x00,0x90,0x45,0x40,0x00,0xb1,0x07,0x76,0x00,0x07,0x76,0x00,0x91,0x39,0x40,0x00,
0xb2,0x07,0x76,0x00,0x07,0x76,0x00,0x07,0x7f,0x00,0x92,0x51,0x40,0x03,0x90,0x46,0x40,0x00,0x91,0x3a,0x40,0x00,0x92,0x52,0x40,0x0c,0x90,0x27,0x40,0x00,0x91,0x1b,
0x40,0x00,0x92,0x33,0x40,0x03,0x90,0x2b,0x40,0x00,0x91,0x1f,0x40,0x00,0x92,0x37,0x40,0x04,0x90,0x2f,0x40,0x00,0x91,0x23,0x40,0x00,0x92,0x3b,0x40,0x04,0x90,0x33,
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0x40,0x00,0x92,0x43,0x40,0x0f,0x90,0x33,0x40,0x00,0x91,0x27,0x40,0x00,0x92,0x3f,0x40,0x17,0xff,0x2f,0x00 };
