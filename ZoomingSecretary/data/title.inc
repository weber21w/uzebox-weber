/*
 * Transformation file: ../data/title.xml
 * Source image: ../data/title.png
 * Tile width: 8px
 * Tile height: 8px
 * Output format: (null)
 */
#define TITLEMAP_WIDTH 24
#define TITLEMAP_HEIGHT 14
const char titleMap[] PROGMEM ={
24,14
,0x0,0x0,0x0,0x0,0x0,0x0,0x0,0x0,0x0,0x0,0x0,0x0,0x0,0x0,0x0,0x0,0x0,0x0,0x0,0x0
,0x0,0x0,0x0,0x0,0x0,0x1,0x2,0x2,0x2,0x2,0x2,0x2,0x2,0x2,0x2,0x2,0x3,0x3,0x4,0x5
,0x5,0x5,0x5,0x5,0x5,0x6,0x3,0x0,0x0,0x3,0x1,0x2,0x2,0x2,0x2,0x2,0x2,0x2,0x2,0x2
,0x3,0x4,0x5,0x5,0x5,0x5,0x5,0x5,0x5,0x5,0x6,0x0,0x0,0x3,0x3,0x3,0x3,0x3,0x3,0x3
,0x7,0x2,0x2,0x2,0x3,0x8,0x5,0x5,0x5,0x5,0x5,0x5,0x5,0x5,0x9,0x0,0x0,0x3,0x3,0x3
,0x3,0x3,0x3,0x7,0x2,0x2,0x2,0xa,0x3,0x3,0x8,0x5,0x5,0x5,0x6,0x3,0x3,0x3,0x3,0x0
,0x0,0x3,0x3,0x3,0x3,0x3,0x7,0x2,0x2,0x2,0xa,0x3,0x3,0x3,0x3,0x8,0x5,0x5,0x5,0x6
,0x3,0x3,0x3,0x0,0x0,0x3,0x3,0x3,0x3,0x7,0x2,0x2,0x2,0xa,0x3,0x3,0x3,0x3,0x3,0x3
,0x8,0x5,0x5,0x5,0x6,0x3,0x3,0x0,0x0,0x3,0x3,0x3,0x7,0x2,0x2,0x2,0xa,0x3,0x3,0x3
,0x3,0x3,0x3,0x3,0x3,0x8,0x5,0x5,0x5,0x6,0x3,0x0,0x0,0x3,0x3,0x7,0x2,0x2,0x2,0x2
,0x2,0xb,0x3,0x3,0x3,0x3,0x3,0x3,0x3,0x3,0x8,0x5,0x5,0x5,0x6,0x0,0x0,0x3,0x3,0x2
,0x2,0x2,0x2,0x2,0x2,0x2,0xb,0x3,0x8,0x5,0x5,0x5,0x5,0x5,0x5,0x5,0x5,0x5,0x9,0x0
,0x0,0x3,0x3,0x2,0x2,0x2,0x2,0x2,0x2,0x2,0x2,0xb,0x3,0x8,0x5,0x5,0x5,0x5,0x5,0x5
,0x5,0x9,0x3,0x0,0x0,0x0,0x0,0x0,0x0,0x0,0x0,0x0,0x0,0x0,0x0,0x0,0x0,0x0,0x0,0x0
,0x0,0x0,0x0,0x0,0x0,0x0,0x0,0x0,0x0,0x0,0xc,0xd,0xd,0xe,0xf,0x10,0x11,0x0,0x0,0x0
,0x0,0x12,0x13,0x14,0x15,0x13,0x16,0x17,0x15,0x18,0x0,0x0,0x0,0x0,0x0,0x0,0x0,0x0,0x0,0x0
,0x0,0x0,0x0,0x0,0x0,0x19,0x1a,0x19,0x1b,0x1a,0x1c,0x1d,0x1b,0x1c,0x0,0x0};

#define TITLETILES_SIZE 30
const char titleTiles[] PROGMEM={
 0xd9, 0xd9, 0xd9, 0xd9, 0xd9, 0xd9, 0xd9, 0xd9, 0xd9, 0xd9, 0xd9, 0xd9, 0xd9, 0xd9, 0xd9, 0xd9, 0xd9, 0xd9, 0xd9, 0xd9, 0xd9, 0xd9, 0xd9, 0xd9, 0xd9, 0xd9, 0xd9, 0xd9, 0xd9, 0xd9, 0xd9, 0xd9, 0xd9, 0xd9, 0xd9, 0xd9, 0xd9, 0xd9, 0xd9, 0xd9, 0xd9, 0xd9, 0xd9, 0xd9, 0xd9, 0xd9, 0xd9, 0xd9, 0xd9, 0xd9, 0xd9, 0xd9, 0xd9, 0xd9, 0xd9, 0xd9, 0xd9, 0xd9, 0xd9, 0xd9, 0xd9, 0xd9, 0xd9, 0xd9		 //tile:0
, 0xa1, 0xa1, 0xa1, 0xa1, 0xa1, 0xa1, 0xa1, 0xa1, 0x0, 0xa1, 0xa1, 0xa1, 0xa1, 0xa1, 0xa1, 0xa1, 0x0, 0x0, 0xa1, 0xa1, 0xa1, 0xa1, 0xa1, 0xa1, 0x0, 0x0, 0x0, 0xa1, 0xa1, 0xa1, 0xa1, 0xa1, 0x0, 0x0, 0x0, 0x0, 0xa1, 0xa1, 0xa1, 0xa1, 0x0, 0x0, 0x0, 0x0, 0x0, 0xa1, 0xa1, 0xa1, 0x0, 0x0, 0x0, 0x0, 0x0, 0x0, 0xa1, 0xa1, 0x0, 0x0, 0x0, 0x0, 0x0, 0x0, 0x0, 0xa1		 //tile:1
, 0xa1, 0xa1, 0xa1, 0xa1, 0xa1, 0xa1, 0xa1, 0xa1, 0xa1, 0xa1, 0xa1, 0xa1, 0xa1, 0xa1, 0xa1, 0xa1, 0xa1, 0xa1, 0xa1, 0xa1, 0xa1, 0xa1, 0xa1, 0xa1, 0xa1, 0xa1, 0xa1, 0xa1, 0xa1, 0xa1, 0xa1, 0xa1, 0xa1, 0xa1, 0xa1, 0xa1, 0xa1, 0xa1, 0xa1, 0xa1, 0xa1, 0xa1, 0xa1, 0xa1, 0xa1, 0xa1, 0xa1, 0xa1, 0xa1, 0xa1, 0xa1, 0xa1, 0xa1, 0xa1, 0xa1, 0xa1, 0xa1, 0xa1, 0xa1, 0xa1, 0xa1, 0xa1, 0xa1, 0xa1		 //tile:2
, 0x0, 0x0, 0x0, 0x0, 0x0, 0x0, 0x0, 0x0, 0x0, 0x0, 0x0, 0x0, 0x0, 0x0, 0x0, 0x0, 0x0, 0x0, 0x0, 0x0, 0x0, 0x0, 0x0, 0x0, 0x0, 0x0, 0x0, 0x0, 0x0, 0x0, 0x0, 0x0, 0x0, 0x0, 0x0, 0x0, 0x0, 0x0, 0x0, 0x0, 0x0, 0x0, 0x0, 0x0, 0x0, 0x0, 0x0, 0x0, 0x0, 0x0, 0x0, 0x0, 0x0, 0x0, 0x0, 0x0, 0x0, 0x0, 0x0, 0x0, 0x0, 0x0, 0x0, 0x0		 //tile:3
, 0x0, 0x0, 0x0, 0x0, 0x0, 0x0, 0x0, 0x9e, 0x0, 0x0, 0x0, 0x0, 0x0, 0x0, 0x9e, 0x9e, 0x0, 0x0, 0x0, 0x0, 0x0, 0x9e, 0x9e, 0x9e, 0x0, 0x0, 0x0, 0x0, 0x9e, 0x9e, 0x9e, 0x9e, 0x0, 0x0, 0x0, 0x9e, 0x9e, 0x9e, 0x9e, 0x9e, 0x0, 0x0, 0x9e, 0x9e, 0x9e, 0x9e, 0x9e, 0x9e, 0x0, 0x9e, 0x9e, 0x9e, 0x9e, 0x9e, 0x9e, 0x9e, 0x9e, 0x9e, 0x9e, 0x9e, 0x9e, 0x9e, 0x9e, 0x9e		 //tile:4
, 0x9e, 0x9e, 0x9e, 0x9e, 0x9e, 0x9e, 0x9e, 0x9e, 0x9e, 0x9e, 0x9e, 0x9e, 0x9e, 0x9e, 0x9e, 0x9e, 0x9e, 0x9e, 0x9e, 0x9e, 0x9e, 0x9e, 0x9e, 0x9e, 0x9e, 0x9e, 0x9e, 0x9e, 0x9e, 0x9e, 0x9e, 0x9e, 0x9e, 0x9e, 0x9e, 0x9e, 0x9e, 0x9e, 0x9e, 0x9e, 0x9e, 0x9e, 0x9e, 0x9e, 0x9e, 0x9e, 0x9e, 0x9e, 0x9e, 0x9e, 0x9e, 0x9e, 0x9e, 0x9e, 0x9e, 0x9e, 0x9e, 0x9e, 0x9e, 0x9e, 0x9e, 0x9e, 0x9e, 0x9e		 //tile:5
, 0x9e, 0x0, 0x0, 0x0, 0x0, 0x0, 0x0, 0x0, 0x9e, 0x9e, 0x0, 0x0, 0x0, 0x0, 0x0, 0x0, 0x9e, 0x9e, 0x9e, 0x0, 0x0, 0x0, 0x0, 0x0, 0x9e, 0x9e, 0x9e, 0x9e, 0x0, 0x0, 0x0, 0x0, 0x9e, 0x9e, 0x9e, 0x9e, 0x9e, 0x0, 0x0, 0x0, 0x9e, 0x9e, 0x9e, 0x9e, 0x9e, 0x9e, 0x0, 0x0, 0x9e, 0x9e, 0x9e, 0x9e, 0x9e, 0x9e, 0x9e, 0x0, 0x9e, 0x9e, 0x9e, 0x9e, 0x9e, 0x9e, 0x9e, 0x9e		 //tile:6
, 0x0, 0x0, 0x0, 0x0, 0x0, 0x0, 0x0, 0xa1, 0x0, 0x0, 0x0, 0x0, 0x0, 0x0, 0xa1, 0xa1, 0x0, 0x0, 0x0, 0x0, 0x0, 0xa1, 0xa1, 0xa1, 0x0, 0x0, 0x0, 0x0, 0xa1, 0xa1, 0xa1, 0xa1, 0x0, 0x0, 0x0, 0xa1, 0xa1, 0xa1, 0xa1, 0xa1, 0x0, 0x0, 0xa1, 0xa1, 0xa1, 0xa1, 0xa1, 0xa1, 0x0, 0xa1, 0xa1, 0xa1, 0xa1, 0xa1, 0xa1, 0xa1, 0xa1, 0xa1, 0xa1, 0xa1, 0xa1, 0xa1, 0xa1, 0xa1		 //tile:7
, 0x9e, 0x9e, 0x9e, 0x9e, 0x9e, 0x9e, 0x9e, 0x9e, 0x0, 0x9e, 0x9e, 0x9e, 0x9e, 0x9e, 0x9e, 0x9e, 0x0, 0x0, 0x9e, 0x9e, 0x9e, 0x9e, 0x9e, 0x9e, 0x0, 0x0, 0x0, 0x9e, 0x9e, 0x9e, 0x9e, 0x9e, 0x0, 0x0, 0x0, 0x0, 0x9e, 0x9e, 0x9e, 0x9e, 0x0, 0x0, 0x0, 0x0, 0x0, 0x9e, 0x9e, 0x9e, 0x0, 0x0, 0x0, 0x0, 0x0, 0x0, 0x9e, 0x9e, 0x0, 0x0, 0x0, 0x0, 0x0, 0x0, 0x0, 0x9e		 //tile:8
, 0x9e, 0x9e, 0x9e, 0x9e, 0x9e, 0x9e, 0x9e, 0x9e, 0x9e, 0x9e, 0x9e, 0x9e, 0x9e, 0x9e, 0x9e, 0x0, 0x9e, 0x9e, 0x9e, 0x9e, 0x9e, 0x9e, 0x0, 0x0, 0x9e, 0x9e, 0x9e, 0x9e, 0x9e, 0x0, 0x0, 0x0, 0x9e, 0x9e, 0x9e, 0x9e, 0x0, 0x0, 0x0, 0x0, 0x9e, 0x9e, 0x9e, 0x0, 0x0, 0x0, 0x0, 0x0, 0x9e, 0x9e, 0x0, 0x0, 0x0, 0x0, 0x0, 0x0, 0x9e, 0x0, 0x0, 0x0, 0x0, 0x0, 0x0, 0x0		 //tile:9
, 0xa1, 0xa1, 0xa1, 0xa1, 0xa1, 0xa1, 0xa1, 0xa1, 0xa1, 0xa1, 0xa1, 0xa1, 0xa1, 0xa1, 0xa1, 0x0, 0xa1, 0xa1, 0xa1, 0xa1, 0xa1, 0xa1, 0x0, 0x0, 0xa1, 0xa1, 0xa1, 0xa1, 0xa1, 0x0, 0x0, 0x0, 0xa1, 0xa1, 0xa1, 0xa1, 0x0, 0x0, 0x0, 0x0, 0xa1, 0xa1, 0xa1, 0x0, 0x0, 0x0, 0x0, 0x0, 0xa1, 0xa1, 0x0, 0x0, 0x0, 0x0, 0x0, 0x0, 0xa1, 0x0, 0x0, 0x0, 0x0, 0x0, 0x0, 0x0		 //tile:10
, 0xa1, 0x0, 0x0, 0x0, 0x0, 0x0, 0x0, 0x0, 0xa1, 0xa1, 0x0, 0x0, 0x0, 0x0, 0x0, 0x0, 0xa1, 0xa1, 0xa1, 0x0, 0x0, 0x0, 0x0, 0x0, 0xa1, 0xa1, 0xa1, 0xa1, 0x0, 0x0, 0x0, 0x0, 0xa1, 0xa1, 0xa1, 0xa1, 0xa1, 0x0, 0x0, 0x0, 0xa1, 0xa1, 0xa1, 0xa1, 0xa1, 0xa1, 0x0, 0x0, 0xa1, 0xa1, 0xa1, 0xa1, 0xa1, 0xa1, 0xa1, 0x0, 0xa1, 0xa1, 0xa1, 0xa1, 0xa1, 0xa1, 0xa1, 0xa1		 //tile:11
, 0xd9, 0xd9, 0xd9, 0xd9, 0xd9, 0xd9, 0xd9, 0xd9, 0x9d, 0x9d, 0x9d, 0x9d, 0x9d, 0x9d, 0x9d, 0xd9, 0xd9, 0xd9, 0xd9, 0xd9, 0x9d, 0x9d, 0x0, 0xd9, 0xd9, 0xd9, 0xd9, 0x9d, 0x9d, 0x0, 0xd9, 0xd9, 0xd9, 0xd9, 0x9d, 0x9d, 0x0, 0xd9, 0xd9, 0xd9, 0xd9, 0x9d, 0x9d, 0x0, 0xd9, 0xd9, 0xd9, 0xd9, 0x9d, 0x9d, 0x9d, 0x9d, 0x9d, 0x9d, 0x9d, 0xd9, 0xd9, 0x0, 0x0, 0x0, 0x0, 0x0, 0x0, 0x0		 //tile:12
, 0xd9, 0xd9, 0xd9, 0xd9, 0xd9, 0xd9, 0xd9, 0xd9, 0xd9, 0x9d, 0x9d, 0x9d, 0x9d, 0x9d, 0xd9, 0xd9, 0x9d, 0x9d, 0x0, 0x0, 0x0, 0x9d, 0x9d, 0xd9, 0x9d, 0x9d, 0x0, 0xd9, 0xd9, 0x9d, 0x9d, 0xd9, 0x9d, 0x9d, 0x0, 0xd9, 0xd9, 0x9d, 0x9d, 0xd9, 0x9d, 0x9d, 0x0, 0xd9, 0xd9, 0x9d, 0x9d, 0xd9, 0xd9, 0x9d, 0x9d, 0x9d, 0x9d, 0x9d, 0x0, 0xd9, 0xd9, 0xd9, 0x0, 0x0, 0x0, 0x0, 0xd9, 0xd9		 //tile:13
, 0xd9, 0xd9, 0xd9, 0xd9, 0xd9, 0xd9, 0xd9, 0xd9, 0x9d, 0x9d, 0xd9, 0xd9, 0xd9, 0x9d, 0x9d, 0xd9, 0x9d, 0x9d, 0x9d, 0xd9, 0x9d, 0x9d, 0x9d, 0x0, 0x9d, 0x9d, 0x9d, 0x9d, 0x9d, 0x9d, 0x9d, 0x0, 0x9d, 0x9d, 0x0, 0x9d, 0x0, 0x9d, 0x9d, 0x0, 0x9d, 0x9d, 0x0, 0xd9, 0x0, 0x9d, 0x9d, 0x0, 0x9d, 0x9d, 0x0, 0xd9, 0xd9, 0x9d, 0x9d, 0x0, 0xd9, 0x0, 0x0, 0xd9, 0xd9, 0xd9, 0x0, 0x0		 //tile:14
, 0xd9, 0xd9, 0x9d, 0x9d, 0x9d, 0xd9, 0xd9, 0xd9, 0xd9, 0xd9, 0xd9, 0x0, 0x0, 0x0, 0xd9, 0xd9, 0xd9, 0x9d, 0x9d, 0x9d, 0x9d, 0x9d, 0xd9, 0xd9, 0xd9, 0xd9, 0x9d, 0x9d, 0x9d, 0x0, 0xd9, 0xd9, 0xd9, 0xd9, 0x9d, 0x9d, 0x9d, 0x0, 0xd9, 0xd9, 0xd9, 0xd9, 0x9d, 0x9d, 0x9d, 0x0, 0xd9, 0xd9, 0xd9, 0x9d, 0x9d, 0x9d, 0x9d, 0x9d, 0xd9, 0xd9, 0xd9, 0xd9, 0x0, 0x0, 0x0, 0x0, 0x0, 0xd9		 //tile:15
, 0xd9, 0xd9, 0xd9, 0xd9, 0xd9, 0xd9, 0xd9, 0xd9, 0x9d, 0x9d, 0xd9, 0xd9, 0xd9, 0x9d, 0x9d, 0xd9, 0x9d, 0x9d, 0x9d, 0xd9, 0xd9, 0x9d, 0x9d, 0x0, 0x9d, 0x9d, 0x9d, 0x9d, 0xd9, 0x9d, 0x9d, 0x0, 0x9d, 0x9d, 0x9d, 0x9d, 0x9d, 0x9d, 0x9d, 0x0, 0x9d, 0x9d, 0x0, 0x9d, 0x9d, 0x9d, 0x9d, 0x0, 0x9d, 0x9d, 0x0, 0xd9, 0x9d, 0x9d, 0x9d, 0x0, 0xd9, 0x0, 0x0, 0xd9, 0xd9, 0x0, 0x0, 0x0		 //tile:16
, 0xd9, 0xd9, 0xd9, 0xd9, 0xd9, 0xd9, 0xd9, 0xd9, 0xd9, 0x9d, 0x9d, 0x9d, 0x9d, 0x9d, 0xd9, 0xd9, 0x9d, 0x9d, 0x0, 0x0, 0x0, 0x9d, 0x9d, 0x0, 0x9d, 0x9d, 0x0, 0xd9, 0xd9, 0xd9, 0xd9, 0xd9, 0x9d, 0x9d, 0x0, 0x9d, 0x9d, 0x9d, 0x9d, 0xd9, 0x9d, 0x9d, 0x0, 0xd9, 0xd9, 0x9d, 0x9d, 0x0, 0xd9, 0x9d, 0x9d, 0x9d, 0x9d, 0x9d, 0x0, 0xd9, 0xd9, 0xd9, 0x0, 0x0, 0x0, 0x0, 0xd9, 0xd9		 //tile:17
, 0xd9, 0xd9, 0xd9, 0xd9, 0xd9, 0xd9, 0xd9, 0xd9, 0xd9, 0xd9, 0xd9, 0xd9, 0xd9, 0xd9, 0xd9, 0xd9, 0xd9, 0x34, 0x34, 0x34, 0x34, 0xd9, 0xd9, 0xd9, 0x34, 0x34, 0x0, 0x0, 0x0, 0x0, 0xd9, 0xd9, 0xd9, 0x34, 0x34, 0x34, 0x34, 0x34, 0xd9, 0xd9, 0xd9, 0xd9, 0xd9, 0xd9, 0xd9, 0x34, 0x34, 0xd9, 0x34, 0x34, 0xd9, 0xd9, 0xd9, 0x34, 0x34, 0xd9, 0xd9, 0x34, 0x34, 0x34, 0x34, 0x34, 0x0, 0xd9		 //tile:18
, 0xd9, 0xd9, 0xd9, 0xd9, 0xd9, 0xd9, 0xd9, 0xd9, 0xd9, 0xd9, 0xd9, 0xd9, 0xd9, 0xd9, 0xd9, 0xd9, 0x34, 0x34, 0x34, 0x34, 0x34, 0x34, 0x34, 0xd9, 0x34, 0x34, 0x0, 0x0, 0x0, 0x0, 0x0, 0xd9, 0x34, 0x34, 0x34, 0x34, 0x34, 0x34, 0xd9, 0xd9, 0x34, 0x34, 0x0, 0x0, 0x0, 0x0, 0x0, 0xd9, 0x34, 0x34, 0x0, 0xd9, 0xd9, 0xd9, 0xd9, 0xd9, 0x34, 0x34, 0x34, 0x34, 0x34, 0x34, 0x34, 0xd9		 //tile:19
, 0xd9, 0xd9, 0xd9, 0xd9, 0xd9, 0xd9, 0xd9, 0xd9, 0xd9, 0xd9, 0xd9, 0xd9, 0xd9, 0xd9, 0xd9, 0xd9, 0xd9, 0x34, 0x34, 0x34, 0x34, 0x34, 0xd9, 0xd9, 0x34, 0x34, 0x0, 0x0, 0x0, 0x34, 0x34, 0xd9, 0x34, 0x34, 0x0, 0xd9, 0xd9, 0xd9, 0x0, 0x0, 0x34, 0x34, 0x0, 0xd9, 0xd9, 0xd9, 0xd9, 0xd9, 0x34, 0x34, 0x0, 0xd9, 0xd9, 0x34, 0x34, 0x0, 0xd9, 0x34, 0x34, 0x34, 0x34, 0x34, 0x0, 0xd9		 //tile:20
, 0xd9, 0xd9, 0xd9, 0xd9, 0xd9, 0xd9, 0xd9, 0xd9, 0xd9, 0xd9, 0xd9, 0xd9, 0xd9, 0xd9, 0xd9, 0xd9, 0x34, 0x34, 0x34, 0x34, 0x34, 0x34, 0xd9, 0xd9, 0x34, 0x34, 0x0, 0x0, 0x0, 0x34, 0x34, 0x0, 0x34, 0x34, 0x0, 0xd9, 0xd9, 0x34, 0x34, 0x0, 0x34, 0x34, 0x0, 0xd9, 0x34, 0x34, 0x0, 0xd9, 0x34, 0x34, 0x34, 0x34, 0x34, 0x34, 0x0, 0xd9, 0x34, 0x34, 0x0, 0x0, 0x0, 0x34, 0x34, 0x0		 //tile:21
, 0xd9, 0xd9, 0xd9, 0xd9, 0xd9, 0xd9, 0xd9, 0xd9, 0xd9, 0xd9, 0xd9, 0xd9, 0xd9, 0xd9, 0xd9, 0xd9, 0x34, 0x34, 0x34, 0x34, 0x34, 0x34, 0x34, 0x0, 0xd9, 0xd9, 0x34, 0x34, 0x34, 0x0, 0x0, 0x0, 0xd9, 0xd9, 0x34, 0x34, 0x34, 0x0, 0xd9, 0xd9, 0xd9, 0xd9, 0x34, 0x34, 0x34, 0x0, 0xd9, 0xd9, 0xd9, 0xd9, 0x34, 0x34, 0x34, 0x0, 0xd9, 0xd9, 0xd9, 0xd9, 0x34, 0x34, 0x34, 0x0, 0xd9, 0xd9		 //tile:22
, 0xd9, 0xd9, 0xd9, 0xd9, 0xd9, 0xd9, 0xd9, 0xd9, 0xd9, 0xd9, 0xd9, 0xd9, 0xd9, 0xd9, 0xd9, 0xd9, 0xd9, 0x34, 0x34, 0x34, 0x34, 0x34, 0xd9, 0xd9, 0x34, 0x34, 0x0, 0x0, 0x0, 0x34, 0x34, 0xd9, 0x34, 0x34, 0x0, 0xd9, 0xd9, 0x34, 0x34, 0x0, 0x34, 0x34, 0x0, 0xd9, 0xd9, 0x34, 0x34, 0x0, 0x34, 0x34, 0x34, 0x34, 0x34, 0x34, 0x34, 0x0, 0x34, 0x34, 0x0, 0x0, 0x0, 0x34, 0x34, 0x0		 //tile:23
, 0xd9, 0xd9, 0xd9, 0xd9, 0xd9, 0xd9, 0xd9, 0xd9, 0xd9, 0xd9, 0xd9, 0xd9, 0xd9, 0xd9, 0xd9, 0xd9, 0x34, 0x34, 0x0, 0xd9, 0xd9, 0x34, 0x34, 0x0, 0x34, 0x34, 0x0, 0xd9, 0xd9, 0x34, 0x34, 0x0, 0xd9, 0x34, 0x34, 0xd9, 0xd9, 0x34, 0x34, 0x0, 0xd9, 0xd9, 0x34, 0x34, 0x34, 0x34, 0x34, 0x0, 0xd9, 0xd9, 0xd9, 0xd9, 0xd9, 0x34, 0x34, 0x0, 0xd9, 0xd9, 0x34, 0x34, 0x34, 0x34, 0x0, 0xd9		 //tile:24
, 0xd9, 0xd9, 0x0, 0x0, 0x0, 0x0, 0xd9, 0xd9, 0xd9, 0xd9, 0xd9, 0xd9, 0xd9, 0xd9, 0xd9, 0xd9, 0xd9, 0xd9, 0xd9, 0xd9, 0xd9, 0xd9, 0xd9, 0xd9, 0xd9, 0xd9, 0xd9, 0xd9, 0xd9, 0xd9, 0xd9, 0xd9, 0xd9, 0xd9, 0xd9, 0xd9, 0xd9, 0xd9, 0xd9, 0xd9, 0xd9, 0xd9, 0xd9, 0xd9, 0xd9, 0xd9, 0xd9, 0xd9, 0xd9, 0xd9, 0xd9, 0xd9, 0xd9, 0xd9, 0xd9, 0xd9, 0xd9, 0xd9, 0xd9, 0xd9, 0xd9, 0xd9, 0xd9, 0xd9		 //tile:25
, 0xd9, 0x0, 0x0, 0x0, 0x0, 0x0, 0x0, 0x0, 0xd9, 0xd9, 0xd9, 0xd9, 0xd9, 0xd9, 0xd9, 0xd9, 0xd9, 0xd9, 0xd9, 0xd9, 0xd9, 0xd9, 0xd9, 0xd9, 0xd9, 0xd9, 0xd9, 0xd9, 0xd9, 0xd9, 0xd9, 0xd9, 0xd9, 0xd9, 0xd9, 0xd9, 0xd9, 0xd9, 0xd9, 0xd9, 0xd9, 0xd9, 0xd9, 0xd9, 0xd9, 0xd9, 0xd9, 0xd9, 0xd9, 0xd9, 0xd9, 0xd9, 0xd9, 0xd9, 0xd9, 0xd9, 0xd9, 0xd9, 0xd9, 0xd9, 0xd9, 0xd9, 0xd9, 0xd9		 //tile:26
, 0x0, 0x0, 0xd9, 0xd9, 0xd9, 0x0, 0x0, 0x0, 0xd9, 0xd9, 0xd9, 0xd9, 0xd9, 0xd9, 0xd9, 0xd9, 0xd9, 0xd9, 0xd9, 0xd9, 0xd9, 0xd9, 0xd9, 0xd9, 0xd9, 0xd9, 0xd9, 0xd9, 0xd9, 0xd9, 0xd9, 0xd9, 0xd9, 0xd9, 0xd9, 0xd9, 0xd9, 0xd9, 0xd9, 0xd9, 0xd9, 0xd9, 0xd9, 0xd9, 0xd9, 0xd9, 0xd9, 0xd9, 0xd9, 0xd9, 0xd9, 0xd9, 0xd9, 0xd9, 0xd9, 0xd9, 0xd9, 0xd9, 0xd9, 0xd9, 0xd9, 0xd9, 0xd9, 0xd9		 //tile:27
, 0xd9, 0xd9, 0xd9, 0x0, 0x0, 0x0, 0xd9, 0xd9, 0xd9, 0xd9, 0xd9, 0xd9, 0xd9, 0xd9, 0xd9, 0xd9, 0xd9, 0xd9, 0xd9, 0xd9, 0xd9, 0xd9, 0xd9, 0xd9, 0xd9, 0xd9, 0xd9, 0xd9, 0xd9, 0xd9, 0xd9, 0xd9, 0xd9, 0xd9, 0xd9, 0xd9, 0xd9, 0xd9, 0xd9, 0xd9, 0xd9, 0xd9, 0xd9, 0xd9, 0xd9, 0xd9, 0xd9, 0xd9, 0xd9, 0xd9, 0xd9, 0xd9, 0xd9, 0xd9, 0xd9, 0xd9, 0xd9, 0xd9, 0xd9, 0xd9, 0xd9, 0xd9, 0xd9, 0xd9		 //tile:28
, 0xd9, 0x0, 0x0, 0xd9, 0xd9, 0xd9, 0x0, 0x0, 0xd9, 0xd9, 0xd9, 0xd9, 0xd9, 0xd9, 0xd9, 0xd9, 0xd9, 0xd9, 0xd9, 0xd9, 0xd9, 0xd9, 0xd9, 0xd9, 0xd9, 0xd9, 0xd9, 0xd9, 0xd9, 0xd9, 0xd9, 0xd9, 0xd9, 0xd9, 0xd9, 0xd9, 0xd9, 0xd9, 0xd9, 0xd9, 0xd9, 0xd9, 0xd9, 0xd9, 0xd9, 0xd9, 0xd9, 0xd9, 0xd9, 0xd9, 0xd9, 0xd9, 0xd9, 0xd9, 0xd9, 0xd9, 0xd9, 0xd9, 0xd9, 0xd9, 0xd9, 0xd9, 0xd9, 0xd9		 //tile:29
};
