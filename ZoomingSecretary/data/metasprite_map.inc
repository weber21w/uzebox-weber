const uint8_t sprSecretaryWalk1R[] PROGMEM = {
0,0,0x00,0,
8,0,0x01,0,
0,8,0x09,0,
8,8,0x0a,0,
0,16,0x18,0,
8,16,0x19,0,
128
};

const uint8_t sprSecretaryWalk2R[] PROGMEM = {
0,0,0x02,0,
8,0,0x03,0,
0,8,0x0b,0,
8,8,0x0c,0,
0,16,0x1a,0,
8,16,0x1b,0,
128
};

const uint8_t sprSecretaryWalk3R[] PROGMEM = {
0,0,0x00,0,
8,0,0x01,0,
0,8,0x0d,0,
8,8,0x0e,0,
0,16,0x1c,0,
8,16,0x1d,0,
128
};

const uint8_t sprSecretaryWalk4R[] PROGMEM = {
0,0,0x02,0,
8,0,0x03,0,
0,8,0x0b,0,
8,8,0x0f,0,
0,16,0x1e,0,
8,16,0x1f,0,
128
};

const uint8_t sprSecretaryWalk1L[] PROGMEM = {
0,0,0x01,SPRITE_FLIP_X,
8,0,0x00,SPRITE_FLIP_X,
0,8,0x0a,SPRITE_FLIP_X,
8,8,0x09,SPRITE_FLIP_X,
0,16,0x19,SPRITE_FLIP_X,
8,16,0x18,SPRITE_FLIP_X,
128
};

const uint8_t sprSecretaryWalk2L[] PROGMEM = {
0,0,0x03,SPRITE_FLIP_X,
8,0,0x02,SPRITE_FLIP_X,
0,8,0x0c,SPRITE_FLIP_X,
8,8,0x0b,SPRITE_FLIP_X,
0,16,0x1b,SPRITE_FLIP_X,
8,16,0x1a,SPRITE_FLIP_X,
128
};

const uint8_t sprSecretaryWalk3L[] PROGMEM = {
0,0,0x01,SPRITE_FLIP_X,
8,0,0x00,SPRITE_FLIP_X,
0,8,0x0e,SPRITE_FLIP_X,
8,8,0x0d,SPRITE_FLIP_X,
0,16,0x1d,SPRITE_FLIP_X,
8,16,0x1c,SPRITE_FLIP_X,
128
};

const uint8_t sprSecretaryWalk4L[] PROGMEM = {
0,0,0x03,SPRITE_FLIP_X,
8,0,0x02,SPRITE_FLIP_X,
0,8,0x0f,SPRITE_FLIP_X,
8,8,0x0b,SPRITE_FLIP_X,
0,16,0x1f,SPRITE_FLIP_X,
8,16,0x1e,SPRITE_FLIP_X,
128
};

const uint8_t sprSecretaryAnswer1R[] PROGMEM = {
0,0,0x00,0,
8,0,0x3e,0,
0,8,0x09,0,
8,8,0xf0,0,////0xfe,0,
0,16,0x18,0,
8,16,0x19,0,
128
};

const uint8_t sprSecretaryAnswer2R[] PROGMEM = {
0,0,0x02,0,
8,0,0x08,0,
0,8,0x0b,0,
8,8,0xef,0,/////0xfb,0,
0,16,0x1a,0,
8,16,0x1b,0,
128
};

const uint8_t sprSecretaryAnswer3R[] PROGMEM = {
0,0,0x00,0,
8,0,0x3e,0,
0,8,0x0d,0,
8,8,0xf0,0,/////0xfe,0,
0,16,0x1c,0,
8,16,0x1d,0,
128
};

const uint8_t sprSecretaryAnswer4R[] PROGMEM = {
0,0,0x02,0,
8,0,0x08,0,
0,8,0x0b,0,
8,8,0xf1,0,
0,16,0x1e,0,
8,16,0x1f,0,
128
};

const uint8_t sprSecretaryAnswer1L[] PROGMEM = {
0,0,0x3e,SPRITE_FLIP_X,
8,0,0x00,SPRITE_FLIP_X,
0,8,0xf0,SPRITE_FLIP_X,
8,8,0x09,SPRITE_FLIP_X,
0,16,0x19,SPRITE_FLIP_X,
8,16,0x18,SPRITE_FLIP_X,
128
};

const uint8_t sprSecretaryAnswer2L[] PROGMEM = {
0,0,0x08,SPRITE_FLIP_X,
8,0,0x02,SPRITE_FLIP_X,
0,8,0xef,SPRITE_FLIP_X,
8,8,0x0b,SPRITE_FLIP_X,
0,16,0x1b,SPRITE_FLIP_X,
8,16,0x1a,SPRITE_FLIP_X,
128
};

const uint8_t sprSecretaryAnswer3L[] PROGMEM = {
0,0,0x3e,SPRITE_FLIP_X,
8,0,0x00,SPRITE_FLIP_X,
0,8,0xf0,SPRITE_FLIP_X,
8,8,0x0d,SPRITE_FLIP_X,
0,16,0x1d,SPRITE_FLIP_X,
8,16,0x1c,SPRITE_FLIP_X,
128
};

const uint8_t sprSecretaryAnswer4L[] PROGMEM = {
0,0,0x08,SPRITE_FLIP_X,
8,0,0x02,SPRITE_FLIP_X,
0,8,0xf1,SPRITE_FLIP_X,
8,8,0x0b,SPRITE_FLIP_X,
0,16,0x1f,SPRITE_FLIP_X,
8,16,0x1e,SPRITE_FLIP_X,
128
};


const uint8_t sprSecretaryWalk1D[] PROGMEM = {
0,0,0x04,0,
8,0,0x05,0,
0,8,0x10,0,
8,8,0x11,0,
0,16,0x20,0,
8,16,0x21,0,
128
};

const uint8_t sprSecretaryWalk2D[] PROGMEM = {
0,0,0x04,0,
8,0,0x05,0,
0,8,0x12,0,
8,8,0x13,0,
0,16,0x22,0,
8,16,0x23,0,
128
};

const uint8_t sprSecretaryWalk1U[] PROGMEM = {
0,0,0x06,0,
8,0,0x07,0,
0,8,0x14,0,
8,8,0x15,0,
0,16,0x20,0,
8,16,0x24,0,
128
};

const uint8_t sprSecretaryWalk2U[] PROGMEM = {
0,0,0x06,0,
8,0,0x07,0,
0,8,0x16,0,
8,8,0x17,0,
0,16,0x25,0,
8,16,0x23,0,
128
};

const uint8_t sprSecretaryKnocked1R[] PROGMEM = {
0,0,0x00,0,
8,0,0x01,0,
0,8,0x26,0,
8,8,0x27,0,
0,16,0x2a,0,
8,16,0x2b,0,
128
};

const uint8_t sprSecretaryKnocked2R[] PROGMEM = {
//0,0,0xfa,0,
//8,0,0xfa,0,
0,8,0x28,0,
8,8,0x29,0,
0,16,0x2c,0,
8,16,0x2d,0,
128
};

const uint8_t sprSecretaryKnocked1L[] PROGMEM = {
0,0,0x01,SPRITE_FLIP_X,
8,0,0x00,SPRITE_FLIP_X,
0,8,0x27,SPRITE_FLIP_X,
8,8,0x26,SPRITE_FLIP_X,
0,16,0x2b,SPRITE_FLIP_X,
8,16,0x2a,SPRITE_FLIP_X,
128
};

const uint8_t sprSecretaryKnocked2L[] PROGMEM = {
//0,0,0xfa,SPRITE_FLIP_X,
//8,0,0xfa,SPRITE_FLIP_X,
0,8,0x29,SPRITE_FLIP_X,
8,8,0x28,SPRITE_FLIP_X,
0,16,0x2d,SPRITE_FLIP_X,
8,16,0x2c,SPRITE_FLIP_X,
128
};

const uint8_t sprSecretaryRest1[] PROGMEM = {
8,-2,0xe2,0,
16,-2,0xe3,0,

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16,8,0xe1,0,

128
};

const uint8_t sprSecretaryRest2[] PROGMEM = {
8,-2,0xe2,0,
16,-2,0xe3,0,

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16,8,0xe1,0,

128
};

const uint8_t sprSecretaryRest3[] PROGMEM = {
8,-12,0xe4,0,
16,-12,0xe5,0,
8,-4,0xe8,0,
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16,8,0xe1,0,

128
};

const uint8_t sprSecretaryRest4[] PROGMEM = {
8,-12,0xe6,0,
16,-12,0xe7,0,
8,-4,0xea,0,
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16,8,0xe1,0,

128
};



const uint8_t sprChiefGhostR[] PROGMEM = {
0,0,0x2e,0,
8,0,0x2f,0,
16,0,0x94,0,
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16,16,0xc6,0,
128
};

const uint8_t sprChiefGhostL[] PROGMEM = {
0,0,0x94,SPRITE_FLIP_X,
8,0,0x2f,SPRITE_FLIP_X,
16,0,0x2e,SPRITE_FLIP_X,
0,8,0x97,SPRITE_FLIP_X,
8,8,0x96,SPRITE_FLIP_X,
16,8,0x95,SPRITE_FLIP_X,
0,16,0xc6,SPRITE_FLIP_X,
8,16,0xc5,SPRITE_FLIP_X,
16,16,0x98,SPRITE_FLIP_X,
128
};

const uint8_t sprChiefGhostBlaR[] PROGMEM = {
0,0,0x2e,0,
8,0,0x2f,0,
16,0,0x94,0,
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16,16,0xee,0,
128
};

const uint8_t sprChiefGhostBlaL[] PROGMEM = {
0,0,0x94,SPRITE_FLIP_X,
8,0,0x2f,SPRITE_FLIP_X,
16,0,0x2e,SPRITE_FLIP_X,
0,8,0x97,SPRITE_FLIP_X,
8,8,0x96,SPRITE_FLIP_X,
16,8,0x95,SPRITE_FLIP_X,
0,16,0xee,SPRITE_FLIP_X,
8,16,0xed,SPRITE_FLIP_X,
16,16,0x98,SPRITE_FLIP_X,
128
};



const uint8_t sprChiefWalk1R[] PROGMEM = {
0,0,0x40,0,
8,0,0x41,0,
0,8,0x47,0,
8,8,0x48,0,
0,16,0x4b,0,
8,16,0x4c,0,
128
};

const uint8_t sprChiefWalk2R[] PROGMEM = {
0,0,0x42,0,
8,0,0x43,0,
0,8,0x49,0,
8,8,0x4a,0,
0,16,0x4d,0,
8,16,0x4e,0,
128
};

const uint8_t sprChiefWalk3R[] PROGMEM = {
0,0,0x40,0,
8,0,0x41,0,
0,8,0x47,0,
8,8,0x48,0,
0,16,0x4f,0,
8,16,0x50,0,
128
};

const uint8_t sprChiefWalk4R[] PROGMEM = {
0,0,0x42,0,
8,0,0x43,0,
0,8,0x49,0,
8,8,0x4a,0,
0,16,0x51,0,
8,16,0x52,0,
128
};

const uint8_t sprChiefWalk1L[] PROGMEM = {
0,0,0x41,SPRITE_FLIP_X,
8,0,0x40,SPRITE_FLIP_X,
0,8,0x48,SPRITE_FLIP_X,
8,8,0x47,SPRITE_FLIP_X,
0,16,0x4c,SPRITE_FLIP_X,
8,16,0x4b,SPRITE_FLIP_X,
128
};

const uint8_t sprChiefWalk2L[] PROGMEM = {
0,0,0x43,SPRITE_FLIP_X,
8,0,0x42,SPRITE_FLIP_X,
0,8,0x4a,SPRITE_FLIP_X,
8,8,0x49,SPRITE_FLIP_X,
0,16,0x4e,SPRITE_FLIP_X,
8,16,0x4d,SPRITE_FLIP_X,
128
};

const uint8_t sprChiefWalk3L[] PROGMEM = {
0,0,0x41,SPRITE_FLIP_X,
8,0,0x40,SPRITE_FLIP_X,
0,8,0x48,SPRITE_FLIP_X,
8,8,0x47,SPRITE_FLIP_X,
0,16,0x50,SPRITE_FLIP_X,
8,16,0x4f,SPRITE_FLIP_X,
128
};

const uint8_t sprChiefWalk4L[] PROGMEM = {
0,0,0x43,SPRITE_FLIP_X,
8,0,0x42,SPRITE_FLIP_X,
0,8,0x4a,SPRITE_FLIP_X,
8,8,0x49,SPRITE_FLIP_X,
0,16,0x52,SPRITE_FLIP_X,
8,16,0x51,SPRITE_FLIP_X,
128
};

const uint8_t sprChiefTalk1R[] PROGMEM = {
0,0,0x42,0,
8,0,0x43,0,
0,8,0x49,0,
8,8,0x4a,0,
0,16,0x53,0,
8,16,0x54,0,
128
};

const uint8_t sprChiefTalk2R[] PROGMEM = {
0,0,0x42,0,
8,0,0x43,0,
0,8,0x49,0,
8,8,0x4a,0,
0,16,0x53,0,
8,16,0x54,0,
128
};

const uint8_t sprChiefTalk3R[] PROGMEM = {
0,0,0x44,0,
8,0,0x45,0,
0,8,0x49,0,
8,8,0x4a,0,
0,16,0x53,0,
8,16,0x54,0,
128
};

const uint8_t sprChiefTalk1L[] PROGMEM = {
0,0,0x43,SPRITE_FLIP_X,
8,0,0x42,SPRITE_FLIP_X,
0,8,0x4a,SPRITE_FLIP_X,
8,8,0x49,SPRITE_FLIP_X,
0,16,0x54,SPRITE_FLIP_X,
8,16,0x53,SPRITE_FLIP_X,
128
};

const uint8_t sprChiefTalk2L[] PROGMEM = {
0,0,0x43,SPRITE_FLIP_X,
8,0,0x42,SPRITE_FLIP_X,
0,8,0x4a,SPRITE_FLIP_X,
8,8,0x49,SPRITE_FLIP_X,
0,16,0x54,SPRITE_FLIP_X,
8,16,0x53,SPRITE_FLIP_X,
128
};

const uint8_t sprChiefTalk3L[] PROGMEM = {
0,0,0x45,SPRITE_FLIP_X,
8,0,0x44,SPRITE_FLIP_X,
0,8,0x4a,SPRITE_FLIP_X,
8,8,0x49,SPRITE_FLIP_X,
0,16,0x54,SPRITE_FLIP_X,
8,16,0x53,SPRITE_FLIP_X,
128
};



const uint8_t sprBouncerWalk1R[] PROGMEM = {
0,0,0x55,0,
8,0,0x56,0,
0,8,0x5c,0,
8,8,0x5d,0,
0,16,0x62,0,
8,16,0x63,0,
128
};

const uint8_t sprBouncerWalk2R[] PROGMEM = {
0,0,0x57,0,
8,0,0x58,0,
0,8,0x5e,0,
8,8,0x5f,0,
0,16,0x64,0,
8,16,0x65,0,
128
};

const uint8_t sprBouncerWalk3R[] PROGMEM = {
0,0,0x59,0,
8,0,0x5a,0,
0,8,0x5c,0,
8,8,0x60,0,
0,16,0x66,0,
8,16,0x67,0,
128
};

const uint8_t sprBouncerWalk4R[] PROGMEM = {
0,0,0x57,0,
8,0,0x5b,0,
0,8,0x5e,0,
8,8,0x61,0,
0,16,0x68,0,
8,16,0x69,0,
128
};

const uint8_t sprBouncerWalk1L[] PROGMEM = {
0,0,0x56,SPRITE_FLIP_X,
8,0,0x55,SPRITE_FLIP_X,
0,8,0x5d,SPRITE_FLIP_X,
8,8,0x5c,SPRITE_FLIP_X,
0,16,0x63,SPRITE_FLIP_X,
8,16,0x62,SPRITE_FLIP_X,
128
};

const uint8_t sprBouncerWalk2L[] PROGMEM = {
0,0,0x58,SPRITE_FLIP_X,
8,0,0x57,SPRITE_FLIP_X,
0,8,0x5f,SPRITE_FLIP_X,
8,8,0x5e,SPRITE_FLIP_X,
0,16,0x65,SPRITE_FLIP_X,
8,16,0x64,SPRITE_FLIP_X,
128
};

const uint8_t sprBouncerWalk3L[] PROGMEM = {
0,0,0x5a,SPRITE_FLIP_X,
8,0,0x59,SPRITE_FLIP_X,
0,8,0x60,SPRITE_FLIP_X,
8,8,0x5c,SPRITE_FLIP_X,
0,16,0x67,SPRITE_FLIP_X,
8,16,0x66,SPRITE_FLIP_X,
128
};

const uint8_t sprBouncerWalk4L[] PROGMEM = {
0,0,0x5b,SPRITE_FLIP_X,
8,0,0x57,SPRITE_FLIP_X,
0,8,0x61,SPRITE_FLIP_X,
8,8,0x5e,SPRITE_FLIP_X,
0,16,0x69,SPRITE_FLIP_X,
8,16,0x68,SPRITE_FLIP_X,
128
};



const uint8_t sprChatterWalk1R[] PROGMEM = {
0,0,0x6a,0,
8,0,0x6b,0,
0,8,0x7a,0,
8,8,0x7b,0,
0,16,0x8a,0,
8,16,0x8b,0,
128
};

const uint8_t sprChatterWalk2R[] PROGMEM = {
0,0,0x6c,0,
8,0,0x6d,0,
0,8,0x7c,0,
8,8,0x7d,0,
0,16,0x8c,0,
8,16,0x8d,0,
128
};

const uint8_t sprChatterWalk3R[] PROGMEM = {
0,0,0x6a,0,
8,0,0x6b,0,
0,8,0x7a,0,
8,8,0x7b,0,
0,16,0x8e,0,
8,16,0x8f,0,
128
};

const uint8_t sprChatterWalk4R[] PROGMEM = {
0,0,0x6c,0,
8,0,0x6d,0,
0,8,0x7e,0,
8,8,0x7f,0,
0,16,0x90,0,
8,16,0x91,0,
128
};

const uint8_t sprChatterTalk1R[] PROGMEM = {
0,0,0x6a,0,
8,0,0x6b,0,
0,8,0x80,0,
8,8,0x81,0,
0,16,0x92,0,
8,16,0x93,0,
128
};

const uint8_t sprChatterTalk2R[] PROGMEM = {
0,0,0x6a,0,
8,0,0x6e,0,
0,8,0x82,0,
8,8,0x83,0,
0,16,0x92,0,
8,16,0x93,0,
128
};

const uint8_t sprChatterTalk3R[] PROGMEM = {
0,0,0x6f,0,
8,0,0x70,0,
0,8,0x82,0,
8,8,0x83,0,
0,16,0x92,0,
8,16,0x93,0,
128
};

const uint8_t sprChatterTalk4R[] PROGMEM = {
0,0,0x6f,0,
8,0,0x71,0,
0,8,0x7a,0,
8,8,0x84,0,
0,16,0x92,0,
8,16,0x93,0,
128
};

const uint8_t sprChatterTalk5R[] PROGMEM = {
0,0,0x72,0,
8,0,0x73,0,
0,8,0x85,0,
8,8,0x86,0,
0,16,0x92,0,
8,16,0x93,0,
128
};

const uint8_t sprChatterTalk6R[] PROGMEM = {
0,0,0x72,0,
8,0,0x74,0,
0,8,0x85,0,
8,8,0x87,0,
0,16,0x92,0,
8,16,0x93,0,
128
};

const uint8_t sprChatterTalk7R[] PROGMEM = {
0,0,0x75,0,
8,0,0x76,0,
0,8,0x88,0,
8,8,0x86,0,
0,16,0x92,0,
8,16,0x93,0,
128
};

const uint8_t sprChatterTalk8R[] PROGMEM = {
0,0,0x75,0,
8,0,0x77,0,
0,8,0x88,0,
8,8,0x87,0,
0,16,0x92,0,
8,16,0x93,0,
128
};

const uint8_t sprChatterTalk9R[] PROGMEM = {
0,0,0x78,0,
8,0,0x79,0,
0,8,0x89,0,
8,8,0x87,0,
0,16,0x92,0,
8,16,0x93,0,
128
};

const uint8_t sprChatterWalk1L[] PROGMEM = {
0,0,0x6b,SPRITE_FLIP_X,
8,0,0x6a,SPRITE_FLIP_X,
0,8,0x7b,SPRITE_FLIP_X,
8,8,0x7a,SPRITE_FLIP_X,
0,16,0x8b,SPRITE_FLIP_X,
8,16,0x8a,SPRITE_FLIP_X,
128
};

const uint8_t sprChatterWalk2L[] PROGMEM = {
0,0,0x6d,SPRITE_FLIP_X,
8,0,0x6c,SPRITE_FLIP_X,
0,8,0x7d,SPRITE_FLIP_X,
8,8,0x7c,SPRITE_FLIP_X,
0,16,0x8d,SPRITE_FLIP_X,
8,16,0x8c,SPRITE_FLIP_X,
128
};

const uint8_t sprChatterWalk3L[] PROGMEM = {
0,0,0x6b,SPRITE_FLIP_X,
8,0,0x6a,SPRITE_FLIP_X,
0,8,0x7b,SPRITE_FLIP_X,
8,8,0x7a,SPRITE_FLIP_X,
0,16,0x8f,SPRITE_FLIP_X,
8,16,0x8e,SPRITE_FLIP_X,
128
};

const uint8_t sprChatterWalk4L[] PROGMEM = {
0,0,0x6d,SPRITE_FLIP_X,
8,0,0x6c,SPRITE_FLIP_X,
0,8,0x7f,SPRITE_FLIP_X,
8,8,0x7e,SPRITE_FLIP_X,
0,16,0x91,SPRITE_FLIP_X,
8,16,0x90,SPRITE_FLIP_X,
128
};

const uint8_t sprChatterTalk1L[] PROGMEM = {
0,0,0x6b,SPRITE_FLIP_X,
8,0,0x6a,SPRITE_FLIP_X,
0,8,0x81,SPRITE_FLIP_X,
8,8,0x80,SPRITE_FLIP_X,
0,16,0x93,SPRITE_FLIP_X,
8,16,0x92,SPRITE_FLIP_X,
128
};

const uint8_t sprChatterTalk2L[] PROGMEM = {
0,0,0x6e,SPRITE_FLIP_X,
8,0,0x6a,SPRITE_FLIP_X,
0,8,0x83,SPRITE_FLIP_X,
8,8,0x82,SPRITE_FLIP_X,
0,16,0x93,SPRITE_FLIP_X,
8,16,0x92,SPRITE_FLIP_X,
128
};

const uint8_t sprChatterTalk3L[] PROGMEM = {
0,0,0x70,SPRITE_FLIP_X,
8,0,0x6f,SPRITE_FLIP_X,
0,8,0x83,SPRITE_FLIP_X,
8,8,0x82,SPRITE_FLIP_X,
0,16,0x93,SPRITE_FLIP_X,
8,16,0x92,SPRITE_FLIP_X,
128
};

const uint8_t sprChatterTalk4L[] PROGMEM = {
0,0,0x71,SPRITE_FLIP_X,
8,0,0x6f,SPRITE_FLIP_X,
0,8,0x84,SPRITE_FLIP_X,
8,8,0x7a,SPRITE_FLIP_X,
0,16,0x93,SPRITE_FLIP_X,
8,16,0x92,SPRITE_FLIP_X,
128
};

const uint8_t sprChatterTalk5L[] PROGMEM = {
0,0,0x73,SPRITE_FLIP_X,
8,0,0x72,SPRITE_FLIP_X,
0,8,0x86,SPRITE_FLIP_X,
8,8,0x85,SPRITE_FLIP_X,
0,16,0x93,SPRITE_FLIP_X,
8,16,0x92,SPRITE_FLIP_X,
128
};

const uint8_t sprChatterTalk6L[] PROGMEM = {
0,0,0x74,SPRITE_FLIP_X,
8,0,0x72,SPRITE_FLIP_X,
0,8,0x87,SPRITE_FLIP_X,
8,8,0x85,SPRITE_FLIP_X,
0,16,0x93,SPRITE_FLIP_X,
8,16,0x92,SPRITE_FLIP_X,
128
};

const uint8_t sprChatterTalk7L[] PROGMEM = {
0,0,0x76,SPRITE_FLIP_X,
8,0,0x75,SPRITE_FLIP_X,
0,8,0x86,SPRITE_FLIP_X,
8,8,0x88,SPRITE_FLIP_X,
0,16,0x93,SPRITE_FLIP_X,
8,16,0x92,SPRITE_FLIP_X,
128
};

const uint8_t sprChatterTalk8L[] PROGMEM = {
0,0,0x77,SPRITE_FLIP_X,
8,0,0x75,SPRITE_FLIP_X,
0,8,0x87,SPRITE_FLIP_X,
8,8,0x88,SPRITE_FLIP_X,
0,16,0x93,SPRITE_FLIP_X,
8,16,0x92,SPRITE_FLIP_X,
128
};

const uint8_t sprChatterTalk9L[] PROGMEM = {
0,0,0x79,SPRITE_FLIP_X,
8,0,0x78,SPRITE_FLIP_X,
0,8,0x87,SPRITE_FLIP_X,
8,8,0x89,SPRITE_FLIP_X,
0,16,0x93,SPRITE_FLIP_X,
8,16,0x92,SPRITE_FLIP_X,
128
};



const uint8_t sprGeekWalk1R[] PROGMEM = {
0,0,0x99,0,
8,0,0x9a,0,
0,8,0xa1,0,
8,8,0xa2,0,
0,16,0xa7,0,
8,16,0xa8,0,
128
};

const uint8_t sprGeekWalk2R[] PROGMEM = {
0,0,0x9b,0,
8,0,0x9c,0,
0,8,0xa3,0,
8,8,0xa4,0,
0,16,0xa9,0,
8,16,0xaa,0,
128
};

const uint8_t sprGeekWalk3R[] PROGMEM = {
0,0,0x99,0,
8,0,0x9a,0,
0,8,0xa1,0,
8,8,0xa2,0,
0,16,0xab,0,
8,16,0xac,0,
128
};

const uint8_t sprGeekWalk4R[] PROGMEM = {
0,0,0x9b,0,
8,0,0x9c,0,
0,8,0xa3,0,
8,8,0xa4,0,
0,16,0xad,0,
8,16,0xae,0,
128
};

const uint8_t sprGeekWalk1L[] PROGMEM = {
0,0,0x9a,SPRITE_FLIP_X,
8,0,0x99,SPRITE_FLIP_X,
0,8,0xa2,SPRITE_FLIP_X,
8,8,0xa1,SPRITE_FLIP_X,
0,16,0xa8,SPRITE_FLIP_X,
8,16,0xa7,SPRITE_FLIP_X,
128
};

const uint8_t sprGeekWalk2L[] PROGMEM = {
0,0,0x9c,SPRITE_FLIP_X,
8,0,0x9b,SPRITE_FLIP_X,
0,8,0xa4,SPRITE_FLIP_X,
8,8,0xa3,SPRITE_FLIP_X,
0,16,0xaa,SPRITE_FLIP_X,
8,16,0xa9,SPRITE_FLIP_X,
128
};

const uint8_t sprGeekWalk3L[] PROGMEM = {
0,0,0x9a,SPRITE_FLIP_X,
8,0,0x99,SPRITE_FLIP_X,
0,8,0xa2,SPRITE_FLIP_X,
8,8,0xa1,SPRITE_FLIP_X,
0,16,0xac,SPRITE_FLIP_X,
8,16,0xab,SPRITE_FLIP_X,
128
};

const uint8_t sprGeekWalk4L[] PROGMEM = {
0,0,0x9c,SPRITE_FLIP_X,
8,0,0x9b,SPRITE_FLIP_X,
0,8,0xa4,SPRITE_FLIP_X,
8,8,0xa3,SPRITE_FLIP_X,
0,16,0xae,SPRITE_FLIP_X,
8,16,0xad,SPRITE_FLIP_X,
128
};

const uint8_t sprGeekStand1R[] PROGMEM = {
0,0,0x9d,0,
8,0,0x9e,0,
0,8,0xa5,0,
8,8,0xa6,0,
0,16,0xaf,0,
8,16,0xb0,0,
128
};

const uint8_t sprGeekStand2R[] PROGMEM = {
0,0,0x9f,0,
8,0,0xa0,0,
0,8,0xa5,0,
8,8,0xa6,0,
0,16,0xaf,0,
8,16,0xb0,0,
128
};

const uint8_t sprGeekStand1L[] PROGMEM = {
0,0,0x9e,SPRITE_FLIP_X,
8,0,0x9d,SPRITE_FLIP_X,
0,8,0xa6,SPRITE_FLIP_X,
8,8,0xa5,SPRITE_FLIP_X,
0,16,0xb0,SPRITE_FLIP_X,
8,16,0xaf,SPRITE_FLIP_X,
128
};

const uint8_t sprGeekStand2L[] PROGMEM = {
0,0,0xa0,SPRITE_FLIP_X,
8,0,0x9f,SPRITE_FLIP_X,
0,8,0xa6,SPRITE_FLIP_X,
8,8,0xa5,SPRITE_FLIP_X,
0,16,0xb0,SPRITE_FLIP_X,
8,16,0xaf,SPRITE_FLIP_X,
128
};



const uint8_t sprManBoxWalk1R[] PROGMEM = {
0,0,0xb1,0,
8,0,0xb2,0,
0,8,0xb6,0,
8,8,0xb7,0,
0,16,0xbd,0,
8,16,0xbe,0,
128
};

const uint8_t sprManBoxWalk2R[] PROGMEM = {
0,0,0xb3,0,
8,0,0xb4,0,
0,8,0xb8,0,
8,8,0xb9,0,
0,16,0xbf,0,
8,16,0xc0,0,
128
};

const uint8_t sprManBoxWalk3R[] PROGMEM = {
0,0,0xb1,0,
8,0,0xb2,0,
0,8,0xba,0,
8,8,0xbb,0,
0,16,0xc1,0,
8,16,0xc2,0,
128
};

const uint8_t sprManBoxWalk4R[] PROGMEM = {
0,0,0xb3,0,
8,0,0xb4,0,
0,8,0xb8,0,
8,8,0xbc,0,
0,16,0xc3,0,
8,16,0xc4,0,
128
};

const uint8_t sprManBoxWalk1L[] PROGMEM = {
0,0,0xb2,SPRITE_FLIP_X,
8,0,0xb1,SPRITE_FLIP_X,
0,8,0xb7,SPRITE_FLIP_X,
8,8,0xb6,SPRITE_FLIP_X,
0,16,0xbe,SPRITE_FLIP_X,
8,16,0xbd,SPRITE_FLIP_X,
128
};

const uint8_t sprManBoxWalk2L[] PROGMEM = {
0,0,0xb4,SPRITE_FLIP_X,
8,0,0xb3,SPRITE_FLIP_X,
0,8,0xb9,SPRITE_FLIP_X,
8,8,0xb8,SPRITE_FLIP_X,
0,16,0xc0,SPRITE_FLIP_X,
8,16,0xbf,SPRITE_FLIP_X,
128
};

const uint8_t sprManBoxWalk3L[] PROGMEM = {
0,0,0xb2,SPRITE_FLIP_X,
8,0,0xb1,SPRITE_FLIP_X,
0,8,0xbb,SPRITE_FLIP_X,
8,8,0xba,SPRITE_FLIP_X,
0,16,0xc2,SPRITE_FLIP_X,
8,16,0xc1,SPRITE_FLIP_X,
128
};

const uint8_t sprManBoxWalk4L[] PROGMEM = {
0,0,0xb4,SPRITE_FLIP_X,
8,0,0xb3,SPRITE_FLIP_X,
0,8,0xbc,SPRITE_FLIP_X,
8,8,0xb8,SPRITE_FLIP_X,
0,16,0xc4,SPRITE_FLIP_X,
8,16,0xc3,SPRITE_FLIP_X,
128
};



const uint8_t sprDibrovWalk1R[] PROGMEM = {
0,0,0xc7,0,
8,0,0xc8,0,
0,8,0xcb,0,
8,8,0xcc,0,
0,16,0xd0,0,
8,16,0xd1,0,
128
};

const uint8_t sprDibrovWalk2R[] PROGMEM = {
0,0,0xc9,0,
8,0,0xca,0,
0,8,0xcd,0,
8,8,0xce,0,
0,16,0xd2,0,
8,16,0xd3,0,
128
};

const uint8_t sprDibrovWalk3R[] PROGMEM = {
0,0,0xc7,0,
8,0,0xc8,0,
0,8,0xcb,0,
8,8,0xcc,0,
0,16,0xd4,0,
8,16,0xd5,0,
128
};

const uint8_t sprDibrovWalk4R[] PROGMEM = {
0,0,0xc9,0,
8,0,0xca,0,
0,8,0xcf,0,
8,8,0xce,0,
0,16,0xd6,0,
8,16,0xd7,0,
128
};

const uint8_t sprDibrovWalk1L[] PROGMEM = {
0,0,0xc8,SPRITE_FLIP_X,
8,0,0xc7,SPRITE_FLIP_X,
0,8,0xcc,SPRITE_FLIP_X,
8,8,0xcb,SPRITE_FLIP_X,
0,16,0xd1,SPRITE_FLIP_X,
8,16,0xd0,SPRITE_FLIP_X,
128
};

const uint8_t sprDibrovWalk2L[] PROGMEM = {
0,0,0xca,SPRITE_FLIP_X,
8,0,0xc9,SPRITE_FLIP_X,
0,8,0xce,SPRITE_FLIP_X,
8,8,0xcd,SPRITE_FLIP_X,
0,16,0xd3,SPRITE_FLIP_X,
8,16,0xd2,SPRITE_FLIP_X,
128
};

const uint8_t sprDibrovWalk3L[] PROGMEM = {
0,0,0xc8,SPRITE_FLIP_X,
8,0,0xc7,SPRITE_FLIP_X,
0,8,0xcc,SPRITE_FLIP_X,
8,8,0xcb,SPRITE_FLIP_X,
0,16,0xd5,SPRITE_FLIP_X,
8,16,0xd4,SPRITE_FLIP_X,
128
};

const uint8_t sprDibrovWalk4L[] PROGMEM = {
0,0,0xca,SPRITE_FLIP_X,
8,0,0xc9,SPRITE_FLIP_X,
0,8,0xce,SPRITE_FLIP_X,
8,8,0xcf,SPRITE_FLIP_X,
0,16,0xd7,SPRITE_FLIP_X,
8,16,0xd6,SPRITE_FLIP_X,
128
};
