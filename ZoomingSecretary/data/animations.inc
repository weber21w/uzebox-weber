const uint8_t * const animWalkLeft[8] PROGMEM = {
sprSecretaryWalk1L,
sprSecretaryWalk2L,
sprSecretaryWalk3L,
sprSecretaryWalk4L,
sprSecretaryAnswer1L,
sprSecretaryAnswer2L,
sprSecretaryAnswer3L,
sprSecretaryAnswer4L
};

const uint8_t * const animWalkRight[8] PROGMEM = {
sprSecretaryWalk1R,
sprSecretaryWalk2R,
sprSecretaryWalk3R,
sprSecretaryWalk4R,
sprSecretaryAnswer1R,
sprSecretaryAnswer2R,
sprSecretaryAnswer3R,
sprSecretaryAnswer4R
};

const uint8_t * const animWalkUp[2] PROGMEM = {
sprSecretaryWalk1U,
sprSecretaryWalk2U
};

const uint8_t * const animWalkDown[2] PROGMEM = {
sprSecretaryWalk1D,
sprSecretaryWalk2D
};

const uint8_t * const animKnockedLeft[2] PROGMEM = {
sprSecretaryKnocked1L,
sprSecretaryKnocked2L
};

const uint8_t * const animKnockedRight[2] PROGMEM = {
sprSecretaryKnocked1R,
sprSecretaryKnocked2R
};

const uint8_t * const animSecretaryRest[4] PROGMEM = {
sprSecretaryRest1,
sprSecretaryRest2,
sprSecretaryRest3,
sprSecretaryRest4
};



const uint8_t * const animChiefWalkLeft[4] PROGMEM = {
sprChiefWalk4L,
sprChiefWalk3L,
sprChiefWalk2L,
sprChiefWalk1L
};

const uint8_t * const animChiefWalkRight[4] PROGMEM = {
sprChiefWalk4R,
sprChiefWalk3R,
sprChiefWalk2R,
sprChiefWalk1R
};

const uint8_t * const animChiefTalkLeft[4] PROGMEM = {
sprChiefTalk1L,
sprChiefTalk2L,
sprChiefTalk3L,
sprChiefTalk2L
};

const uint8_t * const animChiefTalkRight[4] PROGMEM = {
sprChiefTalk1R,
sprChiefTalk2R,
sprChiefTalk3R,
sprChiefTalk2R
};



const uint8_t * const animBouncerWalkLeft[4] PROGMEM = {
sprBouncerWalk4L,
sprBouncerWalk3L,
sprBouncerWalk2L,
sprBouncerWalk1L
};

const uint8_t * const animBouncerWalkRight[4] PROGMEM = {
sprBouncerWalk1R,
sprBouncerWalk2R,
sprBouncerWalk3R,
sprBouncerWalk4R
};



const uint8_t * const animChatterWalkLeft[4] PROGMEM = {
sprChatterWalk4L,
sprChatterWalk3L,
sprChatterWalk2L,
sprChatterWalk1L
};

const uint8_t * const animChatterWalkRight[4] PROGMEM = {
sprChatterWalk1R,
sprChatterWalk2R,
sprChatterWalk3R,
sprChatterWalk4R
};

const uint8_t * const animChatterTalkLeft[4] PROGMEM = {
sprChatterTalk1L,
sprChatterTalk2L,
sprChatterTalk3L,
sprChatterTalk4L
};

const uint8_t * const animChatterTalkRight[4] PROGMEM = {
sprChatterTalk1R,
sprChatterTalk2R,
sprChatterTalk3R,
sprChatterTalk4R
};

const uint8_t * const animChatterGlassesLeft[5] PROGMEM = {
sprChatterTalk5L,
sprChatterTalk6L,
sprChatterTalk7L,
sprChatterTalk8L,
sprChatterTalk9L
};

const uint8_t * const animChatterGlassesRight[5] PROGMEM = {
sprChatterTalk5R,
sprChatterTalk6R,
sprChatterTalk7R,
sprChatterTalk8R,
sprChatterTalk9R
};



const uint8_t * const animGeekWalkLeft[4] PROGMEM = {
sprGeekWalk4L,
sprGeekWalk3L,
sprGeekWalk2L,
sprGeekWalk1L
};

const uint8_t * const animGeekWalkRight[4] PROGMEM = {
sprGeekWalk1R,
sprGeekWalk2R,
sprGeekWalk3R,
sprGeekWalk4R
};

const uint8_t * const animGeekStandLeft[2] PROGMEM = {
sprGeekStand1L,
sprGeekStand2L
};

const uint8_t * const animGeekStandRight[2] PROGMEM = {
sprGeekStand1R,
sprGeekStand2R
};



const uint8_t * const animManBoxWalkLeft[4] PROGMEM = {
sprManBoxWalk4L,
sprManBoxWalk3L,
sprManBoxWalk2L,
sprManBoxWalk1L
};

const uint8_t * const animManBoxWalkRight[4] PROGMEM = {
sprManBoxWalk1R,
sprManBoxWalk2R,
sprManBoxWalk3R,
sprManBoxWalk4R
};



const uint8_t * const animDibrovWalkLeft[4] PROGMEM = {
sprDibrovWalk4L,
sprDibrovWalk3L,
sprDibrovWalk2L,
sprDibrovWalk1L
};

const uint8_t * const animDibrovWalkRight[4] PROGMEM = {
sprDibrovWalk1R,
sprDibrovWalk2R,
sprDibrovWalk3R,
sprDibrovWalk4R
};




const uint8_t animPhone[] PROGMEM = {
64,64,64,64,//idle
64,65,66,65,//level 1
67,68,69,68,//level 2
70,71,72,71, //level 3
};
