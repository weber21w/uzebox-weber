const char Level1Song[] PROGMEM ={//ae1.mid -s0 -e2881 -f60
0x00,0xc0,0x0f,0x00,0xc1,0x10,0x00,0xc2,0x11,0x00,0xc3,0x00,0x00,0xb0,0x07,0x7f,0x00,0xb2,0x07,0x7f,0x00,0xb3,0x07,0x7f,0x00,0x93,0x13,0x64,0x00,0xb1,0x07,0x7f,
0x00,0x92,0x26,0x5a,0x00,0x93,0x14,0x64,0x00,0xb1,0x0b,0x7f,0x00,0x91,0x26,0x7f,0x00,0xff,0x06,0x01,0x53,0x12,0x92,0x26,0x5a,0x00,0x93,0x13,0x64,0x12,0x92,0x2d,
0x5a,0x00,0x93,0x13,0x64,0x00,0x91,0x2d,0x7f,0x11,0x90,0x35,0x7f,0x00,0xb0,0x0b,0x7f,0x00,0x92,0x2c,0x5a,0x00,0x93,0x14,0x64,0x00,0x91,0x35,0x7f,0x02,0x92,0x2d,
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0x02,0x29,0x5a,0x02,0x28,0x5a,0x02,0x27,0x5a,0x02,0x26,0x5a,0x00,0xff,0x06,0x01,0x45,0x01,0x92,0x25,0x5a,0x02,0x24,0x5a,0x02,0x23,0x5a,0x02,0xff,0x2f,0x00 };




