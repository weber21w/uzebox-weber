const char Level2Song[] PROGMEM ={//OIL.MID -s0 -20160 -f17
0x00,0xc0,0x16,0x00,0xc1,0x17,0x00,0xc2,0x18,0x00,0xc3,0x00,0x00,0xb0,0x07,0x7f,0x00,0x0b,0x7f,0x00,0xb1,0x07,0x7f,0x00,0x0b,0x7f,0x00,0xb2,0x07,0x7f,0x00,0x0b,
0x7f,0x00,0x92,0x29,0x7f,0x00,0xb3,0x07,0x7f,0x00,0x0b,0x7f,0x00,0x93,0x1c,0x7f,0x00,0xff,0x06,0x01,0x53,0x07,0x92,0x2b,0x7f,0x00,0x93,0x1b,0x7f,0x07,0x92,0x1f,
0x7f,0x00,0x93,0x19,0x7f,0x08,0x92,0x1f,0x7f,0x00,0x93,0x19,0x7f,0x07,0x91,0x3a,0x7f,0x00,0x3e,0x7f,0x00,0x92,0x1a,0x7f,0x00,0x93,0x19,0x7f,0x0f,0x91,0x3a,0x7f,
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0x7f,0x00,0x3e,0x7f,0x00,0x92,0x1a,0x7f,0x07,0xff,0x2f,0x00 };

