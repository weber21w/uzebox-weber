#define FACESTART 0

const char GameSprites[] PROGMEM = {
/* tile 0 */

  0xA4,0xA4,0xA4,0xA4,0xA4,0xA4,0xA4,0xA4,
  0xA4,0xFF,0xFF,0xFF,0xFF,0xFF,0xFF,0xFF,
  0xA4,0xFF,0xFF,0xFF,0xFF,0xFF,0xFF,0xFF,
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  0xA4,0xFF,0xFF,0xF6,0xF6,0xF6,0x00,0x3F,
/* tile 1 */

  0xA4,0xA4,0xA4,0xA4,0xA4,0xA4,0xA4,0xA4,
  0xFF,0xFF,0xFF,0xFF,0xFF,0xFF,0xFF,0xFF,
  0xFF,0xFF,0xFF,0xFF,0xFF,0xFF,0xFF,0xFF,
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  0x3F,0x3F,0x3F,0x3F,0x3F,0x3F,0x3F,0x3F,
/* tile 2 */

  0xA4,0xA4,0xA4,0xA4,0xA4,0xA4,0xA4,0xF6,
  0xFF,0xFF,0xFF,0xFF,0xFF,0xFF,0xF6,0xA4,
  0xFF,0xFF,0xFF,0xFF,0xFF,0xF6,0xA4,0xA4,
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  0x3F,0x3F,0x00,0xF6,0xF6,0xA4,0xA4,0xA4,
/* tile 3 */

  0xA4,0xFF,0xFF,0xF6,0xF6,0x00,0x3F,0x3F,
  0xA4,0xFF,0xFF,0xF6,0xF6,0x00,0x3F,0x3F,
  0xA4,0xFF,0xFF,0xF6,0x00,0x3F,0x3F,0x3F,
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  0xA4,0xFF,0xFF,0xF6,0xF6,0x00,0x3F,0x3F,
/* tile 4 */

  0x3F,0x3F,0x3F,0x3F,0x3F,0x3F,0x3F,0x3F,
  0x3F,0x00,0x00,0x3F,0x3F,0x3F,0x00,0x00,
  0x3F,0x00,0x00,0x3F,0x3F,0x3F,0x00,0x00,
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  0x3F,0x00,0x3F,0x3F,0x3F,0x3F,0x3F,0x00,
/* tile 5 */

  0x3F,0x3F,0x3F,0x00,0xF6,0xA4,0xA4,0xA4,
  0x3F,0x3F,0x3F,0x00,0xF6,0xA4,0xA4,0xA4,
  0x3F,0x3F,0x3F,0x3F,0x00,0xA4,0xA4,0xA4,
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  0x3F,0x3F,0x3F,0x00,0xF6,0xA4,0xA4,0xA4,
/* tile 6 */

  0xA4,0xFF,0xFF,0xF6,0xF6,0x00,0x3F,0x3F,
  0xA4,0xFF,0xFF,0xF6,0xF6,0xF6,0x00,0x3F,
  0xA4,0xFF,0xFF,0xF6,0xF6,0xF6,0xF6,0x00,
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  0xF6,0xA4,0xA4,0xA4,0xA4,0xA4,0xA4,0xA4,
/* tile 7 */

  0x3F,0x3F,0x00,0x00,0x00,0x00,0x00,0x3F,
  0x3F,0x3F,0x3F,0x3F,0x3F,0x3F,0x3F,0x3F,
  0x3F,0x3F,0x3F,0x3F,0x3F,0x3F,0x3F,0x3F,
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  0xA4,0xA4,0xA4,0xA4,0xA4,0xA4,0xA4,0xA4,
/* tile 8 */

  0x3F,0x3F,0x3F,0x00,0xF6,0xA4,0xA4,0xA4,
  0x3F,0x3F,0x00,0xF6,0xF6,0xA4,0xA4,0xA4,
  0x3F,0x00,0xF6,0xF6,0xF6,0xA4,0xA4,0xA4,
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  0xA4,0xA4,0xA4,0xA4,0xA4,0xA4,0xA4,0xA4,
/* tile 9 */

  0x24,0x00,0x24,0x3F,0x3F,0x3F,0x24,0x00,
  0x00,0x00,0x00,0x3F,0x3F,0x3F,0x00,0x00,
  0x24,0x00,0x24,0x3F,0x3F,0x3F,0x24,0x00,
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  0x3F,0x3F,0x00,0x3F,0x3F,0x3F,0x00,0x3F,
/* tile 10 */

  0x24,0x3F,0x3F,0x00,0xF6,0xA4,0xA4,0xA4,
  0x00,0x3F,0x3F,0x00,0xF6,0xA4,0xA4,0xA4,
  0x24,0x3F,0x3F,0x3F,0x00,0xA4,0xA4,0xA4,
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  0x3F,0x3F,0x3F,0x00,0xF6,0xA4,0xA4,0xA4,
/* tile 11 */

  0x3F,0x3F,0x24,0x00,0x3F,0x00,0x24,0x3F,
  0x3F,0x3F,0x3F,0x00,0x00,0x00,0x3F,0x3F,
  0x3F,0x3F,0x3F,0x3F,0x3F,0x3F,0x3F,0x3F,
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  0xA4,0xA4,0xA4,0xA4,0xA4,0xA4,0xA4,0xA4,
/* tile 12 */

  0x00,0x3F,0x00,0x3F,0x3F,0x3F,0x00,0x3F,
  0x3F,0x00,0x3F,0x3F,0x3F,0x3F,0x3F,0x00,
  0x00,0x3F,0x00,0x3F,0x3F,0x3F,0x00,0x3F,
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  0x3F,0x00,0x3F,0x3F,0x3F,0x3F,0x3F,0x00,
/* tile 13 */

  0x00,0x3F,0x3F,0x00,0xF6,0xA4,0xA4,0xA4,
  0x3F,0x3F,0x3F,0x00,0xF6,0xA4,0xA4,0xA4,
  0x00,0x3F,0x3F,0x3F,0x00,0xA4,0xA4,0xA4,
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  0x3F,0x3F,0x3F,0x00,0xF6,0xA4,0xA4,0xA4,
/* tile 14 */

  0x00,0x3F,0x3F,0x3F,0x3F,0x3F,0x3F,0x3F,
  0x3F,0x3F,0x3F,0x3F,0x3F,0x3F,0x3F,0x3F,
  0x3F,0x3F,0x3F,0x3F,0x3F,0x3F,0x3F,0x3F,
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  0xA4,0xA4,0xA4,0xA4,0xA4,0xA4,0xA4,0xA4,
/* tile 15 */

  0x00,0x3F,0x3F,0x00,0xF6,0xA4,0xA4,0xA4,
  0x3F,0x3F,0x00,0xF6,0xF6,0xA4,0xA4,0xA4,
  0x3F,0x00,0xF6,0xF6,0xF6,0xA4,0xA4,0xA4,
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  0xA4,0xA4,0xA4,0xA4,0xA4,0xA4,0xA4,0xA4,
/* tile 16 */

  0xA4,0xA4,0xA4,0xA4,0xA4,0xA4,0xA4,0xA4,
  0xA4,0xA4,0xA4,0xA4,0xA4,0xA4,0xA4,0xA4,
  0xA4,0xA4,0xF6,0xF6,0xF6,0xF6,0xF6,0xF6,
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  0xA4,0xA4,0xF6,0xF6,0xF6,0xF6,0xF6,0xF6,
/* tile 17 */

  0xA4,0xA4,0xA4,0xA4,0xA4,0xA4,0xA4,0xA4,
  0xA4,0xA4,0xA4,0xA4,0xA4,0xA4,0xA4,0xA4,
  0xF6,0xF6,0xF6,0xF6,0xF6,0xF6,0xF6,0xF6,
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  0x00,0x3F,0x3F,0x3F,0x3F,0x3F,0x3F,0x3F,
/* tile 18 */

  0xA4,0xA4,0xA4,0xA4,0xA4,0xA4,0xA4,0xF6,
  0xA4,0xA4,0xA4,0xA4,0xA4,0xA4,0xA4,0xA4,
  0xF6,0xF6,0xF6,0xF6,0xF6,0xF6,0xF6,0xA4,
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  0x3F,0x3F,0x00,0xF6,0xF6,0xF6,0xF6,0xA4,
/* tile 19 */

  0xA4,0xA4,0xF6,0xF6,0xF6,0xF6,0xF6,0x00,
  0xA4,0xA4,0xF6,0xF6,0xF6,0xF6,0x00,0x3F,
  0xA4,0xA4,0xF6,0xF6,0xF6,0xF6,0x00,0x3F,
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  0xA4,0xA4,0xF6,0xF6,0xF6,0x00,0x3F,0x3F,
/* tile 20 */

  0x3F,0x3F,0x3F,0x3F,0x3F,0x3F,0x3F,0x3F,
  0x3F,0x3F,0x3F,0x3F,0x3F,0x3F,0x3F,0x3F,
  0x3F,0x3F,0x00,0x00,0x3F,0x3F,0x3F,0x00,
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  0x3F,0x00,0x3F,0x3F,0x3F,0x3F,0x3F,0x3F,
/* tile 21 */

  0x3F,0x3F,0x3F,0x00,0xF6,0xF6,0xF6,0xA4,
  0x3F,0x3F,0x3F,0x3F,0x00,0xF6,0xF6,0xA4,
  0x00,0x3F,0x3F,0x3F,0x00,0xF6,0xF6,0xA4,
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  0x3F,0x00,0x3F,0x3F,0x3F,0x00,0xF6,0xA4,
/* tile 22 */

  0xA4,0xA4,0xF6,0xF6,0xF6,0xF6,0x00,0x3F,
  0xA4,0xA4,0xF6,0xF6,0xF6,0xF6,0x00,0x3F,
  0xA4,0xA4,0xF6,0xF6,0xF6,0xF6,0xF6,0x00,
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  0xF6,0xA4,0xA4,0xA4,0xA4,0xA4,0xA4,0xA4,
/* tile 23 */

  0x3F,0x3F,0x00,0x3F,0x3F,0x3F,0x3F,0x3F,
  0x3F,0x3F,0x3F,0x00,0x00,0x00,0x00,0x00,
  0x3F,0x3F,0x3F,0x3F,0x3F,0x3F,0x3F,0x3F,
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  0xA4,0xA4,0xA4,0xA4,0xA4,0xA4,0xA4,0xA4,
/* tile 24 */

  0x00,0x3F,0x3F,0x3F,0x00,0xF6,0xF6,0xA4,
  0x3F,0x3F,0x3F,0x3F,0x00,0xF6,0xF6,0xA4,
  0x3F,0x3F,0x3F,0x00,0xF6,0xF6,0xF6,0xA4,
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  0xA4,0xA4,0xA4,0xA4,0xA4,0xA4,0xA4,0xA4,
/* tile 25 */

  0xA4,0xFF,0xFF,0xF6,0xF6,0x00,0x3F,0x3F,
  0xA4,0xFF,0xFF,0xF6,0xF6,0x00,0x3F,0x3F,
  0xA4,0xFF,0xFF,0xF6,0x00,0x3F,0x3F,0x00,
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  0xA4,0xFF,0xFF,0xF6,0xF6,0x00,0x3F,0x3F,
/* tile 26 */

  0x3F,0x3F,0x3F,0x3F,0x3F,0x3F,0x3F,0x3F,
  0x00,0x00,0x00,0x00,0x00,0x00,0x00,0x00,
  0x00,0x00,0x00,0x00,0x3F,0x00,0x00,0x00,
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  0x3F,0x00,0x3F,0x3F,0x3F,0x3F,0x3F,0x00,
/* tile 27 */

  0x3F,0x3F,0x3F,0x00,0xF6,0xA4,0xA4,0xA4,
  0x00,0x3F,0x3F,0x00,0xF6,0xA4,0xA4,0xA4,
  0x00,0x00,0x3F,0x3F,0x00,0xA4,0xA4,0xA4,
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  0x3F,0x3F,0x3F,0x00,0xF6,0xA4,0xA4,0xA4,

//pointer
  0xFE,0x00,0x00,0xFE,0xFE,0xFE,0xFE,0xFE,
  0xFE,0x00,0xFF,0x00,0xFE,0xFE,0xFE,0xFE,
  0xFE,0x00,0xFF,0xFF,0x00,0xFE,0xFE,0xFE,
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  0xFE,0xFE,0xFE,0xFE,0x00,0x00,0x00,0xFE,

};

const char FaceMaps[] PROGMEM=
{
    1,  2,  3,
    4,  5,  6,
    7,  8,  9,
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    7,  8,  9
};

const char GameTiles[] PROGMEM = {

/* tile 0 */

  0xFF,0xFF,0xFF,0xFF,0xFF,0xFF,0xFF,0xFF,
  0xFF,0xFF,0xFF,0xFF,0xFF,0xFF,0xFF,0xFF,
  0xFF,0xFF,0xFF,0xFF,0xFF,0xFF,0xFF,0xFF,
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  0xF6,0xF6,0xF6,0xF6,0xF6,0xF6,0xF6,0xF6,


/* tile 0 */

  0xFF,0xFF,0xFF,0xFF,0xFF,0xFF,0xFF,0xFF,
  0xFF,0xFF,0xFF,0xFF,0xFF,0xFF,0xFF,0xFF,
  0xFF,0xFF,0xFF,0xFF,0xFF,0xFF,0xFF,0xFF,
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  0xF6,0xF6,0xF6,0xF6,0xF6,0xF6,0xF6,0xF6,
/* tile 1 */

  0xF6,0xF6,0xF6,0xF6,0xF6,0xF6,0xF6,0xF6,
  0xF6,0xF6,0xF6,0xF6,0xF6,0xA4,0xA4,0xA4,
  0xF6,0xF6,0xF6,0xF6,0xF6,0xA4,0xA4,0xA4,
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  0xF6,0xF6,0xF6,0xF6,0xF6,0xA4,0xA4,0xF6,
/* tile 2 */

  0xF6,0xF6,0xF6,0xF6,0xF6,0xF6,0xF6,0xF6,
  0xA4,0xA4,0xA4,0xA4,0xA4,0xA4,0xA4,0xA4,
  0xA4,0xA4,0xA4,0xA4,0xA4,0xA4,0xA4,0xA4,
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  0xF6,0xF6,0xF6,0xF6,0xF6,0xF6,0xF6,0xA4,
/* tile 3 */

  0xF6,0xF6,0xF6,0xF6,0xF6,0xF6,0xF6,0xF6,
  0xA4,0xA4,0xA4,0xA4,0xA4,0xA4,0xA4,0xA4,
  0xA4,0xA4,0xA4,0xA4,0xA4,0xA4,0xA4,0xA4,
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  0xA4,0xA4,0xA4,0xA4,0xA4,0xA4,0xA4,0xA4,
/* tile 4 */

  0xF6,0xF6,0xF6,0xF6,0xF6,0xF6,0xF6,0xF6,
  0xA4,0xA4,0xA4,0xA4,0xA4,0xA4,0xA4,0xA4,
  0xA4,0xA4,0xA4,0xA4,0xA4,0xA4,0xA4,0xA4,
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  0xF6,0xF6,0xF6,0xF6,0xF6,0xF6,0xF6,0xF6,
/* tile 5 */

  0xF6,0xF6,0xF6,0xF6,0xF6,0xF6,0xF6,0xF6,
  0xA4,0xA4,0xA4,0xA4,0xA4,0xA4,0xA4,0xA4,
  0xA4,0xA4,0xA4,0xA4,0xA4,0xA4,0xA4,0xA4,
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  0xF6,0xF6,0xF6,0xF6,0xF6,0xF6,0xA4,0xA4,
/* tile 6 */

  0xF6,0xF6,0xF6,0xF6,0xF6,0xF6,0xF6,0xF6,
  0xA4,0xA4,0xA4,0xA4,0xA4,0xA4,0xA4,0xA4,
  0xA4,0xA4,0xA4,0xA4,0xA4,0xA4,0xA4,0xA4,
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  0xA4,0xA4,0xA4,0xA4,0xA4,0xA4,0xA4,0xF6,
/* tile 7 */

  0xF6,0xF6,0xF6,0xF6,0xF6,0xF6,0xF6,0xF6,
  0xA4,0xA4,0xF6,0xF6,0xF6,0xF6,0xF6,0xF6,
  0xA4,0xF6,0xFF,0xF6,0xF6,0xF6,0xF6,0xF6,
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  0xF6,0xFF,0xFF,0xF6,0xF6,0xF6,0xF6,0xF6,
/* tile 8 */

  0xF6,0xF6,0xF6,0xF6,0xF6,0xA4,0xA4,0xF6,
  0xF6,0xF6,0xF6,0xF6,0xF6,0xA4,0xA4,0xF6,
  0xF6,0xF6,0xF6,0xF6,0xF6,0xA4,0xA4,0xF6,
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  0xF6,0xF6,0xF6,0xF6,0xF6,0xA4,0xA4,0xF6,
/* tile 9 */

  0xF6,0xF6,0xF6,0xF6,0xF6,0xF6,0xF6,0xA4,
  0xF6,0xF6,0xF6,0xF6,0xF6,0xF6,0xF6,0xA4,
  0xF6,0xF6,0xF6,0xF6,0xF6,0xF6,0xF6,0xA4,
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  0xF6,0xF6,0xF6,0xF6,0xF6,0xF6,0xF6,0xA4,
/* tile 10 */

  0x00,0x00,0x00,0x00,0x00,0x00,0x00,0x00,
  0x00,0x00,0x00,0x00,0x00,0x00,0x00,0x00,
  0x00,0x00,0x00,0x00,0x00,0x00,0x00,0x00,
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  0x00,0x00,0x00,0x00,0x00,0x00,0x00,0x00,
/* tile 11 */

  0xFF,0xF6,0xF6,0xF6,0xF6,0xF6,0xF6,0xF6,
  0xFF,0xF6,0xF6,0xF6,0xF6,0xF6,0xF6,0xF6,
  0xFF,0xF6,0xF6,0xF6,0xF6,0xF6,0xF6,0xF6,
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  0xFF,0xF6,0xF6,0xF6,0xF6,0xF6,0xF6,0xF6,
/* tile 12 */

  0xF6,0xF6,0xF6,0xF6,0xF6,0xF6,0xF6,0xF6,
  0xF6,0xF6,0xF6,0xF6,0xF6,0xF6,0xF6,0xF6,
  0xF6,0xF6,0xF6,0xF6,0xF6,0xF6,0xF6,0xF6,
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  0xF6,0xF6,0xF6,0xF6,0xF6,0xF6,0xF6,0xF6,
/* tile 13 */

  0xF6,0xF6,0xF6,0xF6,0xF6,0xF6,0xA4,0x00,
  0xF6,0xF6,0xF6,0xF6,0xF6,0xF6,0xA4,0x00,
  0xF6,0xF6,0xF6,0xF6,0xF6,0xF6,0xA4,0x00,
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  0xF6,0xF6,0xF6,0xF6,0xF6,0xF6,0xA4,0x00,
/* tile 14 */

  0x00,0x00,0x00,0x00,0x00,0x00,0x00,0xFF,
  0x00,0x00,0x00,0x00,0x00,0x00,0x00,0xFF,
  0x00,0x00,0x00,0x00,0x00,0x00,0x00,0xFF,
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  0x00,0x00,0x00,0x00,0x00,0x00,0x00,0xFF,
/* tile 15 */

  0xF6,0xFF,0xFF,0xF6,0xF6,0xF6,0xF6,0xF6,
  0xF6,0xFF,0xFF,0xF6,0xF6,0xF6,0xF6,0xF6,
  0xF6,0xFF,0xFF,0xF6,0xF6,0xF6,0xF6,0xF6,
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  0xF6,0xFF,0xFF,0xF6,0xF6,0xF6,0xF6,0xF6,
/* tile 16 */

  0xF6,0xF6,0xF6,0xF6,0xF6,0xA4,0xA4,0xF6,
  0xF6,0xF6,0xF6,0xF6,0xF6,0xA4,0xA4,0xF6,
  0xF6,0xF6,0xF6,0xF6,0xF6,0xA4,0xA4,0xF6,
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  0xF6,0xF6,0xF6,0xF6,0xF6,0xF6,0xF6,0xF6,
/* tile 17 */

  0xF6,0xF6,0xF6,0xF6,0xF6,0xF6,0xF6,0xF6,
  0xF6,0xF6,0xF6,0xF6,0xF6,0xF6,0xF6,0xF6,
  0xF6,0xF6,0xF6,0xF6,0xF6,0xF6,0xF6,0xF6,
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  0xF6,0xF6,0xF6,0xF6,0xF6,0xF6,0xF6,0xF6,
/* tile 18 */

  0xFF,0xFF,0xFF,0xFF,0xFF,0xFF,0xFF,0xFF,
  0xF6,0xF6,0xF6,0xF6,0xF6,0xF6,0xF6,0xF6,
  0xF6,0xF6,0xF6,0xF6,0xF6,0xF6,0xF6,0xF6,
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  0xF6,0xF6,0xF6,0xF6,0xF6,0xF6,0xF6,0xF6,
/* tile 19 */

  0xFF,0xF6,0xF6,0xF6,0xF6,0xF6,0xF6,0xF6,
  0xF6,0xF6,0xF6,0xF6,0xF6,0xF6,0xF6,0xF6,
  0xF6,0xF6,0xF6,0xF6,0xF6,0xF6,0xF6,0xF6,
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  0xF6,0xF6,0xF6,0xF6,0xF6,0xF6,0xF6,0xF6,
/* tile 20 */

  0xF6,0xF6,0xF6,0xF6,0xF6,0xF6,0xF6,0xFF,
  0xF6,0xF6,0xF6,0xF6,0xF6,0xF6,0xF6,0xF6,
  0xF6,0xF6,0xF6,0xF6,0xF6,0xF6,0xF6,0xF6,
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  0xF6,0xF6,0xF6,0xF6,0xF6,0xF6,0xF6,0xF6,
/* tile 21 */

  0xF6,0xFF,0xFF,0xF6,0xF6,0xF6,0xF6,0xF6,
  0xF6,0xFF,0xFF,0xF6,0xF6,0xF6,0xF6,0xF6,
  0xF6,0xFF,0xFF,0xF6,0xF6,0xF6,0xF6,0xF6,
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  0xF6,0xF6,0xF6,0xF6,0xF6,0xF6,0xF6,0xF6,
/* tile 22 */

  0xF6,0xF6,0xF6,0xF6,0xF6,0xF6,0xF6,0xF6,
  0xF6,0xF6,0xF6,0xF6,0xF6,0xF6,0xF6,0xF6,
  0xF6,0xF6,0xF6,0xF6,0xF6,0xF6,0xF6,0xF6,
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  0xF6,0xF6,0xF6,0xF6,0xF6,0xA4,0xA4,0xA4,
/* tile 23 */

  0xF6,0xF6,0xF6,0xF6,0xF6,0xF6,0xF6,0xF6,
  0xF6,0xF6,0xF6,0xF6,0xF6,0xF6,0xF6,0xF6,
  0xF6,0xF6,0xF6,0xF6,0xF6,0xF6,0xF6,0xF6,
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  0xA4,0xA4,0xA4,0xA4,0xA4,0xA4,0xA4,0xA4,
/* tile 24 */

  0xF6,0xF6,0xF6,0xF6,0xF6,0xF6,0xF6,0xF6,
  0xF6,0xF6,0xF6,0xF6,0xF6,0xF6,0xF6,0xF6,
  0xF6,0xF6,0xF6,0xF6,0xF6,0xF6,0xF6,0xF6,
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  0xF6,0xFF,0xFF,0xF6,0xF6,0xF6,0xF6,0xF6,
/* tile 25 */

  0xF6,0xF6,0xF6,0xF6,0xF6,0xA4,0xA4,0xA4,
  0xF6,0xF6,0xF6,0xF6,0xF6,0xA4,0xA4,0xA4,
  0xF6,0xF6,0xF6,0xF6,0xF6,0xA4,0xA4,0xA4,
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  0xF6,0xF6,0xF6,0xF6,0xF6,0xA4,0xA4,0xA4,
/* tile 26 */

  0xFF,0xFF,0xFF,0xF6,0xF6,0xF6,0xF6,0xF6,
  0xFF,0xFF,0xFF,0xF6,0xF6,0xF6,0xF6,0xF6,
  0xFF,0xFF,0xFF,0xF6,0xF6,0xF6,0xF6,0xF6,
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  0xFF,0xFF,0xFF,0xF6,0xF6,0xF6,0xF6,0xF6,
/* tile 27 */

  0xF6,0xF6,0xF6,0xF6,0xF6,0xA4,0xA4,0xF6,
  0xF6,0xF6,0xF6,0xF6,0xF6,0xA4,0xF6,0xFF,
  0xF6,0xF6,0xF6,0xF6,0xF6,0xF6,0xFF,0xFF,
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  0xF6,0xF6,0xF6,0xF6,0xF6,0xF6,0xF6,0xF6,
/* tile 28 */

  0xFF,0xFF,0xFF,0xF6,0xF6,0xF6,0xF6,0xF6,
  0xFF,0xFF,0xFF,0xF6,0xF6,0xF6,0xF6,0xF6,
  0xFF,0xFF,0xFF,0xF6,0xF6,0xF6,0xF6,0xF6,
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  0xF6,0xF6,0xF6,0xF6,0xF6,0xF6,0xF6,0xF6,


#define MENUSTART 23
#define GRIDSTART 30
#define NUMBERSTART GRIDSTART+75
#define FONTSTART NUMBERSTART+7
#define ZEROSTART 135

#include "grid.inc"
#include "number.inc"
#include "font.inc"

};

const char NumberMaps[] PROGMEM = {
    1,  2,
    3,  4,
    5,  6,
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   10, 26,

};

const char BGMap[] PROGMEM=
{30,28,
    1,  1,  1,  1,  1,  1,  1,  1,  1,  1,  1,  1,  1,  1,  1,  1,  1,  1,  1,  1,  1,  1,  1,  1,  1,  1,  1,  1,  1,  1,
    2,  3,  4,  4,  4,  4,  4,  4,  5,  5,  5,  5,  5,  5,  5,  5,  5,  5,  5,  5,  5,  6,  4,  4,  4,  4,  4,  7,  5,  8,
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   28,  1,  1,  1,  1,  1,  1,  1,  1,  1,  1,  1,  1,  1,  1,  1,  1,  1,  1,  1,  1,  1,  1,  1,  1,  1,  1,  1,  1, 29
};
