/* tile 0 */

  0x00,0x00,0x00,0x00,0x00,0x00,0x00,0x00,
  0x00,0x00,0x00,0x00,0x07,0x07,0x07,0x07,
  0x00,0x00,0x00,0x07,0x00,0x07,0x07,0x07,
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  0x00,0x00,0x00,0x07,0x07,0x07,0x00,0x00,
/* tile 1 */

  0x00,0x00,0x00,0x00,0x00,0x00,0x00,0x00,
  0x07,0x07,0x07,0x07,0x07,0x00,0x00,0x00,
  0x07,0x07,0x07,0x07,0x00,0x07,0x00,0x00,
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  0x00,0x00,0x00,0x07,0x07,0x07,0x00,0x00,
/* tile 2 */

  0x00,0x00,0x00,0x07,0x07,0x07,0x00,0x00,
  0x00,0x00,0x00,0x07,0x07,0x00,0x00,0x00,
  0x00,0x00,0x00,0x07,0x00,0x00,0x04,0x00,
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  0x00,0x00,0x00,0x07,0x07,0x07,0x00,0x00,
/* tile 3 */

  0x00,0x00,0x00,0x07,0x07,0x07,0x00,0x00,
  0x00,0x00,0x00,0x00,0x07,0x07,0x00,0x00,
  0x04,0x00,0x04,0x00,0x00,0x07,0x00,0x00,
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  0x00,0x00,0x00,0x07,0x07,0x07,0x00,0x00,
/* tile 4 */

  0x00,0x00,0x00,0x07,0x07,0x07,0x00,0x00,
  0x00,0x00,0x00,0x07,0x07,0x07,0x00,0x00,
  0x00,0x00,0x00,0x07,0x07,0x07,0x00,0x00,
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  0x00,0x00,0x00,0x00,0x00,0x00,0x00,0x00,
/* tile 5 */

  0x00,0x00,0x00,0x07,0x07,0x07,0x00,0x00,
  0x00,0x00,0x00,0x07,0x07,0x07,0x00,0x00,
  0x00,0x00,0x00,0x07,0x07,0x07,0x00,0x00,
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  0x00,0x00,0x00,0x00,0x00,0x00,0x00,0x00,
/* tile 6 */

  0x00,0x00,0x00,0x00,0x00,0x00,0x00,0x00,
  0x00,0x00,0x00,0x00,0x00,0x04,0x00,0x04,
  0x00,0x00,0x00,0x04,0x00,0x00,0x04,0x00,
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  0x00,0x00,0x00,0x00,0x04,0x00,0x00,0x00,
/* tile 7 */

  0x00,0x00,0x00,0x00,0x00,0x00,0x00,0x00,
  0x00,0x04,0x00,0x04,0x00,0x00,0x00,0x00,
  0x04,0x00,0x04,0x00,0x00,0x07,0x00,0x00,
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  0x00,0x00,0x00,0x07,0x07,0x07,0x00,0x00,
/* tile 8 */

  0x00,0x00,0x00,0x04,0x00,0x04,0x00,0x00,
  0x00,0x00,0x00,0x00,0x04,0x00,0x00,0x00,
  0x00,0x00,0x00,0x04,0x00,0x00,0x04,0x00,
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  0x00,0x00,0x00,0x00,0x04,0x00,0x00,0x00,
/* tile 9 */

  0x00,0x00,0x00,0x04,0x00,0x04,0x00,0x00,
  0x00,0x00,0x00,0x00,0x04,0x00,0x00,0x00,
  0x00,0x00,0x00,0x04,0x00,0x04,0x00,0x00,
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  0x00,0x00,0x00,0x00,0x00,0x00,0x00,0x00,
/* tile 10 */

  0x00,0x00,0x00,0x07,0x07,0x07,0x00,0x00,
  0x00,0x00,0x00,0x07,0x07,0x07,0x00,0x00,
  0x00,0x00,0x00,0x07,0x07,0x07,0x00,0x00,
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  0x00,0x00,0x00,0x00,0x00,0x00,0x00,0x00,
/* tile 11 */

  0x00,0x00,0x00,0x00,0x00,0x00,0x00,0x00,
  0x00,0x00,0x00,0x00,0x07,0x07,0x07,0x07,
  0x00,0x00,0x00,0x04,0x00,0x07,0x07,0x07,
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  0x00,0x00,0x00,0x00,0x04,0x00,0x00,0x00,
/* tile 12 */

  0x00,0x00,0x00,0x04,0x00,0x04,0x00,0x00,
  0x00,0x00,0x00,0x00,0x04,0x00,0x00,0x00,
  0x00,0x00,0x00,0x04,0x00,0x07,0x07,0x07,
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  0x00,0x00,0x00,0x07,0x07,0x07,0x00,0x00,
/* tile 13 */

  0x00,0x00,0x00,0x07,0x07,0x07,0x00,0x00,
  0x00,0x00,0x00,0x00,0x07,0x07,0x00,0x00,
  0x07,0x07,0x07,0x07,0x00,0x07,0x00,0x00,
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  0x00,0x00,0x00,0x00,0x04,0x00,0x00,0x00,
/* tile 14 */

  0x00,0x00,0x00,0x04,0x00,0x04,0x00,0x00,
  0x00,0x00,0x00,0x00,0x04,0x00,0x00,0x00,
  0x00,0x00,0x00,0x04,0x00,0x04,0x00,0x00,
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  0x00,0x00,0x00,0x00,0x00,0x00,0x00,0x00,
/* tile 15 */

  0x00,0x00,0x00,0x04,0x00,0x04,0x00,0x00,
  0x00,0x00,0x00,0x00,0x04,0x00,0x00,0x00,
  0x00,0x00,0x00,0x04,0x00,0x07,0x07,0x07,
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  0x00,0x00,0x00,0x00,0x04,0x00,0x00,0x00,
/* tile 16 */

  0x00,0x00,0x00,0x07,0x07,0x07,0x00,0x00,
  0x00,0x00,0x00,0x00,0x07,0x07,0x00,0x00,
  0x07,0x07,0x07,0x07,0x00,0x07,0x00,0x00,
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  0x00,0x00,0x00,0x07,0x07,0x07,0x00,0x00,
/* tile 17 */

  0x00,0x00,0x00,0x04,0x00,0x04,0x00,0x00,
  0x00,0x00,0x00,0x00,0x04,0x00,0x00,0x00,
  0x00,0x00,0x00,0x04,0x00,0x04,0x00,0x00,
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  0x00,0x00,0x00,0x00,0x00,0x00,0x00,0x00,
/* tile 18 */

  0x00,0x00,0x00,0x00,0x00,0x00,0x00,0x00,
  0x00,0x00,0x00,0x00,0x00,0x04,0x00,0x04,
  0x00,0x00,0x00,0x07,0x00,0x00,0x04,0x00,
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  0x00,0x00,0x00,0x07,0x07,0x07,0x00,0x00,
/* tile 19 */

  0x00,0x00,0x00,0x07,0x07,0x07,0x00,0x00,
  0x00,0x00,0x00,0x07,0x07,0x00,0x00,0x00,
  0x00,0x00,0x00,0x07,0x00,0x07,0x07,0x07,
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  0x00,0x00,0x00,0x00,0x04,0x00,0x00,0x00,
/* tile 20 */

  0x00,0x00,0x00,0x00,0x00,0x00,0x00,0x00,
  0x07,0x07,0x07,0x07,0x07,0x00,0x00,0x00,
  0x07,0x07,0x07,0x07,0x00,0x04,0x00,0x00,
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  0x00,0x00,0x00,0x00,0x04,0x00,0x00,0x00,
/* tile 21 */

  0x00,0x00,0x00,0x04,0x00,0x04,0x00,0x00,
  0x00,0x00,0x00,0x00,0x04,0x00,0x00,0x00,
  0x07,0x07,0x07,0x07,0x00,0x04,0x00,0x00,
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  0x00,0x00,0x00,0x07,0x07,0x07,0x00,0x00,
/* tile 22 */

  0x00,0x00,0x00,0x07,0x07,0x07,0x00,0x00,
  0x00,0x00,0x00,0x07,0x07,0x00,0x00,0x00,
  0x00,0x00,0x00,0x07,0x00,0x07,0x07,0x07,
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  0x00,0x00,0x00,0x07,0x07,0x07,0x00,0x00,
/* tile 23 */

  0x00,0x00,0x00,0x00,0x00,0x00,0x00,0x00,
  0x00,0x04,0x00,0x04,0x00,0x00,0x00,0x00,
  0x04,0x00,0x04,0x00,0x00,0x04,0x00,0x00,
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  0x00,0x00,0x00,0x00,0x04,0x00,0x00,0x00,
/* tile 24 */

  0x00,0x00,0x00,0x04,0x00,0x04,0x00,0x00,
  0x00,0x00,0x00,0x00,0x04,0x00,0x00,0x00,
  0x07,0x07,0x07,0x07,0x00,0x04,0x00,0x00,
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  0x00,0x00,0x00,0x00,0x04,0x00,0x00,0x00,
/* tile 25 */

  0x00,0x00,0x00,0x04,0x00,0x04,0x00,0x00,
  0x00,0x00,0x00,0x00,0x04,0x00,0x00,0x00,
  0x00,0x00,0x00,0x04,0x00,0x04,0x00,0x00,
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  0x00,0x00,0x00,0x00,0x00,0x00,0x00,0x00,