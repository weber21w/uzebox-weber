const char Level5Song[] PROGMEM ={//midiconv -s0 -e58752 -f10 zelda.mid zelda.inc
0x00,0xc0,0x3e,0x00,0xc1,0x3f,0x00,0xc2,0x40,0x00,0xc3,0x30,0x00,0xb0,0x07,0x7f,0x00,0xb1,0x07,0x7f,0x00,0xb2,0x07,0x7f,0x00,0x92,0x2e,0x64,0x00,0xb3,0x07,0x7f,
0x00,0xff,0x06,0x01,0x53,0x10,0x91,0x35,0x64,0x11,0x3a,0x64,0x11,0x3e,0x64,0x10,0x3a,0x64,0x11,0x35,0x64,0x11,0x92,0x2b,0x64,0x11,0x91,0x32,0x64,0x10,0x37,0x64,
0x11,0x3a,0x64,0x11,0x37,0x64,0x10,0x32,0x64,0x11,0x92,0x30,0x64,0x11,0x91,0x37,0x64,0x11,0x3a,0x64,0x10,0x41,0x64,0x11,0x3a,0x64,0x11,0x37,0x64,0x10,0x92,0x29,
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0xff,0x06,0x01,0x45,0x00,0xff,0x2f,0x00 };



