const char Level4Song[] PROGMEM ={//midiconv -s0 -e44200 -f22 dukest.mid duke.inc
0x00,0xc0,0x2e,0x00,0xc1,0x2f,0x00,0xc2,0x30,0x00,0xc3,0x08,0x00,0xb0,0x07,0x7f,0x00,0xb1,0x07,0x7f,0x00,0xb2,0x07,0x7f,0x00,0xb3,0x07,0x7f,0x00,0x07,0x7f,0x00,
0x07,0x7f,0x00,0x07,0x7f,0x00,0x07,0x7f,0x00,0x07,0x7f,0x00,0xff,0x06,0x01,0x53,0x01,0xb0,0x64,0x00,0x00,0x64,0x00,0x00,0x64,0x00,0x00,0xb1,0x64,0x00,0x00,0x64,
0x00,0x00,0xb2,0x64,0x00,0x00,0x64,0x00,0x00,0xb3,0x64,0x00,0x00,0x64,0x00,0x00,0x64,0x00,0x00,0x64,0x00,0x00,0x64,0x00,0x00,0x64,0x00,0x04,0xb0,0x64,0x7f,0x00,
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0x06,0x01,0x45,0x00,0xff,0x2f,0x00 };

