//Original FamiTone format data is included for sound effects..
//In case someone ever wanted to make them sound good.
const char patch00[] PROGMEM ={//card blip 1
 	0,PC_WAVE,4,
	0,PC_PITCH,74,
	1,PC_PITCH,78,
	1,PC_PITCH,82,
	1,PC_PITCH,86,
	1,PC_PITCH,90,
	1,PC_ENV_SPEED,-14,
	6,PC_NOTE_CUT,0,
	0,PATCH_END
  };

const char patch01[] PROGMEM ={//card blip 2
 	0,PC_WAVE,0,
	0,PC_PITCH,45,
	1,PC_PITCH,50,
	1,PC_PITCH,54,
	1,PC_PITCH,59,
	1,PC_PITCH,64,
	1,PC_PITCH,68,
	1,PC_PITCH,73,
	1,PC_PITCH,77,
	1,PC_ENV_SPEED,-14,
	8,PC_NOTE_CUT,0,
	0,PATCH_END
  };

const char patch02[] PROGMEM ={//card blip 3
 	0,PC_WAVE,2,
	0,PC_PITCH,47,
	1,PC_PITCH,49,
	1,PC_PITCH,51,
	1,PC_PITCH,54,
	1,PC_PITCH,56,
	1,PC_PITCH,58,
	1,PC_PITCH,60,
	1,PC_ENV_SPEED,-4,
	16,PC_NOTE_CUT,0,
	0,PATCH_END
  };

const char patch03[] PROGMEM ={//VECTORMAN PORT LEAD
0,PC_WAVE,3,//2
0,PC_ENV_VOL,58,
1,PC_ENV_SPEED,25,
0,PC_TREMOLO_RATE,223,
0,PC_TREMOLO_LEVEL,170,
//0,PC_ENV_SPEED,2,
//7,PC_ENV_SPEED,1,
//1,PC_ENV_SPEED,0,
1,PC_ENV_SPEED,-1,
19,PC_ENV_SPEED,-4,
0,PC_NOTE_HOLD,0,
3,PC_ENV_SPEED,-10,
4,PC_ENV_SPEED,-12,
//0,PC_NOTE_HOLD,0,
9,PC_NOTE_CUT,0,
0,PATCH_END
  };



const char patch04[] PROGMEM ={//VECTORMAN PORT RYTHM
0,PC_TREMOLO_LEVEL,170,     
0,PC_TREMOLO_RATE,160, 
0,PC_WAVE,4,
0,PC_ENV_VOL,54,
0,PC_ENV_SPEED,16,
1,PC_NOTE_HOLD,0,
0,PC_ENV_SPEED,-3,
32,PC_NOTE_CUT,0,
0,PATCH_END

/*
0,PC_WAVE,4,//4
0,PC_ENV_VOL,67,
0,PC_TREMOLO_RATE,203,
0,PC_TREMOLO_LEVEL,158,

//0,PC_ENV_SPEED,2,
//7,PC_ENV_SPEED,1,
//1,PC_ENV_SPEED,0,
3,PC_ENV_SPEED,-1,//3,PC_ENV_SPEED,-1,
3,PC_ENV_SPEED,-2,
5,PC_ENV_SPEED,-7,//was 5
7,PC_ENV_SPEED,-13,//was 3
//0,PC_NOTE_HOLD,0,
11,PC_NOTE_CUT,0,
0,PATCH_END
*/
  };

const char patch05[] PROGMEM ={//VECTORMAN PORT BASS
0,PC_WAVE,3,
0,PC_ENV_VOL,60,
0,PC_TREMOLO_RATE,120,
0,PC_TREMOLO_LEVEL,99,
1,PC_ENV_VOL,74,
4,PC_ENV_VOL,77,
0,PC_WAVE,2,
1,PC_TREMOLO_RATE,60,
6,PC_ENV_SPEED,-8,//was 2
//0,PC_ENV_SPEED,2,
//7,PC_ENV_SPEED,1,
//1,PC_ENV_SPEED,0,
2,PC_ENV_SPEED,-10,
6,PC_ENV_SPEED,-20,//was 3

6,PC_ENV_VOL,72,//ADDED ECHO, CREATE STATIC?
//0,PC_NOTE_HOLD,0,
10,PC_NOTE_CUT,0,
0,PATCH_END


  };

const char patch06[] PROGMEM ={//VECTORMAN PORT BASS DRUM
  	0,PC_NOISE_PARAMS,9,
  	0,PC_ENV_VOL,0x40,
	1,PC_NOISE_PARAMS,12,
	1,PC_ENV_SPEED,-4,
  	1,PC_ENV_SPEED,-12,
	1,PC_ENV_SPEED,-30, 
  	8,PC_NOTE_CUT,0,
  	0,PATCH_END

  };

const char patch07[] PROGMEM ={//VECTORMAN PORT SNARE DRUM
   	0,PC_NOISE_PARAMS,9,
  	0,PC_ENV_VOL,0x40,
	1,PC_NOISE_PARAMS,12,
	1,PC_ENV_SPEED,-4,
  	1,PC_ENV_SPEED,-12,
	1,PC_ENV_SPEED,-30, 
  	8,PC_NOTE_CUT,0,
  	0,PATCH_END

  };


const char patch08[] PROGMEM ={//VECTORMAN PORT HAT?
  	0,PC_NOISE_PARAMS,9,
  	0,PC_ENV_VOL,0x40,
	1,PC_NOISE_PARAMS,12,
	1,PC_ENV_SPEED,-4,
  	1,PC_ENV_SPEED,-12,
	1,PC_ENV_SPEED,-30, 
  	8,PC_NOTE_CUT,0,
  	0,PATCH_END
  };

const char patch09[] PROGMEM ={//VECTORMAN PORT HATS??
  	0,PC_NOISE_PARAMS,9,
  	0,PC_ENV_VOL,0x40,
	1,PC_NOISE_PARAMS,12,
	1,PC_ENV_SPEED,-4,
  	1,PC_ENV_SPEED,-12,
	1,PC_ENV_SPEED,-30, 
  	8,PC_NOTE_CUT,0,
  	0,PATCH_END
  };

const char patch10[] PROGMEM ={//VECTORMAN PORT TOM1?
  	0,PC_NOISE_PARAMS,9,
  	0,PC_ENV_VOL,0x40,
	1,PC_NOISE_PARAMS,12,
	1,PC_ENV_SPEED,-4,
  	1,PC_ENV_SPEED,-12,
	1,PC_ENV_SPEED,-30, 
  	8,PC_NOTE_CUT,0,
  	0,PATCH_END
  };

const char patch11[] PROGMEM ={//VECTORMAN PORT TOM2?
  	0,PC_NOISE_PARAMS,9,
  	0,PC_ENV_VOL,0x40,
	1,PC_NOISE_PARAMS,12,
	1,PC_ENV_SPEED,-4,
  	1,PC_ENV_SPEED,-12,
	1,PC_ENV_SPEED,-30, 
  	8,PC_NOTE_CUT,0,
  	0,PATCH_END
  };



const char patch12[] PROGMEM ={//VECTORMAN PORT CYMBAL?
  	0,PC_NOISE_PARAMS,9,
  	0,PC_ENV_VOL,0x40,
	1,PC_NOISE_PARAMS,12,
	1,PC_ENV_SPEED,-4,
  	1,PC_ENV_SPEED,-12,
	1,PC_ENV_SPEED,-30, 
  	8,PC_NOTE_CUT,0,
  	0,PATCH_END
  };

const char patch13[] PROGMEM ={//VECTORMAN PORT CYMBAL?
  	0,PC_NOISE_PARAMS,9,
  	0,PC_ENV_VOL,0x40,
	1,PC_NOISE_PARAMS,12,
	1,PC_ENV_SPEED,-4,
  	1,PC_ENV_SPEED,-12,
	1,PC_ENV_SPEED,-30, 
  	8,PC_NOTE_CUT,0,
  	0,PATCH_END
  }; 


const char patch14[] PROGMEM ={//VECTORMAN PORT CYMBAL?
  	0,PC_NOISE_PARAMS,9,
  	0,PC_ENV_VOL,0x40,
	1,PC_NOISE_PARAMS,12,
	1,PC_ENV_SPEED,-4,
  	1,PC_ENV_SPEED,-12,
	1,PC_ENV_SPEED,-30, 
  	8,PC_NOTE_CUT,0,
  	0,PATCH_END
  };


const char patch15[] PROGMEM ={//TMNT BASE song 1

0,PC_TREMOLO_LEVEL,88,     
0,PC_TREMOLO_RATE,155, 
0,PC_WAVE,4,
0,PC_ENV_VOL,59,
0,PC_ENV_SPEED,16,
0,PC_NOTE_HOLD,0,
0,PC_ENV_SPEED,-8,
16,PC_NOTE_CUT,0,
0,PATCH_END

  }; 

const char patch16[] PROGMEM ={//TMNT BASEsong 2
0,PC_TREMOLO_LEVEL,170,     
0,PC_TREMOLO_RATE,180, 
0,PC_WAVE,4,
0,PC_ENV_VOL,54,
0,PC_ENV_SPEED,16,
1,PC_NOTE_HOLD,0,
0,PC_ENV_SPEED,-3,
8,PC_NOTE_CUT,0,
0,PATCH_END
  }; 
const char patch17[] PROGMEM ={//TMNT BASEsong 3 bass
0,PC_TREMOLO_LEVEL,140,     
0,PC_TREMOLO_RATE,90, 
0,PC_WAVE,4,
1,PC_ENV_VOL,90,
1,PC_ENV_SPEED,2,
0,PC_NOTE_HOLD,0,
0,PC_ENV_SPEED,-6,
18,PC_NOTE_CUT,0,
0,PATCH_END
  };

const char patch18[] PROGMEM ={//TMNT BASEsong 4
0,PC_TREMOLO_LEVEL,180,     
0,PC_TREMOLO_RATE,90, 
0,PC_WAVE,4,
1,PC_ENV_VOL,90,
0,PC_ENV_SPEED,5,
0,PC_NOTE_HOLD,0,
0,PC_ENV_SPEED,-6,
18,PC_NOTE_CUT,0,
0,PATCH_END
  };

const char patch19[] PROGMEM ={//TMNT BASEsong drums 1
0,PC_NOISE_PARAMS,122,
0,PC_ENV_VOL,60,
0,PC_ENV_SPEED,15,
1,PC_ENV_SPEED,-15,
1,PC_ENV_SPEED,-8, 
3,PC_NOTE_CUT,0,
0,PATCH_END

};


const char patch20[] PROGMEM ={//TMNT BASEsong drums 2
  	0,PC_NOISE_PARAMS,11,
  	0,PC_ENV_VOL,40,
  	0,PC_ENV_SPEED,-20, 
  	4,PC_NOTE_CUT,0,
  	0,PATCH_END
/*
0,PC_NOISE_PARAMS,14,
0,PC_ENV_VOL,40,
0,PC_ENV_SPEED,10,
1,PC_ENV_SPEED,-20,
1,PC_ENV_SPEED,-8,
1,PC_ENV_SPEED,-4,  
5,PC_NOTE_CUT,0,
0,PATCH_END
*/
  };


const char patch21[] PROGMEM ={//TMNT BASE song drums 3
  	0,PC_NOISE_PARAMS,11,
  	0,PC_ENV_VOL,40,
  	0,PC_ENV_SPEED,-20, 
  	4,PC_NOTE_CUT,0,
  	0,PATCH_END
  };

/////////////////////////////////////////////////////
const char patch22[] PROGMEM ={//OIL INSTRUMENT 1
0,PC_WAVE,2,
0,PC_ENV_VOL,76,
0,PC_ENV_SPEED,25,
0,PC_TREMOLO_RATE,199,
0,PC_TREMOLO_LEVEL,160,
//0,PC_ENV_SPEED,2,
//7,PC_ENV_SPEED,1,
//1,PC_ENV_SPEED,0,
1,PC_ENV_SPEED,-1,
19,PC_ENV_SPEED,-4,
0,PC_NOTE_HOLD,0,
3,PC_ENV_SPEED,-10,
4,PC_ENV_SPEED,-12,
//0,PC_NOTE_HOLD,0,
5,PC_NOTE_CUT,0,
0,PATCH_END
  }; 
const char patch23[] PROGMEM ={//OIL INSTRUMENT 2
0,PC_WAVE,4,//4
0,PC_ENV_VOL,80,
0,PC_TREMOLO_RATE,45,
0,PC_TREMOLO_LEVEL,151,
0,PC_ENV_SPEED,2,
//0,PC_ENV_SPEED,2,
//7,PC_ENV_SPEED,1,
//1,PC_ENV_SPEED,0,
1,PC_ENV_SPEED,-3,
4,PC_ENV_SPEED,-7,
//0,PC_NOTE_HOLD,0,
11,PC_NOTE_CUT,0,
0,PATCH_END
  };

const char patch24[] PROGMEM ={//OIL INSTRUMENT 3
0,PC_WAVE,3,
0,PC_ENV_VOL,80,
0,PC_TREMOLO_RATE,120,
0,PC_TREMOLO_LEVEL,99,
1,PC_ENV_VOL,84,
4,PC_ENV_VOL,87,
0,PC_WAVE,2,
1,PC_TREMOLO_RATE,60,
2,PC_ENV_SPEED,-8,
//0,PC_ENV_SPEED,2,
//7,PC_ENV_SPEED,1,
//1,PC_ENV_SPEED,0,
0,PC_ENV_SPEED,-10,
3,PC_ENV_SPEED,-20,
//0,PC_NOTE_HOLD,0,
11,PC_NOTE_CUT,0,
0,PATCH_END
  };

const char patch25[] PROGMEM ={//Stage 1 song drums 1
0,PC_NOISE_PARAMS,5,
0,PC_ENV_VOL,66,
0,PC_ENV_SPEED,-30,
1,PC_ENV_SPEED,-15,
1,PC_ENV_SPEED,-8,  
1,PC_NOTE_CUT,0,
0,PATCH_END
  };


const char patch26[] PROGMEM ={//Stage 1 song drums 2
0,PC_NOISE_PARAMS,8,
0,PC_ENV_VOL,55,
0,PC_ENV_SPEED,-30,
1,PC_ENV_SPEED,-15,
1,PC_ENV_SPEED,-8, 
2,PC_NOTE_CUT,0,
0,PATCH_END
  };


const char patch27[] PROGMEM ={//Stage 1 song drums 3
  	0,PC_NOISE_PARAMS,1,
  	0,PC_ENV_VOL,0x53,
  	0,PC_ENV_SPEED,-30, 
  	8,PC_NOTE_CUT,0,
  	0,PATCH_END
  };
//////////////////////////////////////////////////////////
const char patch28[] PROGMEM ={//Stage 2 song 1
0,PC_WAVE,5,
0,PC_ENV_VOL,100,
0,PC_TREMOLO_RATE,121,
0,PC_TREMOLO_LEVEL,88,
//0,PC_ENV_SPEED,2,
//7,PC_ENV_SPEED,1,
//1,PC_ENV_SPEED,0,
0,PC_ENV_SPEED,-10,
4,PC_ENV_SPEED,-15,
//0,PC_NOTE_HOLD,0,
5,PC_NOTE_CUT,0,
0,PATCH_END
  }; 
const char patch29[] PROGMEM ={//Stage 2 song 2
0,PC_WAVE,4,
0,PC_ENV_VOL,102,
0,PC_TREMOLO_RATE,77,
0,PC_TREMOLO_LEVEL,77,

//0,PC_ENV_SPEED,2,
//7,PC_ENV_SPEED,1,
//1,PC_ENV_SPEED,0,
0,PC_ENV_SPEED,-5,
3,PC_ENV_SPEED,-20,
//0,PC_NOTE_HOLD,0,
5,PC_NOTE_CUT,0,
0,PATCH_END
  };

const char patch30[] PROGMEM ={//SONG 1 FIRST PATCH
0,PC_WAVE,3,//2
0,PC_ENV_VOL,58,
1,PC_ENV_SPEED,25,
0,PC_TREMOLO_RATE,223,
0,PC_TREMOLO_LEVEL,170,
//0,PC_ENV_SPEED,2,
//7,PC_ENV_SPEED,1,
//1,PC_ENV_SPEED,0,
1,PC_ENV_SPEED,-1,
19,PC_ENV_SPEED,-4,
0,PC_NOTE_HOLD,0,
3,PC_ENV_SPEED,-10,
4,PC_ENV_SPEED,-12,
//0,PC_NOTE_HOLD,0,
5,PC_NOTE_CUT,0,
0,PATCH_END
  };

const char patch31[] PROGMEM ={//SONG 1 SECOND PATCH
0,PC_WAVE,4,//4
0,PC_ENV_VOL,67,
0,PC_TREMOLO_RATE,203,
0,PC_TREMOLO_LEVEL,158,

//0,PC_ENV_SPEED,2,
//7,PC_ENV_SPEED,1,
//1,PC_ENV_SPEED,0,
3,PC_ENV_SPEED,-1,
3,PC_ENV_SPEED,-2,
3,PC_ENV_SPEED,-7,
3,PC_ENV_SPEED,-13,
//0,PC_NOTE_HOLD,0,
11,PC_NOTE_CUT,0,
0,PATCH_END
  };


const char patch32[] PROGMEM ={//SONG 1 THIRD PATCH
0,PC_WAVE,3,
0,PC_ENV_VOL,80,
0,PC_TREMOLO_RATE,120,
0,PC_TREMOLO_LEVEL,99,
1,PC_ENV_VOL,84,
4,PC_ENV_VOL,87,
0,PC_WAVE,2,
1,PC_TREMOLO_RATE,60,
2,PC_ENV_SPEED,-8,
//0,PC_ENV_SPEED,2,
//7,PC_ENV_SPEED,1,
//1,PC_ENV_SPEED,0,
0,PC_ENV_SPEED,-10,
3,PC_ENV_SPEED,-20,
//0,PC_NOTE_HOLD,0,
11,PC_NOTE_CUT,0,
0,PATCH_END
  };


const char patch33[] PROGMEM ={//SONG 1 INSTRUMENT 1 ALTERNATE
0,PC_WAVE,4,//4
0,PC_ENV_VOL,67,
0,PC_TREMOLO_RATE,203,
0,PC_TREMOLO_LEVEL,158,

//0,PC_ENV_SPEED,2,
//7,PC_ENV_SPEED,1,
//1,PC_ENV_SPEED,0,
3,PC_ENV_SPEED,-1,
3,PC_ENV_SPEED,-2,
3,PC_ENV_SPEED,-7,
3,PC_ENV_SPEED,-13,
//0,PC_NOTE_HOLD,0,
11,PC_NOTE_CUT,0,
0,PATCH_END
  };
/////////////////////////////////////////////////////////
const char patch34[] PROGMEM ={//Stage 3 song 1
0,PC_WAVE,5,
0,PC_ENV_VOL,102,
0,PC_TREMOLO_RATE,121,
0,PC_TREMOLO_LEVEL,55,
//0,PC_ENV_SPEED,2,
//7,PC_ENV_SPEED,1,
//1,PC_ENV_SPEED,0,
0,PC_ENV_SPEED,-10,
4,PC_ENV_SPEED,-17,
0,PC_WAVE,3,
//0,PC_NOTE_HOLD,0,
5,PC_NOTE_CUT,0,
0,PATCH_END
  }; 
const char patch35[] PROGMEM ={//Stage 3 song 2
0,PC_WAVE,4,
0,PC_ENV_VOL,104,
0,PC_TREMOLO_RATE,180,
0,PC_TREMOLO_LEVEL,60,

//0,PC_ENV_SPEED,2,
//7,PC_ENV_SPEED,1,
//1,PC_ENV_SPEED,0,
0,PC_ENV_SPEED,7,
1,PC_ENV_SPEED,-5,
0,PC_TREMOLO_LEVEL,90,
5,PC_ENV_SPEED,-15,
0,PC_WAVE,5,
0,PC_TREMOLO_LEVEL,120,
//0,PC_NOTE_HOLD,0,
5,PC_NOTE_CUT,0,
5,PATCH_END
  };

const char patch36[] PROGMEM ={//FIRST SONG DRUMS 1
0,PC_NOISE_PARAMS,18,
0,PC_ENV_VOL,66,
0,PC_ENV_SPEED,-30,
1,PC_ENV_SPEED,-15,
1,PC_ENV_SPEED,-8,  
1,PC_NOTE_CUT,0,
0,PATCH_END
  };

const char patch37[] PROGMEM ={//FIRST SONG DRUMS 2

  	0,PC_NOISE_PARAMS,5,
  	0,PC_ENV_VOL,0x33,
  	0,PC_ENV_SPEED,-15, 
  	8,PC_NOTE_CUT,0,
  	0,PATCH_END
  };


const char patch38[] PROGMEM ={//FIRST SONG DRUMS 3

0,PC_NOISE_PARAMS,9,
0,PC_ENV_VOL,66,
0,PC_ENV_SPEED,-30,
1,PC_ENV_SPEED,-15,
1,PC_ENV_SPEED,-8,  
1,PC_NOTE_CUT,0,
0,PATCH_END
  };


const char patch39[] PROGMEM ={//FIRST SONG DRUMS 4

  	0,PC_NOISE_PARAMS,22,
  	0,PC_ENV_VOL,0x90,
  	0,PC_ENV_SPEED,-30, 
  	8,PC_NOTE_CUT,0,
  	0,PATCH_END
  };
///////////////////////////////////////////////////////
const char patch40[] PROGMEM ={//4th song patch 1


/*0,PC_WAVE,5,
0,PC_ENV_VOL,100,
0,PC_TREMOLO_RATE,180,
0,PC_TREMOLO_LEVEL,120,
//0,PC_ENV_SPEED,2,
//7,PC_ENV_SPEED,1,
//1,PC_ENV_SPEED,0,
0,PC_ENV_SPEED,-10,
1,PC_ENV_SPEED,-20,
1,PC_WAVE,3,
1,PC_ENV_SPEED,-25,
//0,PC_NOTE_HOLD,0,
5,PC_NOTE_CUT,0,
0,PATCH_END
*/ 
 }; 
const char patch41[] PROGMEM ={//Stage 4 song 2
/*
0,PC_WAVE,0,
0,PC_ENV_VOL,120,
0,PC_TREMOLO_RATE,188,
0,PC_TREMOLO_LEVEL,122,

//0,PC_ENV_SPEED,2,
//7,PC_ENV_SPEED,1,
//1,PC_ENV_SPEED,0,
0,PC_ENV_SPEED,-5,
1,PC_ENV_SPEED,-15,
1,PC_ENV_SPEED,-40,
2,PC_WAVE,3,
0,PC_TREMOLO_RATE,99,
0,PC_TREMOLO_LEVEL,90,

//0,PC_NOTE_HOLD,0,
5,PC_NOTE_CUT,0,
0,PATCH_END
*/  
};

const char patch42[] PROGMEM ={//Stage 4 song 3
/* 
	0,PC_WAVE,4,
 	0,PC_ENV_SPEED,-35,
	0,PATCH_END
*/  
};

const char patch43[] PROGMEM ={//Stage 4 song drums 1
  	0,PC_NOISE_PARAMS,1,
  	0,PC_ENV_VOL,40,
  	0,PC_ENV_SPEED,-15, 
  	8,PC_NOTE_CUT,0,
  	0,PATCH_END
  };


const char patch44[] PROGMEM ={//Stage 4 song drums 2
  	0,PC_NOISE_PARAMS,3,
  	0,PC_ENV_VOL,40,
  	0,PC_ENV_SPEED,-20, 
  	8,PC_NOTE_CUT,0,
  	0,PATCH_END
  };


const char patch45[] PROGMEM ={//Stage 4 song drums 3
  	0,PC_NOISE_PARAMS,1,
  	0,PC_ENV_VOL,50,
  	0,PC_ENV_SPEED,-30, 
  	8,PC_NOTE_CUT,0,
  	0,PATCH_END
  };
/////////////////////////////////////////////////////
const char patch46[] PROGMEM ={//Duke lead
0,PC_TREMOLO_LEVEL,210,     
0,PC_TREMOLO_RATE,110, 
0,PC_WAVE,4,
0,PC_ENV_VOL,116,
0,PC_ENV_SPEED,16,
1,PC_NOTE_HOLD,0,
0,PC_ENV_SPEED,-4,
39,PC_NOTE_CUT,0,
0,PATCH_END
  }; 
const char patch47[] PROGMEM ={//Duke strings
0,PC_TREMOLO_LEVEL,169,     
0,PC_TREMOLO_RATE,62, 
0,PC_WAVE,0,
0,PC_ENV_VOL,41,//was 38
0,PC_ENV_SPEED,3,
2,PC_WAVE,1,
0,PC_ENV_SPEED,2,
16,PC_ENV_SPEED,1,
20,PC_ENV_SPEED,0,
//0,PC_WAVE,1,
100,PC_ENV_SPEED,-1,
60,PC_ENV_SPEED,-2,
8,PC_NOTE_CUT,0,
0,PATCH_END
  };

const char patch48[] PROGMEM ={//Duke bass
0,PC_WAVE,4,
0,PC_ENV_VOL,94,
0,PC_TREMOLO_RATE,120,
0,PC_TREMOLO_LEVEL,99,
1,PC_ENV_VOL,84,
4,PC_ENV_VOL,87,
0,PC_WAVE,2,
1,PC_TREMOLO_RATE,60,
6,PC_ENV_SPEED,-8,
//0,PC_ENV_SPEED,2,
//7,PC_ENV_SPEED,1,
//1,PC_ENV_SPEED,0,
2,PC_ENV_SPEED,-10,

4,PC_ENV_VOL,78,

3,PC_ENV_SPEED,-20,
//0,PC_NOTE_HOLD,0,
11,PC_NOTE_CUT,0,
0,PATCH_END
  };

const char patch49[] PROGMEM ={//Stage 5 song drums 1
0,PC_NOISE_PARAMS,7,
  	0,PC_ENV_VOL,40,
  	0,PC_ENV_SPEED,-30, 
  	8,PC_NOTE_CUT,0,
  	0,PATCH_END

/*0,PC_NOISE_PARAMS,3,
0,PC_ENV_VOL,40,
0,PC_ENV_SPEED,30,
1,PC_ENV_SPEED,-20,
1,PC_ENV_SPEED,-8,
1,PC_ENV_SPEED,-4,  
5,PC_NOTE_CUT,0,
0,PATCH_END
*/
  };


const char patch50[] PROGMEM ={//Stage 5 song drums 2
0,PC_NOISE_PARAMS,2,
0,PC_ENV_VOL,40,
0,PC_ENV_SPEED,-30,
1,PC_ENV_SPEED,-15,
//1,PC_ENV_SPEED,-8, 
1,PC_NOTE_CUT,0,
0,PATCH_END

  };


const char patch51[] PROGMEM ={//Duke bass drum
  	0,PC_NOISE_PARAMS,9,
  	0,PC_ENV_VOL,0x40,
	1,PC_NOISE_PARAMS,12,
	1,PC_ENV_SPEED,-4,
  	1,PC_ENV_SPEED,-12,
	1,PC_ENV_SPEED,-30, 
  	8,PC_NOTE_CUT,0,
  	0,PATCH_END
  };
///////////////////////////////////////////////////////////
const char patch52[] PROGMEM ={//Duke snare
0,PC_NOISE_PARAMS,5,
0,PC_ENV_VOL,0x60,
0,PC_ENV_SPEED,-30,
1,PC_ENV_SPEED,-15,
1,PC_ENV_SPEED,-8,  
1,PC_NOTE_CUT,0,
0,PATCH_END

/*0,PC_ENV_VOL,0x60,
0,PC_ENV_SPEED,-19,
0,PC_NOISE_PARAMS,6,
2,PC_NOISE_PARAMS,0x1,
0,PATCH_END  
*/ 
}; 

const char patch53[] PROGMEM ={//Duke ride cymbal
0,PC_NOISE_PARAMS,1,
0,PC_ENV_VOL,0x40,
0,PC_ENV_SPEED,-30,
0,PC_ENV_SPEED,-3, 
45,PC_NOTE_CUT,0,
0,PATCH_END};

const char patch54[] PROGMEM ={//Duke crash cymbal
0,PC_NOISE_PARAMS,0,
0,PC_ENV_VOL,0x44,
0,PC_ENV_SPEED,-20, 
1,PC_ENV_SPEED,-2,
0,PC_NOISE_PARAMS,1,
10,PC_NOTE_CUT,0,
0,PATCH_END    

};

const char patch55[] PROGMEM ={//Duke overhead tom 1
  	0,PC_NOISE_PARAMS,44,
  	0,PC_ENV_VOL,0x60,
  	0,PC_ENV_SPEED,-30,
	1,PC_ENV_SPEED,-4,
	0,PC_NOISE_PARAMS,39, 
  	16,PC_NOTE_CUT,0,
  	0,PATCH_END
  };


const char patch56[] PROGMEM ={//Duke overhead tom 2
  	0,PC_NOISE_PARAMS,66,
  	0,PC_ENV_VOL,0x60,
  	0,PC_ENV_SPEED,-30,
	1,PC_ENV_SPEED,-4,
	0,PC_NOISE_PARAMS,45, 
  	16,PC_NOTE_CUT,0,
  	0,PATCH_END
  };


const char patch57[] PROGMEM ={//Duke crash 2
  	0,PC_NOISE_PARAMS,1,
  	0,PC_ENV_VOL,0x90,
  	0,PC_ENV_SPEED,-30, 
  	8,PC_NOTE_CUT,0,
  	0,PATCH_END
  };
///////////////////////////////////////////////////////////
const char patch58[] PROGMEM ={//Duke etc
  	0,PC_NOISE_PARAMS,10,
  	0,PC_ENV_VOL,0x90,
  	0,PC_ENV_SPEED,-30, 
  	8,PC_NOTE_CUT,0,
  	0,PATCH_END
  }; 
const char patch59[] PROGMEM ={//Duke etc
  	0,PC_NOISE_PARAMS,1,
  	0,PC_ENV_VOL,40,
  	0,PC_ENV_SPEED,-30, 
  	8,PC_NOTE_CUT,0,
  	0,PATCH_END
  };

const char patch60[] PROGMEM ={//Duke etc
  	0,PC_NOISE_PARAMS,41,
  	0,PC_ENV_VOL,40,
  	0,PC_ENV_SPEED,-30, 
  	8,PC_NOTE_CUT,0,
  	0,PATCH_END
  };

const char patch61[] PROGMEM ={//Duke etc
  	0,PC_NOISE_PARAMS,1,
  	0,PC_ENV_VOL,40,
  	0,PC_ENV_SPEED,-30, 
  	8,PC_NOTE_CUT,0,
  	0,PATCH_END
  };


const char patch62[] PROGMEM ={//Zelda lead(static...)
0,PC_WAVE,0,
0,PC_ENV_VOL,66,//76
0,PC_ENV_SPEED,25,
0,PC_TREMOLO_RATE,180,//199
0,PC_TREMOLO_LEVEL,160,//160
//0,PC_ENV_SPEED,2,
//7,PC_ENV_SPEED,1,
//1,PC_ENV_SPEED,0,
1,PC_ENV_SPEED,-1,
5,PC_WAVE,2,
0,PC_NOTE_HOLD,0,
16,PC_ENV_SPEED,-4,//WAS 14
3,PC_ENV_SPEED,-10,
4,PC_ENV_SPEED,-12,
//0,PC_NOTE_HOLD,0,
5,PC_NOTE_CUT,0,
0,PATCH_END
};


const char patch63[] PROGMEM ={//Zelda rythm(static??)
0,PC_WAVE,4,//4
0,PC_ENV_VOL,22,
0,PC_TREMOLO_RATE,90,//45
0,PC_TREMOLO_LEVEL,101,//151
0,PC_ENV_SPEED,2,
//2,PC_ENV_SPEED,2,
//7,PC_ENV_SPEED,1,
4,PC_ENV_SPEED,0,
6,PC_ENV_SPEED,-3,

3,PC_ENV_VOL,25,//ADDED ECHO, STATIC NOW??

8,PC_ENV_SPEED,-7,
//0,PC_NOTE_HOLD,0,
11,PC_NOTE_CUT,0,
0,PATCH_END


/*
0,PC_TREMOLO_LEVEL,169,//169     
0,PC_TREMOLO_RATE,120, //76*2
0,PC_WAVE,2,//0
0,PC_ENV_VOL,36,//38
0,PC_ENV_SPEED,3,
2,PC_WAVE,2,
0,PC_ENV_SPEED,2,
16,PC_ENV_SPEED,1,
20,PC_ENV_SPEED,0,
//0,PC_WAVE,3,
15,PC_ENV_SPEED,-1,
22,PC_ENV_SPEED,-2,
8,PC_NOTE_CUT,0,
0,PATCH_END
*/ 
 };

const char patch64[] PROGMEM ={//Zelda bass(STATIC IS HERE)
0,PC_WAVE,3,
0,PC_ENV_VOL,80,
0,PC_TREMOLO_RATE,120,
0,PC_TREMOLO_LEVEL,99,
1,PC_ENV_VOL,84,
4,PC_ENV_VOL,87,
0,PC_WAVE,2,
1,PC_TREMOLO_RATE,60,
22,PC_ENV_SPEED,-8,
//0,PC_ENV_SPEED,2,
//7,PC_ENV_SPEED,1,
//1,PC_ENV_SPEED,0,
0,PC_ENV_SPEED,-10,

6,PC_ENV_VOL,80,//ADDED ECHO, STATIC NOW?

6,PC_ENV_SPEED,-20,//WAS 3

//0,PC_NOTE_HOLD,0,
11,PC_NOTE_CUT,0,
0,PATCH_END


/*//0,PC_ENV_VOL,0,


//0,PC_TREMOLO_LEVEL,111,     
//0,PC_TREMOLO_RATE,76, 
0,PC_WAVE,2,
//0,PC_ENV_VOL,42,//52
//0,PC_ENV_SPEED,3,
10,PC_WAVE,0,
//0,PC_ENV_SPEED,2,
//6,PC_ENV_SPEED,1,
3,PC_ENV_SPEED,0,
45,PC_ENV_SPEED,-1,
60,PC_ENV_SPEED,-2,
8,PC_NOTE_CUT,0,
0,PATCH_END
*/ 
 };

const char patch65[] PROGMEM ={//Zelda extra(NOT USED)
8,PC_NOTE_CUT,0,
0,PATCH_END
  };

const char patch66[] PROGMEM ={//Zelda lead(static...)
0,PC_WAVE,2,
0,PC_ENV_VOL,76,
0,PC_ENV_SPEED,25,
0,PC_TREMOLO_RATE,199,
0,PC_TREMOLO_LEVEL,160,
//0,PC_ENV_SPEED,2,
//7,PC_ENV_SPEED,1,
//1,PC_ENV_SPEED,0,
1,PC_ENV_SPEED,-1,
19,PC_ENV_SPEED,-4,
0,PC_NOTE_HOLD,0,
3,PC_ENV_SPEED,-10,
4,PC_ENV_SPEED,-12,
//0,PC_NOTE_HOLD,0,
5,PC_NOTE_CUT,0,
0,PATCH_END
};

const char patch67[] PROGMEM ={//Zelda lead(static...)
0,PC_TREMOLO_LEVEL,170,     
0,PC_TREMOLO_RATE,180, 
0,PC_WAVE,4,
0,PC_ENV_VOL,54,
0,PC_ENV_SPEED,16,
1,PC_NOTE_HOLD,0,
0,PC_ENV_SPEED,-3,
8,PC_NOTE_CUT,0,
0,PATCH_END
};

const char patch68[] PROGMEM ={//Zelda lead(static...)
0,PC_WAVE,3,
0,PC_ENV_VOL,60,
0,PC_TREMOLO_RATE,120,
0,PC_TREMOLO_LEVEL,99,
1,PC_ENV_VOL,70,
4,PC_ENV_VOL,73,
0,PC_WAVE,2,
1,PC_TREMOLO_RATE,60,
22,PC_ENV_SPEED,-8,
//0,PC_ENV_SPEED,2,
//7,PC_ENV_SPEED,1,
//1,PC_ENV_SPEED,0,
0,PC_ENV_SPEED,-10,
3,PC_ENV_SPEED,-20,
//0,PC_NOTE_HOLD,0,
11,PC_NOTE_CUT,0,
0,PATCH_END

/*
0,PC_WAVE,3,
0,PC_ENV_VOL,80,
0,PC_TREMOLO_RATE,120,
0,PC_TREMOLO_LEVEL,99,
1,PC_ENV_VOL,84,
4,PC_ENV_VOL,87,
0,PC_WAVE,2,
1,PC_TREMOLO_RATE,60,
22,PC_ENV_SPEED,-8,
//0,PC_ENV_SPEED,2,
//7,PC_ENV_SPEED,1,
//1,PC_ENV_SPEED,0,
0,PC_ENV_SPEED,-10,
3,PC_ENV_SPEED,-20,
//0,PC_NOTE_HOLD,0,
11,PC_NOTE_CUT,0,
0,PATCH_END
*/
};


const char patch69[] PROGMEM ={//CHEMICAL INSTRUMENT 1
0,PC_WAVE,3,
0,PC_ENV_VOL,76,
0,PC_ENV_SPEED,25,
0,PC_TREMOLO_RATE,88,
0,PC_TREMOLO_LEVEL,200,
//0,PC_ENV_SPEED,2,
//7,PC_ENV_SPEED,1,
//1,PC_ENV_SPEED,0,
//0,PC_NOTE_HOLD,0,
1,PC_ENV_SPEED,-7,
7,PC_ENV_SPEED,-10,
0,PC_NOTE_HOLD,0,

4,PC_ENV_SPEED,-12,
//0,PC_NOTE_HOLD,0,
5,PC_NOTE_CUT,0,
0,PATCH_END
  }; 


const char patch70[] PROGMEM ={//CHEMICAL BASS
0,PC_WAVE,3,
0,PC_ENV_VOL,60,
0,PC_TREMOLO_RATE,222,
0,PC_TREMOLO_LEVEL,67,
1,PC_ENV_VOL,74,
4,PC_ENV_VOL,77,
0,PC_WAVE,2,
//0,PC_NOTE_HOLD,0,
1,PC_TREMOLO_RATE,60,
6,PC_ENV_SPEED,-8,//was 2
//0,PC_ENV_SPEED,2,
//7,PC_ENV_SPEED,1,
//1,PC_ENV_SPEED,0,
20,PC_ENV_SPEED,-10,
6,PC_ENV_SPEED,-20,//was 3

6,PC_ENV_VOL,72,//ADDED ECHO, CREATE STATIC?
//0,PC_NOTE_HOLD,0,
10,PC_NOTE_CUT,0,
0,PATCH_END
  }; 


const char patch71[] PROGMEM ={//CHEMICAL rythm
0,PC_TREMOLO_LEVEL,170,     
0,PC_TREMOLO_RATE,160, 
0,PC_WAVE,4,
0,PC_ENV_VOL,54,
0,PC_ENV_SPEED,16,
//1,PC_NOTE_HOLD,0,
0,PC_ENV_SPEED,-3,
32,PC_NOTE_CUT,0,
0,PATCH_END
  };

const char patch72[] PROGMEM ={//CHEMICAL drums 1
  	0,PC_NOISE_PARAMS,1,
  	0,PC_ENV_VOL,40,
  	0,PC_ENV_SPEED,-15, 
  	8,PC_NOTE_CUT,0,
  	0,PATCH_END
  };


const char patch73[] PROGMEM ={//CHEMICAL drums 2

  	0,PC_NOISE_PARAMS,3,
  	0,PC_ENV_VOL,40,
  	0,PC_ENV_SPEED,-20, 
  	8,PC_NOTE_CUT,0,
  	0,PATCH_END
  };


const char patch74[] PROGMEM ={//CHEMICAL drums 3

  	0,PC_NOISE_PARAMS,1,
  	0,PC_ENV_VOL,50,
  	0,PC_ENV_SPEED,-30, 
  	8,PC_NOTE_CUT,0,
  	0,PATCH_END
  };

const char patch75[] PROGMEM ={//CHEMICAL drums 4

0,PC_NOISE_PARAMS,1,
0,PC_ENV_VOL,0x20,
0,PC_ENV_SPEED,-30,
0,PC_ENV_SPEED,-3, 
45,PC_NOTE_CUT,0,
0,PATCH_END};



/////////////////////////////////////////////////////////



const struct PatchStruct patches[] PROGMEM = {
//sfx
{0,NULL,patch00,0,0},//
{0,NULL,patch01,0,0},//
{0,NULL,patch02,0,0},//
{0,NULL,patch03,0,0},//
{0,NULL,patch04,0,0},//
{0,NULL,patch05,0,0},//
{1,NULL,patch06,0,0},//
{1,NULL,patch07,0,0},//
{1,NULL,patch08,0,0},//
{1,NULL,patch09,0,0},//
{1,NULL,patch10,0,0},//
{1,NULL,patch11,0,0},//
{1,NULL,patch12,0,0},//
{1,NULL,patch13,0,0},//
{1,NULL,patch14,0,0},//
//instruments
{0,NULL,patch15,0,0},//
{0,NULL,patch16,0,0},//
{0,NULL,patch17,0,0},//
{1,NULL,patch18,0,0},//
{1,NULL,patch19,0,0},//
{1,NULL,patch20,0,0},//
{1,NULL,patch21,0,0},//

{0,NULL,patch22,0,0},//
{0,NULL,patch23,0,0},//
{0,NULL,patch24,0,0},//
{1,NULL,patch25,0,0},//
{1,NULL,patch26,0,0},//
{1,NULL,patch27,0,0},//

{0,NULL,patch28,0,0},//
{0,NULL,patch29,0,0},//
{0,NULL,patch30,0,0},//
{0,NULL,patch31,0,0},//
{0,NULL,patch32,0,0},//
{0,NULL,patch33,0,0},//

{0,NULL,patch34,0,0},//
{0,NULL,patch35,0,0},//
{1,NULL,patch36,0,0},//
{1,NULL,patch37,0,0},//
{1,NULL,patch38,0,0},//
{1,NULL,patch39,0,0},//


{0,NULL,patch40,0,0},//
{0,NULL,patch41,0,0},//
{0,NULL,patch42,0,0},//
{1,NULL,patch43,0,0},//
{1,NULL,patch44,0,0},//
{1,NULL,patch45,0,0},//


{0,NULL,patch46,0,0},//
{0,NULL,patch47,0,0},//
{0,NULL,patch48,0,0},//
{1,NULL,patch49,0,0},//
{1,NULL,patch50,0,0},//
{1,NULL,patch51,0,0},//


{1,NULL,patch52,0,0},//
{1,NULL,patch53,0,0},//
{1,NULL,patch54,0,0},//
{1,NULL,patch55,0,0},//
{1,NULL,patch56,0,0},//
{1,NULL,patch57,0,0},//


{1,NULL,patch58,0,0},//
{1,NULL,patch59,0,0},//
{1,NULL,patch60,0,0},//
{1,NULL,patch61,0,0},//
{0,NULL,patch62,0,0},//
{0,NULL,patch63,0,0},//
{0,NULL,patch64,0,0},//
{0,NULL,patch65,0,0},//
{0,NULL,patch66,0,0},//
{0,NULL,patch67,0,0},//
{0,NULL,patch68,0,0},//

{0,NULL,patch69,0,0},//
{0,NULL,patch70,0,0},//
{0,NULL,patch71,0,0},//

{1,NULL,patch72,0,0},//
{1,NULL,patch73,0,0},//
{1,NULL,patch74,0,0},//
{1,NULL,patch75,0,0},//


};

