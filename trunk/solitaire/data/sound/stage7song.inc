const char Level7Song[] PROGMEM ={//dungeon -s0 -e1161 -f60 dungeon.mid
0x00,0xc0,0x42,0x00,0xc1,0x43,0x00,0xc2,0x44,0x00,0xb0,0x07,0x7f,0x00,0xb2,0x07,0x7f,0x00,0xb1,0x07,0x7f,0x00,0xff,0x06,0x01,0x53,0x01,0x92,0x37,0x5a,0x00,0x91,
0x43,0x7f,0x0a,0x90,0x46,0x7f,0x0a,0x91,0x4a,0x7f,0x0a,0x90,0x4b,0x7f,0x00,0xb0,0x0b,0x7f,0x0a,0x91,0x43,0x7f,0x0a,0x90,0x46,0x7f,0x0a,0x91,0x4a,0x7f,0x0a,0x90,
0x4b,0x7f,0x0a,0x92,0x3a,0x5a,0x00,0x91,0x43,0x7f,0x0a,0x90,0x46,0x7f,0x0a,0x91,0x4a,0x7f,0x0a,0x90,0x4b,0x7f,0x0a,0x92,0x3e,0x5a,0x00,0x91,0x43,0x7f,0x0a,0x90,
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0x46,0x7f,0x0a,0x91,0x4a,0x7f,0x00,0xff,0x2f,0x00 };
