const char Level3Song[] PROGMEM ={//ae3.mid s0 -e2281 -f60
0x00,0xc0,0x1e,0x00,0xc1,0x1f,0x00,0xc2,0x20,0x00,0xc3,0x00,0x00,0xb0,0x07,0x7f,0x00,0xb2,0x07,0x7f,0x00,0x07,0x7f,0x00,0x92,0x24,0x6e,0x00,0xb3,0x07,0x7f,0x00,
0x93,0x24,0x6e,0x00,0xb1,0x07,0x7f,0x00,0x91,0x4c,0x6e,0x00,0xff,0x06,0x01,0x53,0x0d,0x93,0x26,0x6e,0x07,0x26,0x6e,0x07,0x92,0x24,0x6e,0x00,0x93,0x25,0x6e,0x00,
0x91,0x4f,0x6e,0x0e,0x93,0x26,0x6e,0x07,0x26,0x6e,0x00,0x91,0x4f,0x6e,0x07,0x92,0x21,0x6e,0x00,0x93,0x24,0x6e,0x00,0x91,0x4c,0x6e,0x0e,0x92,0x21,0x6e,0x00,0x93,
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0x6e,0x00,0xff,0x06,0x01,0x45,0x17,0xff,0x2f,0x00 };
