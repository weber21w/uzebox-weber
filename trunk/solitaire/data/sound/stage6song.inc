const char Level6Song[] PROGMEM ={//-s0 -e15330 -f35 ocean.mid ocean.inc
0x00,0xc0,0x03,0x00,0xc1,0x04,0x00,0xc2,0x05,0x00,0xc3,0x00,0x00,0xb0,0x07,0x64,0x00,0x07,0x78,0x00,0x07,0x64,0x00,0x90,0x24,0x64,0x00,0xb1,0x07,0x64,0x00,0xb2,
0x07,0x64,0x00,0x92,0x30,0x64,0x00,0xb3,0x07,0x6e,0x06,0xff,0x06,0x01,0x53,0x06,0x91,0x3f,0x64,0x00,0x43,0x64,0x0d,0x90,0x24,0x64,0x00,0x92,0x30,0x64,0x0d,0x91,
0x3f,0x64,0x00,0x43,0x64,0x06,0x90,0x24,0x64,0x00,0x92,0x30,0x64,0x0d,0x91,0x43,0x64,0x00,0x3f,0x64,0x06,0x90,0x24,0x64,0x00,0x92,0x30,0x64,0x0d,0x91,0x3f,0x64,
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0x06,0x6a,0x06,0x06,0x64,0x00,0xff,0x06,0x01,0x45,0x06,0xff,0x2f,0x00 };

