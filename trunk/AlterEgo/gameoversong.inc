const char GameOverSong[] PROGMEM ={//aegameover.mid -f60
0x00,0xc0,0x34,0x00,0xc1,0x35,0x00,0xc2,0x02,0x00,0xc3,0x00,0x00,0xb0,0x07,0x60,0x00,0xb1,0x07,0x7f,0x00,0xb2,0x07,0x7f,0x00,0xb3,0x07,0x7f,0x01,0x90,0x4f,0x7f,
0x00,0xb0,0x0b,0x7f,0x00,0xb1,0x0b,0x7f,0x00,0x91,0x4e,0x7f,0x01,0x90,0x4e,0x7f,0x01,0x91,0x4d,0x7f,0x01,0x4e,0x7f,0x01,0x90,0x4f,0x7f,0x04,0x50,0x7f,0x00,0x91,
0x4f,0x7f,0x01,0x90,0x4f,0x7f,0x00,0x91,0x4e,0x7f,0x04,0x90,0x4e,0x7f,0x01,0x91,0x4d,0x7f,0x01,0x4e,0x7f,0x01,0x90,0x4f,0x7f,0x04,0x50,0x7f,0x00,0x91,0x4f,0x7f,
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0x01,0x2b,0x7f,0x01,0x2a,0x7f,0x01,0x29,0x7f,0x01,0x28,0x7f,0x01,0x27,0x7f,0x01,0x26,0x7f,0x01,0x25,0x7f,0x81,0x0c,0xff,0x2f,0x00 };

