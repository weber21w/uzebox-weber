//*********************************//
// MIDI file: lose.inc
//*********************************//
const char midisong[] PROGMEM ={
0x00,0xca,0x50,0x00,0xcb,0x50,0x00,0xcc,0x50,0x00,0xba,0x07,0x7f,0x00,0xbb,0x07,0x7f,0x00,0xbc,0x07,0x7f,0x00,0xff,0x06,0x01,0x53,0x01,0xba,0x07,0x7f,0x00,0x07,
0x00,0x00,0x9a,0x4a,0x7f,0x00,0xbb,0x07,0x7f,0x00,0x07,0x00,0x00,0x9b,0x48,0x7f,0x00,0xbc,0x07,0x7f,0x00,0x9c,0x47,0x7f,0x01,0xba,0x07,0x7f,0x00,0xbb,0x07,0x7f,
0x00,0xbc,0x07,0x7f,0x00,0x9c,0x46,0x7f,0x01,0xba,0x07,0x7f,0x00,0x9a,0x49,0x7f,0x00,0xbb,0x07,0x7f,0x00,0x9b,0x47,0x7f,0x00,0xbc,0x07,0x7f,0x00,0x9c,0x45,0x7f,
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0x07,0x7f,0x00,0xbb,0x07,0x7f,0x00,0xbc,0x07,0x7f,0x83,0xfe,0x23,0xff,0x06,0x01,0x45,0x00,0xff,0x2f,0x00 };
