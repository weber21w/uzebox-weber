//*********************************//
// MIDI file: cmain.inc
//*********************************//
const char midisong[] PROGMEM ={
0x00,0xc0,0x00,0x00,0xc1,0x01,0x00,0xc2,0x02,0x00,0xc3,0x03,0x00,0xb0,0x07,0x7f,0x00,0x91,0x51,0x6e,0x00,0xb2,0x07,0x7f,0x00,0x92,0x2d,0x64,0x00,0xb3,0x07,0x7f,
0x00,0x93,0x06,0x64,0x00,0xff,0x06,0x01,0x53,0x0c,0x90,0x40,0x64,0x00,0x91,0x4c,0x5a,0x00,0x93,0x0c,0x5a,0x07,0x0c,0x5a,0x06,0x91,0x54,0x6e,0x00,0x92,0x28,0x64,
0x00,0x93,0x0c,0x64,0x00,0x08,0x64,0x0d,0x90,0x40,0x64,0x00,0x91,0x4c,0x5a,0x00,0x93,0x0c,0x50,0x0d,0x91,0x53,0x6e,0x00,0x92,0x2d,0x64,0x00,0x93,0x06,0x64,0x0c,
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0x45,0x00,0xff,0x2f,0x00 };
