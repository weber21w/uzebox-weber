const char IntroSong[] PROGMEM = {
0x00,0xc0,0x0b,0x00,0xc1,0x0c,0x00,0xc2,0x0d,0x00,0xb0,0x07,0x70,0x00,0xb1,0x07,0x70,0x00,0xb2,0x07,0x70,0x00,0x90,0x46,0x7f,0x00,0x92,0x3a,0x7f,0x00,0xff,0x06,
0x01,0x53,0x09,0x90,0x45,0x7f,0x00,0x92,0x39,0x7f,0x0a,0x90,0x43,0x7f,0x00,0x92,0x37,0x7f,0x02,0x90,0x45,0x7f,0x00,0x92,0x39,0x7f,0x03,0x90,0x43,0x7f,0x00,0x92,
0x37,0x7f,0x04,0x90,0x42,0x7f,0x00,0x92,0x36,0x7f,0x0b,0x90,0x49,0x7f,0x00,0x91,0x42,0x7f,0x00,0x92,0x3d,0x7f,0x0a,0x90,0x48,0x7f,0x00,0x91,0x41,0x7f,0x00,0x92,
0x3c,0x7f,0x09,0x90,0x46,0x7f,0x00,0x91,0x3f,0x7f,0x00,0x92,0x3a,0x7f,0x03,0x90,0x48,0x7f,0x00,0x91,0x41,0x7f,0x00,0x92,0x3c,0x7f,0x02,0x90,0x46,0x7f,0x00,0x91,
0x3f,0x7f,0x00,0x92,0x3a,0x7f,0x06,0x90,0x45,0x7f,0x00,0x91,0x3e,0x7f,0x00,0x92,0x39,0x7f,0x09,0x90,0x48,0x7f,0x00,0x91,0x41,0x7f,0x00,0x92,0x3c,0x7f,0x83,0xdd,
0x20,0xff,0x06,0x01,0x45,0x00,0xff,0x2f,0x00 };