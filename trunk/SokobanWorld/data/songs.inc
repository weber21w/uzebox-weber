const char LevelClearSong[] PROGMEM ={
0x00,0xc3,0x03,0x00,0xc2,0x02,0x00,0xc1,0x01,0x00,0xc0,0x00,0x00,0xb0,0x07,0x5a,0x00,0x07,0x73,0x00,0x90,0x51,0x64,0x00,0xb1,0x07,0x64,0x00,0xb2,0x07,0x7f,0x00,
0x92,0x21,0x64,0x00,0xff,0x06,0x01,0x53,0x0d,0x90,0x40,0x64,0x07,0x43,0x64,0x0e,0x4b,0x64,0x00,0x92,0x24,0x64,0x07,0x90,0x52,0x64,0x00,0x92,0x28,0x64,0x0e,0x90,
0x47,0x64,0x07,0x58,0x64,0x00,0x92,0x24,0x64,0x0d,0x90,0x43,0x64,0x07,0x51,0x64,0x00,0x92,0x21,0x64,0x0e,0x90,0x51,0x64,0x00,0x92,0x21,0x64,0x07,0x90,0x3e,0x64,
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0x5a,0x00,0x07,0x73,0x00,0x90,0x42,0x01,0x00,0xb0,0x07,0x7f,0x0a,0x92,0x21,0x01,0xd5,0x55,0xff,0x06,0x01,0x45,0x00,0xff,0x2f,0x00
};

const char AmericaSong[] PROGMEM ={

0x00,0xc2,0x02,0x00,0xc1,0x01,0x00,0xc0,0x00,0x00,0xb0,0x07,0x7f,0x00,0x90,0x3a,0x64,0x00,0xb1,0x07,0x5a,0x00,0xb2,0x07,0x7f,0x00,0x92,0x1f,0x64,0x00,0xb3,0x07,
0x7f,0x00,0xff,0x06,0x01,0x53,0x0c,0x90,0x3b,0x64,0x07,0x43,0x64,0x00,0x91,0x47,0x64,0x00,0x93,0x04,0x64,0x0c,0x90,0x3a,0x64,0x00,0x91,0x47,0x64,0x00,0x93,0x04,
0x64,0x07,0x90,0x3b,0x64,0x00,0x92,0x26,0x64,0x0c,0x90,0x43,0x64,0x07,0x3a,0x64,0x00,0x91,0x47,0x64,0x00,0x93,0x03,0x64,0x0c,0x90,0x3b,0x64,0x08,0x43,0x64,0x00,
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0x00,0x93,0x03,0x64,0x13,0x91,0x48,0x64,0x00,0x92,0x30,0x64,0x13,0x93,0x04,0x64,0x0c,0x04,0x64,0x1b,0x03,0x64,0x09,0xff,0x06,0x01,0x45,0x00,0xff,0x2f,0x00 };



const char EgyptSong[] PROGMEM ={

0x00,0xc3,0x75,0x00,0xc2,0x00,0x00,0xc1,0x06,0x00,0xc0,0x05,0x00,0xb0,0x07,0x7f,0x00,0xb1,0x07,0x7f,0x00,0x07,0x7e,0x00,0x07,0x7e,0x00,0xb2,0x07,0x7e,0x00,0x07,
0x7e,0x03,0x90,0x50,0x64,0x00,0x91,0x28,0x70,0x00,0x93,0x08,0x7f,0x00,0xff,0x06,0x01,0x53,0x09,0x90,0x51,0x64,0x09,0x50,0x64,0x00,0x93,0x09,0x7f,0x09,0x90,0x51,
0x64,0x00,0x93,0x09,0x7f,0x08,0x90,0x53,0x64,0x00,0x93,0x08,0x7f,0x12,0x90,0x51,0x64,0x00,0x91,0x26,0x70,0x00,0x93,0x09,0x7f,0x12,0x90,0x50,0x64,0x00,0x91,0x28,
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0x7f,0x09,0x2c,0x66,0x09,0x29,0x66,0x11,0x27,0x72,0x12,0xff,0x06,0x01,0x45,0x00,0xff,0x2f,0x00 };



const char ChinaSong[] PROGMEM ={

0x00,0xc3,0x73,0x00,0xc1,0x10,0x00,0xc2,0x11,0x00,0xc0,0x0f,0x00,0xb0,0x07,0x7f,0x00,0x07,0x7f,0x00,0x93,0x12,0x64,0x00,0xff,0x06,0x01,0x53,0x10,0x92,0x45,0x64,
0x00,0x93,0x13,0x66,0x04,0x92,0x46,0x64,0x04,0x91,0x3a,0x64,0x08,0x92,0x45,0x64,0x00,0x93,0x12,0x64,0x10,0x91,0x3d,0x64,0x00,0x93,0x13,0x66,0x10,0x92,0x46,0x64,
0x00,0x91,0x36,0x64,0x00,0x93,0x12,0x64,0x08,0x92,0x46,0x64,0x00,0x91,0x36,0x64,0x08,0x93,0x13,0x66,0x08,0x92,0x42,0x64,0x00,0x91,0x35,0x64,0x00,0x93,0x12,0x64,
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0x64,0x00,0x93,0x14,0x66,0x08,0x91,0x35,0x64,0x00,0x93,0x14,0x66,0x08,0xff,0x06,0x01,0x45,0x00,0xff,0x2f,0x00 };



const char SouthPoleSong[] PROGMEM ={

0x00,0xc1,0x18,0x00,0xc0,0x17,0x00,0xc2,0x19,0x00,0xc3,0x73,0x06,0x93,0x1a,0x6c,0x00,0xb3,0x07,0x7f,0x00,0xb2,0x07,0x7f,0x00,0x92,0x38,0x6c,0x00,0xb0,0x07,0x7f,
0x00,0xb1,0x07,0x7f,0x00,0x91,0x20,0x6e,0x00,0xff,0x06,0x01,0x53,0x0c,0x93,0x1c,0x6c,0x0d,0x1b,0x6c,0x00,0x91,0x24,0x6e,0x0c,0x93,0x1c,0x6c,0x00,0x91,0x27,0x6e,
0x0d,0x93,0x1a,0x6c,0x00,0x91,0x25,0x6e,0x06,0x25,0x6e,0x07,0x93,0x1c,0x6c,0x00,0x91,0x25,0x6e,0x0c,0x93,0x1b,0x6c,0x00,0x91,0x29,0x6e,0x0d,0x93,0x1a,0x6c,0x00,
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0x00,0x07,0x7f,0x00,0x07,0x7f,0x00,0x07,0x7f,0x00,0x07,0x7f,0x00,0x07,0x7f,0x00,0x07,0x7f,0x00,0x07,0x7f,0x00,0x07,0x7f,0x00,0xff,0x06,0x01,0x45,0x00,0xff,0x2f,
0x00 };



const char JapanSong[] PROGMEM ={

0x00,0xc2,0x20,0x00,0xc1,0x1f,0x00,0xc3,0x73,0x00,0xc0,0x1e,0x00,0x93,0x22,0x64,0x00,0x91,0x29,0x64,0x00,0xff,0x06,0x01,0x53,0x0b,0x93,0x22,0x64,0x0b,0x21,0x64,
0x0c,0x22,0x64,0x00,0x91,0x29,0x64,0x0b,0x93,0x22,0x64,0x00,0x91,0x2c,0x64,0x0b,0x93,0x22,0x64,0x0c,0x21,0x64,0x0b,0x22,0x64,0x00,0x91,0x2c,0x64,0x0b,0x93,0x22,
0x64,0x00,0x91,0x2e,0x64,0x0c,0x93,0x22,0x64,0x0b,0x21,0x64,0x0c,0x22,0x64,0x00,0x91,0x2e,0x64,0x0b,0x93,0x22,0x64,0x00,0x91,0x30,0x64,0x0b,0x93,0x22,0x64,0x00,
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0x21,0x64,0x00,0x91,0x2c,0x64,0x0c,0x93,0x22,0x64,0x00,0x91,0x27,0x64,0x0b,0xff,0x06,0x01,0x45,0x00,0xff,0x2f,0x00 };