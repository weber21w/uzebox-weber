const char SwapWave[] PROGMEM = {/*
0x00,0xFE,0xFF,0xFF,0xFF,0xFD,0xFF,0x02,0x01,0xFE,0x03,0x01,0x00,0x00,0x03,0xFE,
0xFF,0x03,0x00,0xFF,0xFB,0xFF,0xFE,0xFE,0xFB,0x00,0xFF,0xFF,0xFA,0x01,0x01,0xF9,
0x02,0x05,0xFF,0xFE,0x03,0x05,0x03,0xFF,0x02,0x05,0x04,0x02,0x09,0xFF,0xFB,0xFA,
0x02,0xFD,0xFD,0x09,0x03,0x01,0x04,0xFF,0x05,0xFA,0xFB,0xF7,0xFF,0x0B,0x04,0xFB,
0x00,0x06,0xFA,0x04,0x01,0x06,0x07,0xFF,0x04,0x05,0x00,0x07,0x07,0x03,0x06,0x01,
0xFC,0xFF,0xFD,0x00,0x01,0x06,0xFE,0x07,0xFC,0xFD,0xFC,0xE0,0x00,0x02,0x06,0x02,
0xF6,0xF0,0x01,0x08,0xEE,0xF2,0xF0,0x17,0x07,0x17,0x03,0xF9,0xFA,0x03,0x02,0x06,
0x02,0xFF,0xE9,0xFB,0x03,0x10,0xFE,0xF8,0xE8,0xFB,0xF2,0xFE,0x16,0xF0,0x06,0xF4,
0x0E,0xEF,0x03,0x18,0x1E,0xFE,0x02,0xF6,0xFD,0x01,0xF1,0x12,0xF7,0xF6,0xF7,0xFC,
0x11,0x0E,0xF1,0x08,0xFE,0xFD,0xFE,0xFA,0x0E,0x0A,0xE9,0x0C,0x00,0xFD,0x0E,0x1D,
0x02,0xFA,0xF2,0x07,0xFD,0xF6,0x06,0x00,0x01,0x00,0x04,0x07,0x01,0xDF,0x0F,0x03,
0x16,0xF7,0xF2,0xFB,0xF9,0x2E,0xFF,0xFA,0x1E,0x15,0xE4,0x33,0xFF,0x0F,0x1C,0x17,
0xFD,0x10,0xF3,0x0E,0x06,0xF3,0xF6,0x00,0x01,0x14,0x03,0x20,0x06,0xFC,0x0D,0xEA,
0xF7,0xFA,0x0D,0xF8,0x0D,0xEF,0xE9,0x18,0x07,0xE7,0xF0,0xE6,0x1C,0x0D,0xD6,0xFD,
0xF3,0xD8,0xFE,0x0F,0xF9,0xDB,0x06,0x08,0x0C,0x0C,0x17,0x11,0x0E,0x07,0x07,0xFF,
0xF6,0xFC,0x16,0x04,0x23,0x11,0x0F,0xE9,0x02,0x29,0x06,0x03,0xE2,0x0A,0xDD,0x0F,
0x17,0x0D,0x1A,0xF6,0x0D,0x1E,0xD2,0x21,0x1A,0x15,0xF7,0xE2,0xEA,0x0D,0x2A,0x48,
0xD1,0x23,0x3B,0xD1,0x2E,0xFB,0xB8,0x03,0x12,0xEE,0xFC,0xDE,0x06,0xF7,0xEF,0x16,
0x22,0xF3,0x0C,0xF1,0x02,0xE0,0xE6,0x0D,0xF9,0xFC,0xF6,0xFD,0xDF,0x18,0x03,0xE9,
0xD1,0x21,0x00,0x32,0xE3,0x05,0xE8,0x08,0xD2,0x20,0x06,0xF5,0xE4,0x0D,0x03,0xFF,
0x03,0x0C,0x1A,0x27,0x08,0x1D,0x24,0xDD,0xE6,0x0B,0xCA,0x1B,0x05,0x26,0xF9,0x14,
0xFB,0x31,0xDF,0xCA,0x04,0x13,0xE7,0xCD,0xE8,0x12,0x35,0x16,0x0F,0x1B,0x0D,0xDC,
0x0E,0xB5,0x11,0xFF,0x03,0xE6,0x07,0xEE,0xF1,0xF9,0xEA,0x1F,0xF1,0x22,0xC4,0x1B,
0xF6,0xF3,0xEC,0x24,0x01,0x14,0x1C,0xF3,0x17,0x06,0x2D,0x28,0xE8,0xE1,0xCE,0xFA,
0xEB,0xFF,0xFB,0xB8,0x09,0x07,0xFC,0xC8,0x10,0xE4,0x0F,0xDF,0xD6,0x26,0xFD,0xFC,
0x31,0xE9,0x04,0xF5,0x20,0xD7,0x08,0xE5,0xEC,0x09,0x0C,0x20,0xFB,0x05,0xF8,0x0B,
0xDD,0xF7,0xFB,0x1C,0x10,0x1E,0x28,0x10,0x21,0xE5,0x03,0x23,0x0E,0xEF,0x01,0xF7,
0x0C,0x10,0x0F,0xF1,0x18,0x00,0xFF,0x0B,0x05,0xDF,0x0B,0xEA,0x0D,0x09,0x1A,0xE9,
0x0D,0xE0,0xE9,0xDE,0x03,0x13,0x14,0xF8,0xF8,0x0C,0x07,0xD5,0xF9,0xF5,0x0F,0xDD,
0x0A,0xE3,0xFA,0x0E,0xF6,0xFB,0xF9,0x2B,0x0B,0xF0,0xF0,0x14,0x07,0xF4,0x13,0x14,
0xF2,0xD4,0xFA,0x11,0xEB,0xF4,0xFA,0x08,0x08,0xF9,0x07,0x08,0x05,0xED,0x03,0x02,
0x10,0x08,0xE7,0x13,0x04,0xF4,0xE1,0xE8,0x22,0xFB,0x0E,0xE1,0x15,0xF5,0xFD,0x02,
0x03,0x0B,0xF6,0xFD,0x0D,0x0C,0x0F,0xFC,0x02,0xFB,0x06,0xFF,0x04,0x0A,0xFE,0xF4,
0x04,0x0C,0x00,*/

/*0x0A,0x04,0xFF,0xF0,0x08,0xF9,0x01,0x02,0xFC,0x0E,0xEA,0x01,0x06,
0x0A,0x0E,0x00,0x01,0xFA,0x05,0x06,0xF5,0x03,0xF9,0xFB,0xFA,0x03,0xF9,0x06,0x04,
0x07,0xFE,0xFA,0xFC,0xFB,0xFD,0x08,0xF4,0x0D,0x08,0x01,0x0D,0x00,0x07,0xF9,0xF7,
0xFF,0xFE,0x05,0x0E,0xF3,0xFE,0xFD,0x0F,0xF4,0x07,0x04,0xF5,0x03,0x04,0xFE,0x00,
0x0B,0xFC,0xF2,0x03,0xF6,0x01,0x10,0xF7,0x07,0xFA,0x02,0xFB,0x0A,0xF6,0x03,0x00,
0xF8,0x06,0x07,0xFE,0xFC,0x09,0xFC,0xFF,0x04,0x04,0x0B,0xFE,0x0C,0xFA,0xF0,0x06,
0x01,0xF5,0xFB,0x09,0xFA,0xF7,0x00,0xFF,0xFB,0x00,0xFB,0x07,0xFA,0x01,0x03,0xFC,
0x00,0xFC,0x01,0x02,0xFE,0x05,0xFE,0xFC,0x01,0xFB,0x00,0xFB,0x03,0x04,0xFE,0x01,
0xFD,0x07,0x07,0x00,0x00,0xFD,0x05,0xFF,0x06,0x03,0xFC,0xF9,0x02,0xFE,0x06,0xFD,
0xFD,0x01,0x04,0xFE,0xFD,0x04,0xFB,0xFC,0xFD,0x02,0xFF,0x01,0xFE,0x03,0x01,0xFF,
0xFB,0x00,0xFD,0x00,0x03,0xF8,0xFB,0x01,0xFD,0xFC,0xFF,0xFD,0xFA,0x00,0x00,0x04,
0x02,0xFC,0xFB,0x04,0xFC,0x02,0xFF,0x01,0x01,0x03,0xFE,0xFC,0xFB,0x02,0xFC,0xFE,
0x00,0xFF,0xFA,0xFE,0xFF,0x03,0x01,0x02,0x00,0x01,0x00,0xFF,0xFE,0x04,0x02,0xFF,
0x01,0xFD,0x00,0xFE,0xFD,0xFE,0xFD,0x03,0x01,0x02,0xFC,0x02,0x01,0xFF,0x05,0x03,
0xFF,0x00,0x01,0xFE,0xFF,0xFB,0x00,0x03,0xFF,0xFE,0xFF,0xFB,0xFD,0x00,0x00,0x01,
0xFE,0x00,0x00,0x01,0xFD,0x00,0xFF,0xFE,0xFD,0x00,0x00,0xFF,0x01,0xFF,0xFF,0xFF,
0xFF,0xFD,0x00,0xFF,0xFF,0xFF,0xFF,0x01,0x00,0x00,0x01,0x01,0xFC,0x02,0xFE,0xFE,
0x00
*/
};










///////////////////////////////////////////////////////////////////////////////
const char DropWave[] PROGMEM = {
0xFF,0x02,0xFE,0x03,0xFC,0x06,0xF6,0x17,0x17,0x39,0x3F,0xAB,0xAF,0x8C,0xA6,0x8A,
0xAA,0x97,0x23,0x3A,0xD7,0x20,0xC4,0x76,0x13,0xD4,0xB8,0xAC,0xA4,0x95,0x9E,0xA4,
0x57,0xE3,0x01,0xE9,0xBB,0x7F,0x3D,0x57,0x28,0x43,0xE1,0xF1,0xA9,0x6F,0xFC,0xF6,
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0x0D,0x0D,0x0D,0x0B,0x08,0x04,0xFB,0xF3,0xF3,0x05,0x0F,0x0B,0x04,0x02,0x01,0x00 

};
////////////////////////////////////////////////////////////////////////////////











////////////////////////////////////////////////////////////////////////////////
const char ScoreWave[] PROGMEM = {
0x00,0xFF,0xFE,0x04,0xFA,0xFF,0x03,0xFA,0x04,0x05,0x1C,0xF8,0xC9,0x11,0x1C,0x03,
0x00,0xF1,0xB2,0x24,0xDF,0xE3,0x01,0xDF,0x12,0x17,0xC2,0x10,0xFA,0xCB,0x11,0xF4,
0xF0,0x12,0xCD,0xF6,0x1C,0xD1,0x0C,0x19,0xD1,0xF4,0xEB,0xD5,0x30,0xF0,0xFF,0x1F,
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0x01,0x00
};
/*
0xFE,0xFD,0x00,0xFD,0x01,0x01,0xFE,0xFF,0xFD,0xFF,0x00,0xFF,0xFF,0xFF,0xFE,0x00,
0xFF,0x00,0xFF,0x00,0xFF,0x00,0xFF,0x00,0xFF,0x7F };
*/
////////////////////////////////////////////////////////////////////////////////


















////////////////////////////////////////////////////////////////////////////////
const char MagicWave[] PROGMEM = {
0xFF,0x00,0xFC,0x00,0xFD,0xFF,0xFE,0x01,0xFE,0x00,0xFF,0xFE,0x00,0xFF,0x00,0xFF,
0x00,0xFF,0x00,0xFF,0x00,0xFF,0xFF,0xFF,0xFF,0x00,0x09,0x0A,0x09,0x09,0x07,0x03,
0xFE,0xFA,0xF5,0xF4,0xFB,0x07,0x07,0xF9,0xF4,0xFB,0x00,0x00,0xFB,0xF6,0xF6,0xFD,
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0xFF,0xFF,0xFE,0x03,0x00,0x00,0x00,0xFD,0x02,0x02,0x01,0x01,0xFC,0x00,

/*0x02,0x02,
0x02,0xFC,0xFC,0x04,0x04,0x02,0xFD,0xFA,0xFE,0x04,0x05,0xFD,0xFC,0xFF,0x03,0x06,
0xFE,0xF9,0xFA,0x04,0x07,0x02,0xFC,0xF8,0x02,0x08,0x02,0xF9,0xF7,0x01,0x08,0x09,
0xFB,0xF5,0xFF,0x09,0x07,0xFA,0xF5,0xFB,0x0A,0x0D,0xFC,0xF5,0xFA,0x07,0x0A,0xFF,
0xF4,0xF7,0x0A,0x0C,0x01,0xF5,0xF5,0x03,0x0B,0x05,0xF5,0xF7,0x04,0x0A,0x07,0xF8,
0xF3,0xFE,0x0B,0x08,0xFB,0xF7,0xFC,0x09,0x0A,0xFD,0xF3,0xF8,0x07,0x0A,0x03,0xF7,
0xF6,0x05,0x0B,0x03,0xF5,0xF6,0x02,0x0C,0x09,0xF7,0xF5,0x00,0x0A,0x07,0xFA,0xF5,
0xFD,0x0C,0x0A,0xFB,0xF6,0xFB,0x07,0x08,0xFF,0xF6,0xFA,0x04,0x08,0xFF,0xFE,0xFC,
0x02,0x08,0x01,0xF9,0xF9,0x01,0x06,0x03,0xFB,0xF9,0xFF,0x06,0x0A,0xFD,0xFA,0xFE,
0x03,0x03,0xFE,0xFB,0xFD,0x02,0x02,0x00,0xFB,0x00,0x06,0x01,0x00,0xFD,0xFE,0x00,
0x01,0x00,0xFF,0xFF,0xFF,0x00,0xFE,0x04,0x04,0xFE,0xFF,0xFE,0x00,0x01,0x00,

0xFE,
0xFE,0x00,0x02,0x01,0xFD,0x02,0x01,0x02,0x03,0xFD,0xFB,0xFE,0x04,0x03,0xFE,0xF9,
0xFD,0x03,0x07,0x05,0xF9,0xFB,0x03,0x07,0x01,0xF8,0xFA,0x02,0x08,0x02,0xF9,0xF6,
0x04,0x0E,0x03,0xFA,0xF5,0xFF,0x08,0x08,0xFD,0xF7,0xF7,0x03,0x06,0x04,0x03,0x00,
0xFA,0xFB,0x04,0x04,0x06,0xFE,0xF9,0xFA,0xFC,0x05,0x05,0x05,0xFE,0xF9,0xFA,0xFC,
0x07,0x0D,0x04,0xFD,0xF9,0xFA,0xFE,0x05,0x05,0x03,0xFD,0xFA,0xFA,0xFF,0x04,0x05,
0x02,0xFC,0xFC,0x03,0x00,0x04,0x05,0x01,0xFC,0xF9,0xFC,0x00,0x05,0x05,0x00,0xFD,
0xF9,0xFD,0x00,0x04,0x06,0x07,0xFD,0xF9,0xFE,0x00,0x05,0x03,0xFF,0xFA,0xFA,0x00,
0x00,0x05,0xFF,0xFF,0xFA,0xFA,0xFF,0x08,0x05,0xFF,0x00,0xFA,0xFB,0x00,0x00,0x05,
0x00,0x00,0xFA,0xFF,0xFF,0xFF,0x05,0xFF,0xFF,0x03,0xFF,0x00,0x00,0x04,0x00,0x00,
0xFA,0xFF,0xFF,0xFF,0x00,0xFF,0xFF,0xFA,0xFF,0xFF,0xFF,0x00,0xFF,0x00,0x03,0x08,
0x00,0x00,0x00,0xFF,0xFF,0xFE,0xFF,0xFF,0x00,0xFF,0xFF,0xFF,0xFF,0xFF,0xFF,0x00,
0x00,0x00,0x00,0x00,0xFF,0x08,0xFE,0xFF,0x00,0xFF,0x00,0x00,0x00,0xFD,0x00,0x00,
0xFF,0x00,0x00,0xFF,0xFE,0x00,0xFF,0x03,0xFF,0xFF,0xFF,0x08,0xFF,0x00,0x05,0x00,
0x00,0x00,0xFF,0x00,0x00,0x06,0x00,0x00,0xFD,0xFF,0xFF,0xFF,0x05,0xFF,0xFF,0xFA,
0x00,0x08,0x08,0x05,0x00,0x00,0xFA,0x00,0x00,0x01,0x05,0x00,0x00,0xFA,0x00,0x00,
0x05,0x05,0xFF,0x00,0xFA,0x00,0xFF,0x06,0x0D,0xFF,0xFF,0xFA,0xFF,0x00,0x05,0x05,
0x00,0xFA,0xFA,0xFF,0x00,0x05,0x05,0x00,0xFA,0xFA,0x00,0x01,0x81 
*/
};



const char CrashWave[] PROGMEM = {
0xF5,0x13,0x41,0xC7,0x7F,0xB9,0x3B,0xD8,0x39,0x85,0x2C,0xBA,0xEC,0xFD,0x21,0xBA,
0x5A,0x2B,0xDD,0x1C,0x7F,0xDF,0x14,0xE2,0x35,0xD7,0x80,0x9B,0x80,0x94,0xB7,0x7A,
0x0A,0xD9,0x6A,0x9F,0x9A,0xE6,0x7C,0x34,0x92,0x81,0x81,0x83,0x8A,0x8E,0x80,0x89,
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0xF8,0xF7,0xF8,0xF8,0xF9,0xFB,0xFE,0x00,0x01,0x03,0x05,0x06,0x05,0x03,0x01,0x00
};


