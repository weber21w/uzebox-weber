const char GridTiles[] PROGMEM = {
0b11111111,
0b10000000,
0b10000000,
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0b00000000,
};

//CAREFUL, THIS DATA MUST BE FORMATTED FOR COLOR LOOKUP TABLE IN UpdateMagicRamTiles()
//don't change
//Could save a couple bytes(384 @4bpp - codespace...like 10 bytes) NOT WORTH IT STOP THINKING ABOUT IT!!!!

const char MagicPallet[] PROGMEM = {
0x00,0xFF,0x03,0x07,0xA7,0x06,//red
0x00,0xFF,0x16,0x27,0x77,0x17,//orange
0x00,0xFF,0x13,0x2F,0x3F,0x1D,//yellow
0x00,0xFF,0x10,0x78,0xB0,0x28,//green
0x00,0xFF,0x88,0xE1,0xF0,0xD1,//blue
0x00,0xFF,0x42,0xC6,0xDF,0x84,//purple
};

const char MagicTiles[] PROGMEM = {
/* tile 195 */

  0x00,0x00,0x00,0x00,0x00,0x00,0x00,0x02,
  0x00,0x00,0x00,0x00,0x00,0x00,0x02,0x03,
  0x00,0x00,0x00,0x00,0x00,0x00,0x02,0x04,
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  0x00,0x00,0x00,0x02,0x04,0x01,0x03,0x05,
/* tile 196 */

  0x02,0x00,0x00,0x00,0x00,0x00,0x00,0x00,
  0x03,0x02,0x00,0x00,0x00,0x00,0x00,0x00,
  0x04,0x02,0x00,0x00,0x00,0x00,0x00,0x00,
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  0x05,0x03,0x01,0x04,0x02,0x00,0x00,0x00,
/* tile 197 */

  0x00,0x00,0x00,0x02,0x01,0x01,0x04,0x01,
  0x00,0x00,0x02,0x04,0x05,0x03,0x04,0x01,
  0x00,0x00,0x02,0x04,0x05,0x01,0x03,0x05,
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  0x00,0x02,0x02,0x02,0x02,0x02,0x02,0x02,
/* tile 198 */

  0x01,0x04,0x01,0x01,0x02,0x00,0x00,0x00,
  0x01,0x04,0x03,0x05,0x04,0x02,0x00,0x00,
  0x05,0x03,0x01,0x05,0x04,0x02,0x00,0x00,
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  0x02,0x02,0x02,0x02,0x02,0x02,0x02,0x00,
/* tile 199 */

  0x00,0x00,0x00,0x00,0x00,0x02,0x02,0x02,
  0x00,0x01,0x04,0x02,0x02,0x04,0x04,0x04,
  0x00,0x04,0x02,0x04,0x04,0x03,0x04,0x04,
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  0x02,0x04,0x04,0x04,0x04,0x01,0x01,0x01,
/* tile 200 */

  0x02,0x02,0x02,0x00,0x00,0x00,0x00,0x00,
  0x01,0x01,0x01,0x02,0x02,0x04,0x01,0x00,
  0x01,0x01,0x03,0x04,0x04,0x02,0x04,0x00,
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  0x01,0x01,0x01,0x04,0x04,0x01,0x01,0x02,
/* tile 201 */

  0x02,0x01,0x01,0x04,0x04,0x01,0x01,0x01,
  0x02,0x01,0x04,0x03,0x05,0x01,0x01,0x01,
  0x02,0x04,0x03,0x04,0x01,0x05,0x01,0x01,
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  0x00,0x00,0x00,0x00,0x00,0x02,0x02,0x02,
/* tile 202 */

  0x04,0x01,0x01,0x04,0x04,0x04,0x04,0x02,
  0x04,0x04,0x01,0x05,0x03,0x03,0x03,0x02,
  0x04,0x04,0x05,0x01,0x04,0x05,0x05,0x02,
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  0x02,0x02,0x02,0x00,0x00,0x00,0x00,0x00,
/* tile 203 */

  0x00,0x02,0x02,0x02,0x02,0x02,0x02,0x02,
  0x02,0x01,0x04,0x04,0x03,0x02,0x03,0x04,
  0x02,0x04,0x01,0x01,0x01,0x03,0x04,0x01,
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  0x00,0x00,0x00,0x02,0x01,0x01,0x04,0x01,
/* tile 204 */

  0x02,0x02,0x02,0x02,0x02,0x02,0x02,0x00,
  0x04,0x03,0x02,0x03,0x04,0x04,0x01,0x02,
  0x01,0x04,0x03,0x01,0x01,0x01,0x04,0x02,
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  0x01,0x04,0x01,0x01,0x02,0x00,0x00,0x00,
/* tile 205 */

  0x00,0x00,0x00,0x02,0x04,0x01,0x03,0x05,
  0x00,0x00,0x00,0x00,0x02,0x01,0x05,0x04,
  0x00,0x00,0x00,0x00,0x02,0x03,0x03,0x01,
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  0x00,0x00,0x00,0x00,0x00,0x00,0x00,0x02,
/* tile 206 */

  0x05,0x03,0x01,0x04,0x02,0x00,0x00,0x00,
  0x04,0x05,0x01,0x02,0x00,0x00,0x00,0x00,
  0x01,0x03,0x03,0x02,0x00,0x00,0x00,0x00,
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  0x02,0x00,0x00,0x00,0x00,0x00,0x00,0x00,
};