const char ColumnsTiles[] PROGMEM ={

/* tile 0 */

  0x00,0x00,0x00,0x00,0x00,0x00,0x00,0x00,
  0x00,0x00,0x00,0x00,0x00,0x00,0x00,0x00,
  0x00,0x00,0x00,0x00,0x00,0x00,0x00,0x00,
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  0x00,0x00,0x00,0x00,0x00,0x00,0x00,0x00,
/* tile 1 */

  0x02,0x02,0x02,0x02,0x02,0x02,0x02,0x02,
  0x0B,0x0B,0x0B,0x0B,0x0B,0x0B,0x0B,0x0B,
  0x64,0x64,0x64,0x64,0x64,0x64,0x64,0x64,
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  0x14,0x14,0x14,0x14,0x14,0x14,0x14,0x14,
/* tile 2 */

  0x13,0x13,0x0A,0x0A,0x13,0x13,0x0A,0x0A,
  0x13,0x13,0x0A,0x0A,0x13,0x13,0x0A,0x0A,
  0x0A,0x0A,0x13,0x13,0x0A,0x0A,0x13,0x13,
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  0x0A,0x0A,0x13,0x13,0x0A,0x0A,0x13,0x13,
/* tile 3 */

  0x13,0x13,0x0A,0x0A,0x13,0x13,0x0A,0x0A,
  0x13,0x13,0x0A,0x0A,0x13,0x13,0x0A,0x0A,
  0x0A,0x0A,0x13,0x13,0x0A,0x0A,0x13,0x13,
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  0x0A,0x0A,0x13,0x5B,0x64,0x64,0x5B,0x5B,
/* tile 4 */

  0x13,0x13,0x0A,0x0A,0x13,0x5B,0x64,0x64,
  0x13,0x13,0x64,0x64,0x5B,0x5B,0x64,0x64,
  0x64,0x64,0x5B,0x5B,0x64,0x64,0x5B,0x5B,
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  0x64,0x64,0x5B,0x5B,0x0A,0x0A,0x5B,0x5B,
/* tile 5 */

  0x5B,0x5B,0x64,0x64,0x13,0x13,0x0A,0x0A,
  0x5B,0x5B,0x64,0x64,0x5B,0x5B,0x0A,0x0A,
  0x64,0x64,0x5B,0x5B,0x64,0x64,0x5B,0x13,
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  0x64,0x0A,0x13,0x13,0x0A,0x64,0x5B,0x5B,
/* tile 6 */

  0x13,0x13,0x0A,0x0A,0x13,0x13,0x0A,0x0A,
  0x13,0x13,0x0A,0x0A,0x13,0x13,0x0A,0x0A,
  0x0A,0x0A,0x13,0x13,0x0A,0x0A,0x13,0x13,
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  0x64,0x64,0x5B,0x5B,0x64,0x64,0x5B,0x5B,
/* tile 7 */

  0x13,0x13,0x64,0x64,0x5B,0x5B,0x64,0x64,
  0x13,0x13,0x64,0x64,0x5B,0x5B,0x64,0x64,
  0x0A,0x64,0x5B,0x5B,0x64,0x64,0x5B,0x5B,
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  0x64,0x64,0x5B,0x5B,0x64,0x64,0x5B,0x5B,
/* tile 8 */

  0x5B,0x5B,0x64,0x64,0x13,0x13,0x64,0x64,
  0x5B,0x5B,0x64,0x64,0x13,0x13,0x64,0x64,
  0x64,0x64,0x5B,0x5B,0x64,0x0A,0x13,0x5B,
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  0x64,0x64,0x5B,0x5B,0x64,0x64,0x5B,0x5B,
/* tile 9 */

  0x5B,0x13,0x0A,0x0A,0x5B,0x5B,0x64,0x0A,
  0x5B,0x5B,0x64,0x64,0x5B,0x5B,0x64,0x0A,
  0x64,0x64,0x5B,0x5B,0x64,0x64,0x13,0x13,
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  0x64,0x64,0x5B,0x5B,0x64,0x64,0x5B,0x5B,
/* tile 10 */

  0x14,0x14,0x14,0x14,0x14,0x14,0x14,0x14,
  0x14,0x14,0x14,0x14,0x14,0x14,0x14,0x14,
  0x64,0x64,0x64,0x64,0x64,0x64,0x64,0x64,
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  0x00,0x00,0x00,0x00,0x00,0x00,0x00,0x00,
/* tile 11 */

  0x03,0x02,0x02,0x02,0x02,0x02,0x02,0x00,
  0x5C,0x5B,0x5B,0x53,0x53,0x12,0x02,0x00,
  0x02,0x02,0x03,0x02,0x02,0x02,0x02,0x01,
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  0x02,0x13,0x02,0x00,0x00,0x00,0x00,0x00,
/* tile 12 */

  0x03,0x5C,0x02,0x00,0x02,0x02,0x02,0x02,
  0x02,0x5B,0x02,0x00,0x02,0x12,0x53,0x13,
  0x02,0x5B,0x03,0x00,0x02,0x02,0x02,0x02,
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  0x00,0x00,0x01,0x00,0x00,0x00,0x00,0x00,
/* tile 13 */

  0xE5,0xE5,0xE5,0xF7,0x8A,0x93,0xE5,0xDC,
  0xE5,0xE5,0xE5,0xE5,0xF7,0x8A,0x93,0xDC,
  0xDC,0xEE,0xE5,0xDC,0xE5,0xF7,0x8A,0x93,
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  0x93,0xDC,0xE5,0x8A,0xF7,0xEE,0xE5,0xE5,
/* tile 14 */

  0x93,0xDC,0x93,0x8A,0xE5,0xDC,0xDC,0xDC,
  0x93,0x93,0x8A,0xE5,0xDC,0xDC,0x93,0xE5,
  0x93,0x8A,0xE5,0xDC,0xDC,0xDC,0xDC,0xDC,
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  0xE5,0xE5,0xF7,0x8A,0x8A,0xF7,0xDC,0xE5,
/* tile 15 */

  0x93,0x8A,0xE5,0x8A,0x8A,0x93,0xDC,0xDC,
  0x93,0x93,0x8A,0xDC,0xE5,0x8A,0x93,0xDC,
  0x93,0x8A,0xDC,0x93,0xE5,0xE5,0x8A,0x93,
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  0xDC,0x93,0xDC,0x93,0x8A,0xF7,0xE5,0xE5,
/* tile 16 */

  0xE5,0xDC,0x93,0x8A,0x8A,0x93,0xDC,0xDC,
  0xDC,0x93,0x8A,0xF7,0xF7,0x8A,0x93,0xDC,
  0x93,0x8A,0xF7,0xE5,0xE5,0xF7,0x8A,0x93,
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  0xDC,0xDC,0xE5,0x8A,0xDC,0xE5,0xEE,0xE5,
/* tile 17 */

  0xDC,0xDC,0xDC,0xE5,0x8A,0xDC,0xE5,0xE5,
  0xDC,0x93,0xDC,0xDC,0xE5,0x8A,0xDC,0xDC,
  0xDC,0xDC,0xE5,0xDC,0xDC,0xE5,0x8A,0xDC,
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  0x93,0x93,0x8A,0x8A,0x8A,0xE5,0xE5,0xE5,
/* tile 18 */

  0xDC,0xDC,0x93,0x8A,0xF7,0xE5,0xE5,0xE5,
  0xDC,0x93,0x8A,0xF7,0xE5,0xEE,0xE5,0xEE,
  0x93,0x8A,0xF7,0xE5,0xDC,0xE5,0xE5,0xDC,
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  0xE5,0xE5,0xDC,0x8A,0x93,0xE5,0xDC,0xDC,
/* tile 19 */

  0xE5,0xDC,0x93,0x8A,0x8A,0x93,0xDC,0xE5,
  0xDC,0x93,0x8A,0xF7,0xF7,0x8A,0x93,0xDC,
  0x93,0x8A,0xF7,0xE5,0xE5,0xF7,0x8A,0x93,
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  0xDC,0xEE,0xE5,0xDC,0x8A,0xDC,0xDC,0xDC,
/* tile 20 */

  0xE5,0xE5,0x93,0x8A,0x8A,0xDC,0xDC,0xDC,
  0xDC,0x93,0x8A,0xDC,0xE5,0x8A,0xDC,0x93,
  0x93,0x8A,0xDC,0xDC,0xDC,0xE5,0x8A,0xDC,
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  0xDC,0xE5,0xDC,0x8A,0x93,0xDC,0xDC,0xDC,
/* tile 21 */

  0xDC,0xDC,0xDC,0xE5,0x8A,0xDC,0xE5,0xE5,
  0xDC,0x93,0xDC,0xDC,0xE5,0x8A,0xDC,0xDC,
  0xDC,0xDC,0xE5,0xDC,0xDC,0xE5,0x8A,0xDC,
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  0xE5,0x93,0x8A,0x8A,0x8A,0xE5,0xE5,0xE5,
/* tile 22 */

  0x93,0xDC,0x93,0x8A,0xE5,0xDC,0xDC,0xDC,
  0x93,0x93,0x8A,0xE5,0xDC,0xDC,0x93,0xE5,
  0xDC,0x8A,0xE5,0xDC,0xDC,0xDC,0xDC,0xDC,
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  0xE5,0xE5,0xF7,0x8A,0x8A,0xF7,0xDC,0xE5,
/* tile 23 */

  0x52,0x52,0x52,0x52,0x52,0x52,0x52,0x52,
  0x52,0x00,0x00,0x00,0x00,0x00,0x00,0x00,
  0x52,0x00,0x00,0x00,0x00,0x00,0x00,0x00,
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  0x52,0x00,0x00,0x00,0x00,0x00,0x00,0x00,
/* tile 24 */

  0x52,0x52,0x52,0x52,0x52,0x52,0x52,0x00,
  0x00,0x00,0x00,0x00,0x00,0x00,0x00,0x00,
  0x00,0x00,0x00,0x00,0x00,0x00,0x00,0x00,
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  0x00,0x00,0x00,0x00,0x00,0x00,0x00,0x00,
/* tile 25 */

  0x52,0x00,0x00,0x00,0x00,0x00,0x00,0x00,
  0x52,0x00,0x00,0x00,0x00,0x00,0x00,0x00,
  0x52,0x00,0x00,0x00,0x00,0x00,0x00,0x00,
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  0x00,0x00,0x00,0x00,0x00,0x00,0x00,0x00,
/* tile 26 */

  0x00,0x00,0x00,0x00,0x00,0x00,0x00,0x00,
  0x00,0x00,0x00,0x00,0x04,0x04,0x04,0x04,
  0x00,0x00,0x00,0x04,0x0F,0xFF,0xFF,0xA7,
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  0x00,0x04,0x03,0x04,0x0F,0x0F,0x04,0x04,
/* tile 27 */

  0x00,0x00,0x00,0x00,0x00,0x00,0x00,0x00,
  0x04,0x04,0x04,0x04,0x00,0x00,0x00,0x00,
  0x04,0x04,0x03,0x03,0x04,0x00,0x00,0x00,
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  0x04,0x0F,0x0F,0x0F,0x04,0x04,0x04,0x00,
/* tile 28 */

  0x00,0x04,0x03,0x03,0x04,0x04,0x04,0x04,
  0x00,0x04,0x03,0x03,0x03,0x03,0x04,0x04,
  0x00,0x04,0x04,0x03,0x03,0x03,0x04,0x04,
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  0x00,0x00,0x00,0x00,0x04,0x04,0x04,0x04,
/* tile 29 */

  0x04,0x0F,0x0F,0x0F,0x04,0x04,0x04,0x00,
  0x04,0x0F,0x0F,0x0F,0x04,0x04,0x04,0x00,
  0x04,0x0F,0x0F,0xA7,0x04,0x04,0x04,0x00,
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  0x04,0x04,0x04,0x04,0x00,0x00,0x00,0x00,
/* tile 30 */

  0x00,0x00,0x00,0x00,0x00,0x00,0x00,0x27,
  0x00,0x00,0x00,0x00,0x00,0x0F,0x27,0x77,
  0x00,0x00,0x00,0x0F,0x0F,0xFF,0xFF,0x27,
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  0x00,0x0F,0x27,0x0F,0x04,0x04,0x04,0x04,
/* tile 31 */

  0x27,0x00,0x00,0x00,0x00,0x00,0x00,0x00,
  0x27,0x27,0x27,0x00,0x00,0x00,0x00,0x00,
  0x0F,0x27,0x27,0x27,0x27,0x00,0x00,0x00,
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  0x0F,0x27,0x27,0x27,0x27,0x77,0x0F,0x00,
/* tile 32 */

  0x00,0x0F,0x27,0x0F,0x0F,0x0F,0x0F,0x0F,
  0x00,0x0F,0x27,0x0F,0x0F,0x27,0x27,0x0F,
  0x00,0x0F,0x27,0x0F,0x0F,0x27,0x77,0x0F,
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  0x00,0x00,0x00,0x00,0x00,0x00,0x00,0x04,
/* tile 33 */

  0x04,0x04,0x04,0x04,0x0F,0x77,0x0F,0x00,
  0x04,0x04,0x04,0x04,0x0F,0x77,0x0F,0x00,
  0x04,0x04,0x04,0x0F,0x0F,0x27,0x0F,0x00,
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  0x04,0x00,0x00,0x00,0x00,0x00,0x00,0x00,
/* tile 34 */

  0x00,0x00,0x00,0x00,0x00,0x00,0x00,0x00,
  0x00,0x00,0x00,0x26,0x37,0x37,0xB6,0xB6,
  0x00,0x00,0x26,0x3F,0x3F,0x26,0x26,0x26,
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  0x00,0x26,0x1E,0x1E,0x26,0x1E,0x1E,0x1E,
/* tile 35 */

  0x00,0x00,0x00,0x00,0x00,0x00,0x00,0x00,
  0xFF,0xFF,0xFF,0xB6,0x26,0x00,0x00,0x00,
  0x26,0x37,0x3F,0xFF,0xB6,0x26,0x00,0x00,
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  0x26,0x26,0x26,0x1E,0x1E,0x1E,0x26,0x00,
/* tile 36 */

  0x00,0x26,0x1E,0x26,0x26,0x1E,0x1E,0x1E,
  0x00,0x26,0x26,0x37,0x26,0x1E,0x1E,0x1E,
  0x00,0x26,0x37,0x3F,0x26,0x26,0x1E,0x1E,
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  0x00,0x00,0x00,0x26,0x26,0x26,0x26,0x26,
/* tile 37 */

  0x1E,0x1E,0x26,0x1E,0x26,0x1E,0x26,0x00,
  0x1E,0x1E,0x26,0x1E,0x26,0x1E,0x26,0x00,
  0x1E,0x1E,0x26,0x1E,0x26,0x26,0x26,0x00,
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  0x26,0x26,0x26,0x26,0x26,0x00,0x00,0x00,
/* tile 38 */

  0x00,0x00,0x00,0x00,0x00,0x00,0x00,0x00,
  0x00,0x00,0x00,0x21,0x21,0x21,0x21,0x21,
  0x00,0x00,0x21,0xB9,0x18,0x21,0x30,0x30,
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  0x00,0xB9,0x21,0x21,0xFF,0x18,0x18,0x18,
/* tile 39 */

  0x00,0x00,0x00,0x00,0x00,0x00,0x00,0x00,
  0x30,0x30,0x30,0x21,0x21,0x00,0x00,0x00,
  0xB9,0x30,0x21,0x30,0xB9,0x21,0x00,0x00,
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  0x21,0x30,0x21,0x30,0x21,0x18,0x30,0x00,
/* tile 40 */

  0x00,0xB9,0x30,0x21,0xB9,0x18,0x18,0x18,
  0x00,0x30,0xF0,0x21,0xB9,0x18,0x18,0x21,
  0x00,0x30,0xF0,0x21,0xF0,0x21,0x18,0x18,
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  0x00,0x00,0x00,0x21,0x21,0x30,0x30,0xB9,
/* tile 41 */

  0x21,0x30,0x21,0x30,0x21,0x21,0x30,0x00,
  0x21,0x21,0x18,0x30,0x21,0x21,0x30,0x00,
  0x18,0x18,0x21,0xB9,0x21,0x21,0x30,0x00,
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  0xF0,0xB9,0x30,0x21,0x21,0x00,0x00,0x00,
/* tile 42 */

  0x00,0x00,0x00,0x00,0x00,0x00,0x00,0x00,
  0x00,0x00,0xD9,0xFF,0xF0,0xF0,0xE3,0xE3,
  0x00,0xD9,0xFF,0xD9,0xD9,0xE3,0xE3,0xD9,
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  0x00,0xD9,0xE3,0xF0,0xF0,0xE3,0xF4,0xD9,
/* tile 43 */

  0x00,0x00,0x00,0x00,0x00,0x00,0x00,0x00,
  0xE3,0xE3,0xF0,0xF0,0xFF,0xD9,0x00,0x00,
  0xD9,0xD9,0xE3,0xE3,0xE3,0xFF,0xD9,0x00,
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  0xE3,0xD9,0xF4,0xE3,0xF0,0xE3,0xD9,0x00,
/* tile 44 */

  0x00,0xD9,0xD9,0xE3,0xF0,0xE3,0xF0,0xD9,
  0x00,0xD9,0x48,0xD9,0xF0,0xE3,0xE3,0xD9,
  0x00,0xD9,0x48,0x48,0xD9,0xD9,0xE3,0xD9,
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  0x00,0x00,0xE3,0xE3,0xE3,0xE3,0xE3,0xE3,
/* tile 45 */

  0xD9,0xD9,0xF0,0xE3,0xF0,0xE3,0xD9,0x00,
  0xD9,0xD9,0xF0,0xE3,0xE3,0xD9,0xD9,0x00,
  0xD9,0xD9,0xF0,0xE3,0xD9,0x48,0xD9,0x00,
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  0xE3,0xE3,0xE3,0xE3,0xE3,0xE3,0x00,0x00,
/* tile 46 */

  0x00,0x00,0x00,0x00,0x00,0x00,0x00,0x00,
  0x00,0x00,0x00,0x84,0x84,0xCF,0xE7,0xE7,
  0x00,0x00,0x00,0x84,0x84,0xCF,0x43,0xFF,
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  0x84,0x43,0x43,0xFF,0x43,0x84,0x84,0x84,
/* tile 47 */

  0x00,0x00,0x00,0x00,0x00,0x00,0x00,0x00,
  0xE7,0xE7,0xCF,0x84,0x84,0x00,0x00,0x00,
  0xFF,0xFF,0x43,0x43,0x84,0x00,0x00,0x00,
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  0xCF,0xCF,0xE7,0x84,0x84,0x43,0x43,0x84,
/* tile 48 */

  0x84,0x43,0x43,0xFF,0x43,0xCF,0x84,0x84,
  0x84,0x43,0x43,0xFF,0x43,0xCF,0x84,0x84,
  0x00,0x84,0x43,0xE6,0x43,0xE7,0xCF,0x84,
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  0x00,0x00,0x00,0x84,0x84,0x84,0x84,0x84,
/* tile 49 */

  0x84,0x84,0xCF,0x84,0x84,0x43,0x43,0x84,
  0x84,0x84,0xCF,0x84,0x84,0x43,0x43,0x84,
  0x84,0x84,0xCF,0x84,0x84,0x43,0x84,0x00,
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  0x84,0x84,0x84,0x84,0x84,0x00,0x00,0x00,
/* tile 50 */

  0x52,0x52,0x52,0x52,0x52,0x52,0x52,0x52,
  0x52,0x00,0x00,0x00,0x00,0x00,0x00,0x00,
  0x52,0x00,0x00,0x00,0x00,0x00,0x00,0x00,
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  0x52,0x00,0x37,0x00,0x00,0x00,0x37,0x3F,
/* tile 51 */

  0x52,0x52,0x52,0x52,0x52,0x52,0x52,0x00,
  0x00,0x00,0x00,0x00,0x00,0x00,0x00,0x00,
  0x37,0x00,0x00,0x00,0x00,0x00,0x00,0x00,
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  0x3F,0x37,0xFF,0x00,0x00,0x00,0x00,0x00,
/* tile 52 */

  0x52,0x00,0x00,0x00,0x00,0xFF,0x37,0x3F,
  0x52,0x00,0x00,0x00,0x00,0x00,0x00,0x37,
  0x52,0x00,0x00,0x00,0x00,0x00,0x3F,0x00,
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  0x00,0x00,0x00,0x00,0x00,0x00,0x00,0x00,
/* tile 53 */

  0x3F,0x37,0x00,0x00,0x00,0x37,0x00,0x00,
  0x37,0x00,0x3F,0x00,0x00,0x00,0x00,0x00,
  0xFF,0x00,0x00,0x00,0x00,0x00,0x00,0x00,
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  0x00,0x00,0x00,0x00,0x00,0x00,0x00,0x00,
/* tile 54 */

  0xFF,0x52,0x52,0x52,0x52,0x52,0x52,0x52,
  0x52,0x00,0x3F,0x00,0x00,0x00,0x00,0x00,
  0x52,0x00,0x00,0x00,0x00,0x00,0x00,0x00,
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  0x3F,0x00,0x00,0x00,0x00,0x0F,0x00,0x0F,
/* tile 55 */

  0x3F,0x52,0x52,0x52,0x52,0x52,0x52,0xFF,
  0x00,0x00,0x00,0x00,0x00,0x00,0x00,0x00,
  0x00,0x00,0x00,0x00,0x00,0x00,0x3F,0x00,
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  0x0F,0x00,0x00,0x37,0x00,0x00,0x00,0x00,
/* tile 56 */

  0x52,0x00,0x00,0x00,0x37,0x00,0x00,0x0F,
  0x52,0x00,0x00,0x00,0x00,0x00,0xFF,0x00,
  0x52,0x00,0x00,0x3F,0x00,0x0F,0x00,0x0F,
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  0xFF,0x00,0x00,0x00,0x00,0x00,0x00,0x3F,
/* tile 57 */

  0x0F,0x00,0x0F,0x00,0x00,0x00,0x00,0x3F,
  0x00,0xFF,0x00,0x00,0x00,0x00,0x00,0x00,
  0x00,0x00,0x0F,0x00,0x37,0x00,0x00,0x00,
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  0x00,0x00,0x00,0x00,0x00,0x00,0x00,0xFF,
/* tile 58 */

  0xA7,0x0F,0xA7,0x52,0xA7,0x52,0x52,0x52,
  0x0F,0x00,0x00,0x37,0x00,0x00,0x00,0x00,
  0xA7,0x00,0x00,0x00,0x00,0x0F,0x00,0x00,
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  0x0F,0x00,0x00,0x00,0x00,0x00,0x2E,0x0F,
/* tile 59 */

  0x0F,0x52,0x52,0xA7,0x52,0xA7,0x0F,0xA7,
  0x00,0x00,0x00,0x00,0x37,0x00,0x00,0x0F,
  0x00,0x00,0x0F,0x00,0x00,0x00,0x00,0xA7,
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  0x0F,0x37,0x00,0x00,0xFF,0x00,0x00,0x00,
/* tile 60 */

  0x52,0x00,0x00,0xFF,0x00,0x00,0x37,0x0F,
  0x52,0x00,0x00,0x00,0x00,0xFF,0x00,0x2E,
  0x52,0x00,0x0F,0x00,0x00,0x00,0x00,0x00,
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  0xA7,0x0F,0xA7,0x00,0xA7,0x00,0x00,0x0F,
/* tile 61 */

  0x0F,0x2E,0x00,0x00,0x00,0x00,0x00,0x0F,
  0x37,0x00,0x00,0xFF,0x00,0x00,0x00,0x00,
  0x00,0xFF,0x00,0x00,0x00,0x0F,0x00,0x00,
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  0x00,0x00,0x00,0xA7,0x00,0xA7,0x0F,0xA7,
/* tile 62 */

  0x0F,0x52,0x52,0x0F,0x52,0x52,0x52,0x52,
  0x52,0xA7,0x00,0x00,0x00,0x00,0x00,0x00,
  0x52,0x00,0xE2,0x00,0x00,0x00,0x00,0xE2,
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  0xA7,0x00,0x00,0x00,0x00,0x00,0xFD,0x00,
/* tile 63 */

  0xA7,0x52,0x52,0x52,0x0F,0x52,0x52,0x0F,
  0x00,0x00,0x00,0x00,0x00,0x00,0xA7,0x00,
  0x00,0x00,0x00,0x00,0x00,0xE2,0x00,0x00,
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  0x00,0x00,0x00,0x00,0x00,0xE2,0x00,0x00,
/* tile 64 */

  0x52,0x00,0xE2,0x00,0x00,0x00,0x00,0x00,
  0x52,0x00,0x00,0x00,0x00,0xF0,0x00,0xFD,
  0x52,0x00,0x00,0xFF,0x00,0x00,0xE2,0x00,
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  0x0F,0x00,0x00,0x0F,0x00,0x00,0x00,0xA7,
/* tile 65 */

  0x00,0xFD,0x00,0x00,0x00,0x00,0x00,0xA7,
  0x00,0x00,0xE2,0x00,0x00,0x00,0x00,0x00,
  0x00,0xF0,0x00,0x00,0xFF,0x00,0x00,0x00,
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  0x00,0x00,0x00,0x00,0x0F,0x00,0x00,0x0F,
/* tile 66 */

  0x2E,0x52,0xFF,0x52,0x37,0x52,0x52,0x52,
  0x52,0x00,0x00,0x00,0x00,0x00,0x00,0xE2,
  0xFF,0x00,0xFD,0x00,0xE2,0x00,0x00,0x00,
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  0x52,0x00,0x00,0x00,0x00,0x00,0x00,0x00,
/* tile 67 */

  0x52,0x52,0x52,0x37,0x52,0xFF,0x52,0x2E,
  0x00,0x00,0x00,0x00,0x00,0x00,0x00,0x00,
  0x00,0x00,0x00,0xE2,0x00,0xFD,0x00,0xFF,
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  0x00,0x00,0x00,0x00,0x00,0x00,0xE2,0x00,
/* tile 68 */

  0x52,0xE2,0x00,0x00,0x00,0x00,0x00,0x00,
  0x52,0x00,0x00,0x00,0xF0,0x00,0x00,0x00,
  0x52,0x00,0x00,0x00,0x00,0x00,0x00,0x00,
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  0x2E,0x00,0xFF,0x00,0x37,0x00,0x00,0x00,
/* tile 69 */

  0x00,0x00,0x00,0x00,0x00,0x00,0x00,0x00,
  0x00,0x00,0x00,0xE2,0x00,0x00,0x00,0x00,
  0x00,0x00,0x00,0x00,0x00,0x00,0x00,0x00,
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  0x00,0x00,0x00,0x37,0x00,0xFF,0x00,0x2E,
/* tile 70 */

  0xFF,0x52,0xFD,0x52,0x52,0x52,0x52,0xE2,
  0x52,0x00,0x00,0x00,0xFD,0x00,0x00,0x00,
  0xFD,0x00,0x00,0x00,0x00,0x00,0x00,0x00,
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  0x52,0x00,0x00,0x00,0x00,0x00,0x00,0x00,
/* tile 71 */

  0x52,0x52,0x52,0x52,0x52,0xFD,0x52,0xFF,
  0x00,0x00,0x00,0xE2,0x00,0x00,0x00,0x00,
  0x00,0x00,0x00,0x00,0x00,0x00,0x00,0xFD,
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  0x00,0x00,0x00,0x00,0x00,0x00,0x00,0xE2,
/* tile 72 */

  0xE2,0x00,0x00,0x00,0x00,0x00,0x00,0x00,
  0x52,0x00,0x00,0x00,0x00,0x00,0x00,0x00,
  0x52,0x00,0x00,0x00,0x00,0x00,0x00,0x00,
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  0xFF,0x00,0xFD,0x00,0x00,0x00,0x00,0x00,
/* tile 73 */

  0x00,0x00,0x00,0x00,0x00,0x00,0x00,0x00,
  0x00,0x00,0x00,0x00,0x00,0x00,0x00,0x00,
  0x00,0x00,0x00,0x00,0x00,0x00,0x00,0x00,
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  0xE2,0x00,0x00,0x00,0x00,0xFD,0x00,0xFF,
/* tile 74 */

  0x52,0x52,0x52,0x52,0xF0,0x52,0x52,0x52,
  0x52,0xDA,0x00,0x00,0x00,0x00,0x00,0x00,
  0x52,0x00,0x00,0x00,0x00,0x00,0x00,0x00,
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  0x52,0x00,0x00,0x00,0x00,0x00,0x00,0x00,
/* tile 75 */

  0x52,0x52,0x52,0xF0,0x52,0x52,0x52,0x00,
  0x00,0x00,0x00,0x00,0x00,0x00,0xDA,0x00,
  0x00,0x00,0x00,0x00,0x00,0x00,0x00,0x00,
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  0x00,0x00,0x00,0x00,0x00,0x00,0x00,0x00,
/* tile 76 */

  0x52,0x00,0x00,0x00,0x00,0x00,0x00,0x00,
  0x52,0x00,0x00,0x00,0x00,0x00,0x00,0x00,
  0x52,0x00,0x00,0x00,0x00,0x00,0x00,0x00,
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  0x00,0x00,0x00,0x00,0xF0,0x00,0x00,0x00,
/* tile 77 */

  0x00,0x00,0x00,0x00,0x00,0x00,0x00,0x00,
  0x00,0x00,0x00,0x00,0x00,0x00,0x00,0x00,
  0x00,0x00,0x00,0x00,0x00,0x00,0x00,0x00,
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  0x00,0x00,0x00,0xF0,0x00,0x00,0x00,0x00,
/* tile 78 */

  0x02,0x02,0x02,0x02,0x02,0x02,0x02,0x02,
  0x02,0x04,0x04,0x04,0x04,0x04,0x04,0x04,
  0x02,0x04,0x04,0x04,0x04,0x04,0x04,0x04,
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  0x02,0x04,0x04,0x04,0x04,0x04,0x04,0x04,
/* tile 79 */

  0x02,0x02,0x02,0x02,0x02,0x02,0x02,0x02,
  0x04,0x04,0x04,0x04,0x04,0x04,0x04,0x02,
  0x04,0x04,0x04,0x04,0x04,0x04,0x04,0x02,
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  0x04,0x04,0x04,0x04,0x04,0x04,0x04,0x02,
/* tile 80 */

  0x04,0x04,0x04,0x04,0x04,0x04,0x04,0x04,
  0x04,0x0F,0x0F,0x0F,0x0F,0x0F,0x0F,0x0F,
  0x04,0x07,0x0F,0x0F,0x0F,0x0F,0x0F,0x0F,
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  0x04,0x07,0x07,0x07,0x07,0x07,0x07,0x0F,
/* tile 81 */

  0x04,0x04,0x04,0x04,0x04,0x04,0x04,0x04,
  0x0F,0x0F,0x0F,0x0F,0x0F,0x0F,0x0F,0x04,
  0x0F,0x0F,0x0F,0x0F,0x0F,0x0F,0x07,0x04,
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  0x0F,0x07,0x07,0x07,0x07,0x07,0x07,0x04,
/* tile 82 */

  0x02,0x04,0x04,0x04,0x04,0x04,0x04,0x02,
  0x02,0x04,0x04,0x04,0x04,0x04,0x02,0x02,
  0x02,0x04,0x04,0x04,0x04,0x02,0x02,0x02,
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  0x02,0x02,0x02,0x02,0x02,0x02,0x02,0x02,
/* tile 83 */

  0x02,0x04,0x04,0x04,0x04,0x04,0x04,0x02,
  0x02,0x02,0x04,0x04,0x04,0x04,0x04,0x02,
  0x02,0x02,0x02,0x04,0x04,0x04,0x04,0x02,
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  0x02,0x02,0x02,0x02,0x02,0x02,0x02,0x02,
/* tile 84 */

  0x04,0x07,0x07,0x07,0x07,0x07,0x07,0x04,
  0x04,0x07,0x07,0x07,0x07,0x07,0x04,0x04,
  0x04,0x07,0x07,0x07,0x07,0x04,0x04,0x04,
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  0x04,0x04,0x04,0x04,0x04,0x04,0x04,0x04,
/* tile 85 */

  0x04,0x07,0x07,0x07,0x07,0x07,0x07,0x04,
  0x04,0x04,0x07,0x07,0x07,0x07,0x07,0x04,
  0x04,0x04,0x04,0x07,0x07,0x07,0x07,0x04,
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  0x04,0x04,0x04,0x04,0x04,0x04,0x04,0x04,
/* tile 86 */

  0x8A,0x8A,0x8A,0x8A,0x8A,0x8A,0x8A,0x8A,
  0x8A,0xDC,0xDC,0xDC,0xDC,0xDC,0xDC,0xDC,
  0x8A,0x93,0xDC,0xDC,0xDC,0xDC,0xDC,0xDC,
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  0x8A,0x93,0x93,0x93,0x93,0x93,0x93,0xDC,
/* tile 87 */

  0x8A,0x8A,0x8A,0x8A,0x8A,0x8A,0x8A,0x8A,
  0xDC,0xDC,0xDC,0xDC,0xDC,0xDC,0xDC,0x8A,
  0xDC,0xDC,0xDC,0xDC,0xDC,0xDC,0x93,0x8A,
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  0xDC,0x93,0x93,0x93,0x93,0x93,0x93,0x8A,
/* tile 88 */

  0xDC,0xDC,0xDC,0xDC,0xDC,0xDC,0xDC,0xDC,
  0xDC,0xF7,0xF7,0xF7,0xF7,0xF7,0xF7,0xF7,
  0xDC,0xEE,0xF7,0xF7,0xF7,0xF7,0xF7,0xF7,
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  0xDC,0xEE,0xEE,0xEE,0xEE,0xEE,0xEE,0xF7,
/* tile 89 */

  0xDC,0xDC,0xDC,0xDC,0xDC,0xDC,0xDC,0xDC,
  0xF7,0xF7,0xF7,0xF7,0xF7,0xF7,0xF7,0xDC,
  0xF7,0xF7,0xF7,0xF7,0xF7,0xF7,0xEE,0xDC,
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  0xF7,0xEE,0xEE,0xEE,0xEE,0xEE,0xEE,0xDC,
/* tile 90 */

  0x8A,0x93,0x93,0x93,0x93,0x93,0x93,0x8A,
  0x8A,0x93,0x93,0x93,0x93,0x93,0x8A,0x8A,
  0x8A,0x93,0x93,0x93,0x93,0x8A,0x8A,0x8A,
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  0x8A,0x8A,0x8A,0x8A,0x8A,0x8A,0x8A,0x8A,
/* tile 91 */

  0x8A,0x93,0x93,0x93,0x93,0x93,0x93,0x8A,
  0x8A,0x8A,0x93,0x93,0x93,0x93,0x93,0x8A,
  0x8A,0x8A,0x8A,0x93,0x93,0x93,0x93,0x8A,
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  0x8A,0x8A,0x8A,0x8A,0x8A,0x8A,0x8A,0x8A,
/* tile 92 */

  0xDC,0xEE,0xEE,0xEE,0xEE,0xEE,0xEE,0xDC,
  0xDC,0xEE,0xEE,0xEE,0xEE,0xEE,0xDC,0xDC,
  0xDC,0xEE,0xEE,0xEE,0xEE,0xDC,0xDC,0xDC,
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  0xDC,0xDC,0xDC,0xDC,0xDC,0xDC,0xDC,0xDC,
/* tile 93 */

  0xDC,0xEE,0xEE,0xEE,0xEE,0xEE,0xEE,0xDC,
  0xDC,0xDC,0xEE,0xEE,0xEE,0xEE,0xEE,0xDC,
  0xDC,0xDC,0xDC,0xEE,0xEE,0xEE,0xEE,0xDC,
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  0xDC,0xDC,0xDC,0xDC,0xDC,0xDC,0xDC,0xDC,


};
#include "magictiles.inc"

const char TitleMap[] PROGMEM=
{
    1,  1,  1,  1,  1,  1,
    2,  3,  4,  5,  2,  3,
    6,  7,  8,  9,  6,  7,
   10, 10, 10, 10, 10, 10
};


const char FieldMap[] PROGMEM=
{
      0,  0,  0,  0,  
      0,  0,  0,  0,  
      0,  0,  0,  0,  
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      7, 10, 11,  6,  



};


