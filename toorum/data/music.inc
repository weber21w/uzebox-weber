//-s0 -e38380 -f12 is close...
const char song1[] PROGMEM = {
0x00,0xc0,0x0a,0x00,0xc1,0x0b,0x00,0xc2,0x09,0x00,0xc3,0x0c,0x00,0xb0,0x07,0x69,0x00,0x07,0x77,0x00,0xb1,0x07,0x4a,0x00,0x07,0x59,0x00,0x91,0x3f,0x53,0x00,0xb2,
0x07,0x6f,0x00,0x07,0x77,0x00,0x07,0x73,0x00,0x07,0x7f,0x00,0x92,0x1b,0x53,0x00,0xb3,0x07,0x7f,0x00,0xff,0x06,0x01,0x53,0x13,0x91,0x46,0x53,0x00,0x92,0x22,0x53,
0x09,0x91,0x3f,0x53,0x00,0x92,0x1b,0x53,0x0a,0x91,0x49,0x53,0x00,0x92,0x25,0x53,0x09,0x91,0x46,0x53,0x00,0x92,0x22,0x53,0x0a,0x91,0x4b,0x53,0x00,0x92,0x27,0x53,
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0x49,0x53,0x00,0x92,0x25,0x53,0x00,0xff,0x06,0x01,0x45,0x09,0xff,0x2f,0x00 };


const char song2[] PROGMEM = {
/*


0x00,0xc0,0x13,0x00,0xc1,0x14,0x00,0xc2,0x15,0x00,0xc3,0x00,0x00,0xb0,0x07,0x7f,0x00,0x90,0x1e,0x64,0x00,0xb1,0x07,0x7f,0x00,0x91,0x2a,0x69,0x00,0xb2,0x64,0x00,
0x00,0xb3,0x07,0x7f,0x00,0x07,0x7f,0x00,0x07,0x7f,0x00,0x07,0x7f,0x00,0x93,0x17,0x64,0x00,0xff,0x06,0x01,0x53,0x0e,0x90,0x1e,0x64,0x00,0x93,0x19,0x50,0x07,0x91,
0x2a,0x69,0x00,0x93,0x17,0x64,0x08,0x91,0x2d,0x69,0x00,0x93,0x18,0x50,0x07,0x90,0x1e,0x64,0x07,0x91,0x2a,0x69,0x00,0x93,0x17,0x64,0x07,0x19,0x50,0x08,0x90,0x1e,
0x64,0x00,0x91,0x2f,0x69,0x00,0x93,0x1d,0x50,0x0e,0x17,0x64,0x07,0x19,0x50,0x08,0x90,0x23,0x64,0x00,0x93,0x18,0x50,0x07,0x90,0x25,0x64,0x07,0x93,0x19,0x50,0x00,
0x90,0x28,0x64,0x07,0x93,0x19,0x50,0x00,0x90,0x25,0x64,0x08,0x92,0x25,0x4b,0x00,0x93,0x17,0x64,0x0d,0x19,0x50,0x07,0x19,0x50,0x09,0x18,0x50,0x0e,0x17,0x64,0x08,
0x19,0x50,0x15,0x17,0x64,0x08,0x19,0x50,0x07,0x18,0x50,0x0e,0x19,0x50,0x08,0x19,0x50,0x07,0x91,0x2a,0x69,0x00,0x93,0x17,0x64,0x0e,0x19,0x50,0x00,0x90,0x2a,0x64,
0x08,0x91,0x2a,0x69,0x00,0x93,0x17,0x64,0x07,0x91,0x2d,0x69,0x00,0x93,0x18,0x50,0x07,0x90,0x1e,0x64,0x07,0x91,0x2a,0x69,0x00,0x93,0x17,0x64,0x08,0x19,0x50,0x07,
0x90,0x1e,0x64,0x00,0x91,0x2f,0x69,0x00,0x93,0x1d,0x50,0x0e,0x17,0x64,0x08,0x19,0x50,0x07,0x90,0x23,0x64,0x00,0x91,0x31,0x69,0x00,0x93,0x18,0x50,0x07,0x90,0x25,
0x64,0x07,0x28,0x64,0x00,0x93,0x19,0x50,0x08,0x90,0x25,0x64,0x00,0x93,0x19,0x50,0x07,0x90,0x1e,0x64,0x00,0x92,0x2f,0x7f,0x00,0x93,0x17,0x64,0x07,0x17,0x64,0x07,
0x90,0x28,0x64,0x00,0x93,0x17,0x64,0x07,0x19,0x50,0x08,0x90,0x25,0x64,0x00,0x93,0x18,0x50,0x0e,0x90,0x23,0x64,0x00,0x93,0x17,0x64,0x07,0x19,0x50,0x08,0x90,0x21,
0x64,0x00,0x93,0x1d,0x50,0x0e,0x90,0x23,0x64,0x00,0x93,0x17,0x64,0x08,0x90,0x21,0x64,0x00,0x93,0x19,0x50,0x07,0x90,0x25,0x64,0x00,0x93,0x18,0x50,0x0e,0x19,0x50,
0x01,0x90,0x23,0x64,0x07,0x93,0x19,0x50,0x07,0x91,0x2a,0x69,0x00,0x92,0x2a,0x4b,0x00,0x93,0x17,0x64,0x0e,0x19,0x50,0x01,0x90,0x2a,0x64,0x07,0x91,0x2a,0x69,0x00,
0x93,0x17,0x64,0x07,0x91,0x2d,0x69,0x00,0x93,0x18,0x50,0x07,0x90,0x1e,0x64,0x08,0x91,0x2a,0x69,0x00,0x93,0x17,0x64,0x07,0x19,0x50,0x07,0x90,0x1e,0x64,0x00,0x91,
0x2f,0x69,0x0f,0x93,0x17,0x64,0x08,0x19,0x50,0x06,0x90,0x23,0x64,0x00,0x91,0x31,0x69,0x00,0x93,0x18,0x50,0x07,0x90,0x25,0x64,0x00,0x93,0x17,0x64,0x08,0x90,0x28,
0x64,0x00,0x91,0x32,0x69,0x00,0x93,0x19,0x50,0x07,0x90,0x25,0x64,0x01,0x93,0x19,0x50,0x06,0x92,0x26,0x4b,0x00,0x93,0x1d,0x50,0x0f,0x19,0x50,0x07,0x17,0x64,0x07,
0x18,0x50,0x0f,0x17,0x64,0x1d,0x17,0x64,0x07,0x17,0x64,0x07,0x90,0x23,0x64,0x00,0x91,0x34,0x69,0x00,0x93,0x18,0x50,0x08,0x90,0x25,0x64,0x07,0x28,0x64,0x00,0x91,
0x31,0x69,0x00,0x93,0x19,0x50,0x07,0x90,0x25,0x64,0x00,0x93,0x19,0x50,0x07,0x92,0x2a,0x4b,0x00,0x93,0x17,0x64,0x0e,0x19,0x50,0x01,0x90,0x2a,0x64,0x07,0x93,0x17,
0x64,0x07,0x18,0x50,0x08,0x90,0x1e,0x64,0x07,0x93,0x17,0x64,0x09,0x19,0x50,0x05,0x90,0x1e,0x64,0x00,0x93,0x1d,0x50,0x0f,0x17,0x64,0x07,0x19,0x50,0x07,0x17,0x64,
0x0f,0x18,0x50,0x07,0x19,0x50,0x07,0x90,0x2a,0x64,0x00,0x92,0x36,0x4b,0x00,0x93,0x17,0x64,0x08,0x90,0x25,0x64,0x00,0x92,0x31,0x4b,0x06,0x93,0x19,0x50,0x01,0x90,
0x28,0x64,0x00,0x92,0x34,0x4b,0x07,0x90,0x2d,0x64,0x00,0x92,0x39,0x4b,0x00,0x93,0x17,0x64,0x07,0x18,0x50,0x08,0x90,0x2a,0x64,0x00,0x92,0x36,0x4b,0x07,0x93,0x17,
0x64,0x07,0x19,0x50,0x00,0x90,0x28,0x64,0x00,0x92,0x34,0x4b,0x07,0x90,0x25,0x64,0x00,0x92,0x31,0x4b,0x08,0x90,0x28,0x64,0x00,0x92,0x34,0x4b,0x07,0x90,0x23,0x64,
0x00,0x92,0x2f,0x4b,0x00,0x93,0x17,0x64,0x06,0x19,0x50,0x09,0x90,0x21,0x64,0x00,0x92,0x2d,0x4b,0x00,0xc3,0x10,0x00,0x93,0x1c,0x64,0x07,0x1c,0x64,0x07,0x1a,0x64,
0x0f,0x90,0x25,0x64,0x00,0x91,0x42,0x40,0x00,0x93,0x17,0x64,0x07,0x91,0x3b,0x40,0x06,0x93,0x19,0x50,0x01,0x91,0x40,0x40,0x00,0x92,0x34,0x7f,0x07,0x93,0x19,0x50,
0x00,0x90,0x1e,0x64,0x00,0x91,0x3d,0x40,0x00,0x92,0x36,0x7f,0x08,0x91,0x42,0x40,0x00,0x93,0x1b,0x7f,0x07,0x90,0x1e,0x64,0x00,0x91,0x40,0x40,0x00,0x92,0x36,0x7f,
0x07,0x91,0x45,0x40,0x07,0x90,0x21,0x64,0x00,0x91,0x3d,0x40,0x00,0x92,0x36,0x7f,0x08,0x90,0x1e,0x64,0x00,0x91,0x42,0x40,0x00,0x93,0x17,0x64,0x07,0x91,0x3b,0x40,
0x00,0x92,0x36,0x7f,0x00,0x93,0x18,0x50,0x07,0x91,0x40,0x40,0x00,0x92,0x39,0x7f,0x07,0x91,0x3d,0x40,0x00,0x92,0x3b,0x7f,0x08,0x91,0x42,0x40,0x00,0x92,0x3d,0x7f,
0x00,0x93,0x1a,0x64,0x07,0x91,0x40,0x40,0x00,0x92,0x34,0x7f,0x07,0x90,0x28,0x64,0x00,0x91,0x45,0x40,0x00,0x92,0x3b,0x7f,0x07,0x90,0x25,0x64,0x00,0x91,0x3d,0x40,
0x00,0x92,0x31,0x7f,0x08,0x90,0x26,0x64,0x00,0x91,0x42,0x40,0x00,0x93,0x17,0x64,0x07,0x91,0x3b,0x40,0x07,0x90,0x26,0x64,0x00,0x91,0x40,0x40,0x00,0x93,0x19,0x50,
0x07,0x91,0x3d,0x40,0x00,0x93,0x19,0x50,0x08,0x91,0x42,0x40,0x00,0x93,0x1b,0x7f,0x07,0x91,0x40,0x40,0x07,0x90,0x25,0x64,0x00,0x91,0x45,0x40,0x07,0x90,0x26,0x64,
0x00,0x91,0x3d,0x40,0x08,0x90,0x25,0x64,0x00,0x91,0x42,0x40,0x00,0x93,0x17,0x64,0x07,0x91,0x3b,0x40,0x07,0x40,0x40,0x08,0x3d,0x40,0x07,0x90,0x28,0x64,0x00,0x91,
0x42,0x40,0x00,0x93,0x1a,0x64,0x07,0x91,0x40,0x40,0x00,0x93,0x18,0x50,0x07,0x91,0x45,0x40,0x08,0x3d,0x40,0x07,0x90,0x25,0x64,0x00,0x91,0x42,0x40,0x00,0x93,0x17,
0x64,0x07,0x91,0x3b,0x40,0x07,0x93,0x19,0x50,0x00,0x90,0x1e,0x64,0x00,0x91,0x40,0x40,0x00,0x92,0x45,0x64,0x08,0x91,0x3d,0x40,0x00,0x92,0x42,0x64,0x00,0x93,0x19,
0x50,0x07,0x90,0x1e,0x64,0x00,0x91,0x42,0x40,0x00,0x93,0x1b,0x7f,0x07,0x91,0x40,0x40,0x00,0x92,0x45,0x64,0x07,0x90,0x21,0x64,0x00,0x91,0x45,0x40,0x00,0x92,0x40,
0x7f,0x08,0x90,0x1e,0x64,0x00,0x91,0x3d,0x40,0x00,0x92,0x42,0x7f,0x00,0x40,0x64,0x00,0x93,0x17,0x64,0x07,0x91,0x42,0x40,0x00,0x92,0x3d,0x7f,0x00,0x93,0x17,0x64,
0x07,0x91,0x3b,0x40,0x00,0x92,0x3b,0x7f,0x00,0x93,0x18,0x50,0x07,0x91,0x40,0x40,0x00,0x92,0x3d,0x7f,0x08,0x91,0x3d,0x40,0x00,0x92,0x3d,0x7f,0x07,0x91,0x42,0x40,
0x00,0x92,0x3b,0x7f,0x00,0x93,0x1a,0x64,0x07,0x91,0x40,0x40,0x00,0x92,0x3b,0x7f,0x07,0x90,0x28,0x64,0x00,0x91,0x45,0x40,0x00,0x92,0x3d,0x7f,0x08,0x91,0x3d,0x40,
0x07,0x90,0x25,0x64,0x00,0x91,0x42,0x40,0x00,0x93,0x17,0x64,0x07,0x90,0x26,0x64,0x00,0x91,0x3b,0x40,0x07,0x93,0x19,0x50,0x00,0x90,0x26,0x64,0x00,0x91,0x40,0x40,
0x08,0x3d,0x40,0x00,0x93,0x19,0x50,0x07,0x91,0x42,0x40,0x00,0x93,0x1b,0x7f,0x07,0x91,0x40,0x40,0x07,0x90,0x25,0x64,0x00,0x91,0x45,0x40,0x08,0x90,0x26,0x64,0x00,
0x91,0x3d,0x40,0x07,0x90,0x25,0x64,0x00,0x91,0x42,0x40,0x00,0x93,0x17,0x64,0x07,0x91,0x3b,0x40,0x00,0x93,0x18,0x50,0x08,0x91,0x40,0x40,0x07,0x3d,0x40,0x07,0x90,
0x28,0x64,0x00,0x91,0x42,0x40,0x00,0x93,0x1a,0x64,0x07,0x91,0x40,0x40,0x08,0x45,0x40,0x07,0x3d,0x40,0x07,0x90,0x23,0x64,0x00,0x91,0x42,0x40,0x00,0x92,0x40,0x64,
0x00,0x3b,0x64,0x00,0xc3,0x18,0x00,0x93,0x17,0x64,0x07,0x91,0x3b,0x40,0x07,0x93,0x19,0x50,0x01,0x91,0x40,0x40,0x00,0x92,0x34,0x7f,0x07,0x90,0x23,0x64,0x00,0x91,
0x3d,0x40,0x00,0x92,0x2f,0x7f,0x00,0x93,0x19,0x50,0x07,0x90,0x25,0x64,0x00,0x91,0x42,0x40,0x00,0x93,0x18,0x50,0x07,0x91,0x40,0x40,0x00,0x92,0x2f,0x7f,0x08,0x90,
0x25,0x64,0x00,0x91,0x45,0x40,0x07,0x3d,0x40,0x00,0x92,0x34,0x7f,0x00,0x93,0x17,0x64,0x07,0x90,0x1e,0x64,0x00,0x91,0x42,0x40,0x00,0x93,0x17,0x64,0x07,0x91,0x3b,
0x40,0x00,0x92,0x40,0x7f,0x08,0x90,0x2a,0x64,0x00,0x91,0x40,0x40,0x07,0x3d,0x40,0x00,0x92,0x40,0x7f,0x07,0x90,0x21,0x64,0x00,0x91,0x42,0x40,0x00,0x92,0x45,0x7f,
0x00,0x93,0x18,0x50,0x07,0x91,0x40,0x40,0x08,0x45,0x40,0x00,0x92,0x42,0x7f,0x07,0x91,0x3d,0x40,0x00,0x92,0x2f,0x7f,0x07,0x90,0x23,0x64,0x00,0x91,0x42,0x40,0x00,
0x93,0x17,0x64,0x07,0x91,0x3b,0x40,0x07,0x93,0x19,0x50,0x01,0x91,0x40,0x40,0x07,0x90,0x23,0x64,0x00,0x91,0x3d,0x40,0x00,0x93,0x19,0x50,0x07,0x90,0x25,0x64,0x00,
0x91,0x42,0x40,0x00,0x93,0x18,0x50,0x07,0x91,0x40,0x40,0x08,0x90,0x25,0x64,0x00,0x91,0x45,0x40,0x07,0x3d,0x40,0x00,0x93,0x17,0x64,0x07,0x90,0x1a,0x64,0x00,0x91,
0x42,0x40,0x00,0x93,0x17,0x64,0x08,0x91,0x3b,0x40,0x07,0x90,0x26,0x64,0x00,0x91,0x40,0x40,0x07,0x3d,0x40,0x07,0x90,0x1c,0x64,0x00,0x91,0x42,0x40,0x00,0x93,0x18,
0x50,0x08,0x91,0x40,0x40,0x07,0x45,0x40,0x00,0x93,0x1c,0x64,0x07,0x91,0x3d,0x40,0x00,0x93,0x1c,0x64,0x07,0x90,0x1e,0x64,0x00,0x91,0x42,0x40,0x00,0x93,0x17,0x64,
0x08,0x90,0x2a,0x64,0x00,0x91,0x3b,0x40,0x06,0x93,0x19,0x50,0x01,0x90,0x28,0x64,0x00,0x91,0x40,0x40,0x07,0x3d,0x40,0x00,0x93,0x19,0x50,0x07,0x90,0x25,0x64,0x00,
0x91,0x42,0x40,0x00,0x93,0x1d,0x7f,0x08,0x91,0x40,0x40,0x07,0x90,0x28,0x64,0x00,0x91,0x45,0x40,0x07,0x90,0x25,0x64,0x00,0x91,0x3d,0x40,0x00,0x93,0x17,0x64,0x07,
0x90,0x25,0x64,0x00,0x91,0x42,0x40,0x00,0x93,0x17,0x64,0x08,0x90,0x23,0x64,0x00,0x91,0x3b,0x40,0x07,0x40,0x40,0x07,0x90,0x21,0x64,0x00,0x91,0x3d,0x40,0x07,0x42,
0x40,0x00,0xc3,0x10,0x00,0x93,0x1a,0x64,0x08,0x90,0x23,0x64,0x00,0x91,0x40,0x40,0x00,0xc3,0x18,0x00,0x93,0x17,0x64,0x07,0x91,0x45,0x40,0x00,0x93,0x17,0x64,0x07,
0x90,0x2a,0x64,0x00,0x91,0x3d,0x40,0x00,0x93,0x1e,0x7f,0x24,0x90,0x21,0x64,0x00,0x92,0x2d,0x64,0x00,0x93,0x1e,0x7f,0x0e,0x19,0x50,0x08,0x19,0x50,0x08,0x90,0x26,
0x64,0x00,0x92,0x39,0x64,0x02,0xff,0x06,0x01,0x45,0x0c,0x93,0x1e,0x7f,0x0f,0x17,0x64,0x00,0x1c,0x64,0x07,0x1c,0x64,0x07,0xc3,0x30,0x00,0xff,0x2f,0x00 };

*/
};






const char *musicData[] PROGMEM = {
NULL,
song1,
song2,
};


