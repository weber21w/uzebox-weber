const char title_map[] PROGMEM=
{
/*//STORED ON SD NOW
30,26,
    0,  0,  0,  0,  0,  0,  0,  0,  0,  0,  0,  0,  0,  0,  0,  0,  0,  0,  0,
    0,  0,  0,  0,  0,  0,  0,  0,  0,  0,  0,
    0,  0,  0,  0,  0,  0,  0,  0,  0,  0,  0,  0,  0,  0,  0,  0,  0,  0,  0,
    0,  0,  0,  0,  0,  0,  0,  0,  0,  0,  0,
    1,  1,  1,  1,  1,  1,  1,  1,  1,  1,  1,  1,  1,  1,  1,  1,  1,  1,  1,
    1,  1,  1,  1,  1,  1,  1,  1,  1,  1,  1,
    2,  2,  2,  2,  2,  2,  2,  2,  2,  2,  2,  2,  2,  2,  2,  2,  2,  2,  2,
    2,  2,  2,  2,  2,  2,  2,  2,  2,  2,  2,
    2,  2,  2,  2,  2,  2,  2,  2,  3,  4,  5,  6,  7,  8,  9, 10, 11, 12, 13,
   14, 15,  2,  2,  2,  2,  2,  2,  2,  2,  2,
    2,  2,  2,  2,  2,  2,  2,  2,  2, 16, 17, 18, 19, 20, 21, 22, 23, 24, 25,
   26, 27, 28,  2,  2,  2,  2,  2,  2,  2,  2,
    2,  2,  2,  2,  2,  2,  2,  2,  2, 29, 30, 31, 32, 33, 34, 35, 36, 37, 38,
   39, 40, 41,  2,  2,  2,  2,  2,  2,  2,  2,
    2,  2,  2,  2,  2,  2,  2,  2,  2, 42, 43, 44, 45, 46, 47, 48, 49, 50,  2,
    2,  2,  2,  2,  2,  2,  2,  2,  2,  2,  2,
    2,  2,  2,  2,  2,  2,  2,  2,  2, 51, 52, 53, 54, 55, 56, 57, 58, 59,  2,
    2,  2,  2,  2,  2,  2,  2,  2,  2,  2,  2,
    2,  2,  2,  2,  2,  2,  2,  2,  2, 60, 61, 62, 63, 64, 65, 66, 67, 68,  2,
    2,  2,  2,  2,  2,  2,  2,  2,  2,  2,  2,
    2,  2,  2,  2,  2,  2,  2,  2,  2,  2,  2, 69,  2,  2,  2,  2,  2,  2,  2,
    2,  2,  2,  2,  2,  2,  2,  2,  2,  2,  2,
    2,  2,  2,  2,  2,  2,  2,  2,  2,  2,  2,  2,  2,  2,  2,  2,  2,  2,  2,
    2,  2,  2,  2,  2,  2,  2,  2,  2,  2,  2,
    2, 70, 71, 72, 73, 74,  2,  2,  2,  2,  2,  2,  2,  2,  2,  2,  2,  2,  2,
    2,  2,  2,  2,  2,  2, 75, 76, 77, 78,  2,
    2, 79, 80, 81, 82, 83,  2,  2,  2,  2,  2,  2,  2,  2,  2,  2,  2,  2,  2,
    2,  2,  2,  2,  2,  2, 84, 85, 86, 87, 88,
    2, 89, 90, 91, 92, 93,  2,  2,  2,  2,  2,  2,  2,  2,  2,  2,  2,  2,  2,
    2,  2,  2,  2,  2,  2, 94, 95, 96, 97, 98,
    2, 99,100,101,102,103,104,  2,  2,  2,  2,  2,  2,  2,  2,  2,  2,  2,  2,
    2,  2,  2,  2,  2,  2,105,106,107,108,109,
    2,110,111,112,113,114,  2,  2,  2,  2,  2,  2,  2,  2,  2,  2,  2,  2,  2,
    2,  2,  2,  2,  2,  2,115,116,117,118,119,
  120,121,122,123,124,125,126,  2,  2,  2,  2,  2,  2,  2,  2,  2,  2,  2,  2,
    2,  2,  2,  2,  2,  2,127,128,129,130,131,
  132,133,134,135,136,137,138,  2,  2,  2,  2,  2,  1,  1,  1,  1,  1,  1,  2,
    2,  2,  2,  2,  2,139,140,141,142,143,144,
  145,146,147,148,149,150,151,  2,  2,  2,  2,  2,  1,152,153,154,  0,  1,  2,
    2,  2,  2,  2,155,156,157,158,159,160,161,
  162,163,164,165,166,167,168,  2,  2,  2,  2,  2,  1,  0,169,170,171,  1,  2,
    2,  2,  2,172,173,174,175,176,177,178,179,
  180,181,182,183,184,185,186,187,188,  2,  2,  2,  1,  1,  1,  1,  1,  1,  2,
    2,  2,  2,189,190,191,192,193,194,195,196,
  197,198,199,200,201,202,203,204,205,  2,  2,  2,  2,  2,  2,  2,  2,  2,  2,
    2,  2,  2,206,207,208,209,210,211,212,213,
    1,  1,  1,  1,  1,  1,  1,  1,  1,  1,  1,  1,  1,  1,  1,  1,  1,  1,  1,
    1,  1,  1,  1,  1,  1,  1,  1,  1,  1,  1,
    0,  0,  0,  0,  0,  0,  0,  0,  0,  0,  0,  0,  0,  0,  0,  0,  0,  0,  0,
    0,  0,  0,  0,  0,  0,  0,  0,  0,  0,  0,
    0,  0,  0,  0,  0,  0,  0,  0,  0,  0,  0,  0,  0,  0,  0,  0,  0,  0,  0,
    0,  0,  0,  0,  0,  0,  0,  0,  0,  0,  0,

*/
};




const char title_tiles[] PROGMEM ={

/*
//STORED ON SD NOW

  0x00,0x00,0x00,0x00,0x00,0x00,0x00,0x00,
  0x00,0x00,0x00,0x00,0x00,0x00,0x00,0x00,
  0x00,0x00,0x00,0x00,0x00,0x00,0x00,0x00,
  0x00,0x00,0x00,0x00,0x00,0x00,0x00,0x00,
  0x00,0x00,0x00,0x00,0x00,0x00,0x00,0x00,
  0x00,0x00,0x00,0x00,0x00,0x00,0x00,0x00,
  0x00,0x00,0x00,0x00,0x00,0x00,0x00,0x00,
  0x00,0x00,0x00,0x00,0x00,0x00,0x00,0x00,

  0x09,0x09,0x09,0x09,0x09,0x09,0x09,0x09,
  0x09,0x09,0x09,0x09,0x09,0x09,0x09,0x09,
  0x09,0x09,0x09,0x09,0x09,0x09,0x09,0x09,
  0x09,0x09,0x09,0x09,0x09,0x09,0x09,0x09,
  0x09,0x09,0x09,0x09,0x09,0x09,0x09,0x09,
  0x09,0x09,0x09,0x09,0x09,0x09,0x09,0x09,
  0x09,0x09,0x09,0x09,0x09,0x09,0x09,0x09,
  0x09,0x09,0x09,0x09,0x09,0x09,0x09,0x09,

  0x49,0x49,0x49,0x49,0x49,0x49,0x49,0x49,
  0x49,0x49,0x49,0x49,0x49,0x49,0x49,0x49,
  0x49,0x49,0x49,0x49,0x49,0x49,0x49,0x49,
  0x49,0x49,0x49,0x49,0x49,0x49,0x49,0x49,
  0x49,0x49,0x49,0x49,0x49,0x49,0x49,0x49,
  0x49,0x49,0x49,0x49,0x49,0x49,0x49,0x49,
  0x49,0x49,0x49,0x49,0x49,0x49,0x49,0x49,
  0x49,0x49,0x49,0x49,0x49,0x49,0x49,0x49,

  0x49,0x49,0x49,0x00,0x00,0x00,0x00,0x00,
  0x49,0x49,0x00,0xFF,0xFF,0xFF,0xFF,0xFF,
  0x49,0x00,0xFF,0xFF,0x2F,0x2F,0x2F,0x2F,
  0x00,0xA4,0xBF,0x3F,0x3F,0x3F,0x3F,0x3F,
  0x00,0xFF,0x3F,0x3F,0x3F,0x3F,0x3F,0x3F,
  0x00,0x00,0x00,0x00,0x00,0x00,0x00,0x00,
  0x49,0x49,0x49,0x00,0x00,0x00,0x00,0x00,
  0x49,0x49,0x49,0x49,0x49,0x49,0x49,0x49,

  0x00,0x00,0x00,0x00,0x00,0x00,0x00,0x00,
  0xFF,0xFF,0xFF,0xFF,0xFF,0xFF,0xFF,0xFF,
  0x2F,0x2F,0x2F,0x2F,0x2F,0x2F,0x2F,0x2F,
  0x3F,0x3F,0x3F,0x3F,0x3F,0x3F,0x3F,0x3F,
  0x3F,0x3F,0x3F,0x3F,0x3F,0x3F,0x3F,0x3F,
  0x00,0x00,0x00,0x00,0x3F,0x3F,0x3F,0x3F,
  0x00,0x00,0x00,0x00,0xFF,0x3F,0x3F,0x00,
  0x49,0x49,0x49,0x00,0xFF,0x3F,0x3F,0x00,

  0x00,0x00,0x00,0x00,0x00,0x00,0x00,0x00,
  0xFF,0xFF,0xFF,0xFF,0xFF,0xFF,0xFF,0xFF,
  0x2F,0x2F,0x2F,0x2F,0x2F,0x2F,0x2F,0x2F,
  0x3F,0x3F,0x3F,0x3F,0x3F,0x3F,0x3F,0x3F,
  0x3F,0x3F,0x3F,0x3F,0x3F,0x3F,0x3F,0x3F,
  0x00,0x00,0x00,0x00,0x00,0x00,0x00,0x00,
  0x00,0x00,0x00,0x00,0x00,0x00,0x00,0x00,
  0x00,0x00,0x49,0x49,0x49,0x49,0x49,0x49,

  0x00,0x00,0x00,0x00,0x00,0x00,0x00,0x00,
  0xFF,0xFF,0xFF,0xFF,0xFF,0xFF,0xFF,0xFF,
  0x2F,0x2F,0x2F,0x2F,0x2F,0x2F,0x2F,0x2F,
  0x3F,0x3F,0x3F,0x3F,0x3F,0x3F,0x3F,0x3F,
  0x3F,0x3F,0x3F,0x3F,0x3F,0x3F,0x3F,0x3F,
  0x00,0x00,0x00,0x00,0x00,0x00,0x00,0x00,
  0x00,0x00,0x00,0x00,0x00,0x00,0x00,0x00,
  0x49,0x49,0x00,0x00,0x00,0x00,0x00,0x49,

  0x00,0x00,0x00,0x00,0x00,0x00,0x00,0x00,
  0xFF,0xFF,0xFF,0xFF,0xFF,0xFF,0xFF,0xFF,
  0x2F,0x2F,0x2F,0x2F,0x2F,0x2F,0x2F,0x2F,
  0x3F,0x3F,0x3F,0x3F,0x3F,0x3F,0x3F,0x3F,
  0x3F,0x3F,0x3F,0x3F,0x3F,0x3F,0x3F,0x3F,
  0x00,0x00,0x00,0x00,0x00,0x00,0x00,0x00,
  0x00,0x00,0x00,0x00,0x00,0x00,0x00,0x00,
  0x49,0x49,0x49,0x49,0x49,0x49,0x00,0x00,

  0x00,0x00,0x00,0x00,0x00,0x00,0x00,0x00,
  0xFF,0xFF,0xFF,0xFF,0xFF,0xFF,0xFF,0xAD,
  0x2F,0x2F,0x2F,0x2F,0x2F,0x2F,0x37,0x00,
  0x3F,0x3F,0x3F,0x3F,0x3F,0x1B,0x00,0x00,
  0x3F,0x3F,0x3F,0x3F,0x12,0x00,0x00,0x00,
  0x00,0x00,0x00,0x00,0x00,0x00,0x00,0x00,
  0x00,0x00,0x00,0x00,0x00,0x00,0x00,0x49,
  0x00,0x00,0x00,0x49,0x49,0x49,0x49,0x49,

  0x49,0x49,0x49,0x49,0x49,0x49,0x49,0x49,
  0x49,0x49,0x49,0x49,0x49,0x49,0x49,0x49,
  0x49,0x49,0x49,0x49,0x49,0x49,0x49,0x49,
  0x00,0x00,0x49,0x49,0x49,0x49,0x49,0x49,
  0x00,0x49,0x49,0x49,0x49,0x49,0x49,0x49,
  0x49,0x49,0x49,0x49,0x49,0x49,0x49,0x49,
  0x49,0x49,0x49,0x49,0x49,0x49,0x49,0x49,
  0x49,0x49,0x49,0x00,0x00,0x00,0x49,0x49,

  0x49,0x49,0x49,0x49,0x49,0x49,0x49,0x49,
  0x49,0x49,0x49,0x49,0x49,0x49,0x49,0x49,
  0x49,0x49,0x49,0x49,0x49,0x49,0x49,0x49,
  0x49,0x49,0x49,0x49,0x49,0x49,0x49,0x49,
  0x49,0x49,0x49,0x49,0x49,0x49,0x49,0x49,
  0x49,0x49,0x49,0x49,0x49,0x49,0x49,0x49,
  0x49,0x49,0x49,0x49,0x49,0x49,0x49,0x49,
  0x00,0x00,0x00,0x49,0x49,0x49,0x49,0x49,

  0x49,0x49,0x49,0x49,0x49,0x49,0x49,0x49,
  0x49,0x49,0x49,0x49,0x49,0x49,0x49,0x49,
  0x49,0x49,0x49,0x49,0x49,0x49,0x49,0x49,
  0x49,0x49,0x49,0x49,0x49,0x49,0x49,0x49,
  0x49,0x49,0x49,0x49,0x49,0x49,0x49,0x49,
  0x49,0x49,0x49,0x49,0x49,0x49,0x49,0x49,
  0x49,0x49,0x49,0x49,0x49,0x49,0x49,0x49,
  0x49,0x00,0x00,0x00,0x49,0x49,0x49,0x00,

  0x49,0x49,0x49,0x49,0x49,0x49,0x49,0x49,
  0x49,0x49,0x49,0x49,0x49,0x49,0x49,0x49,
  0x49,0x49,0x49,0x49,0x49,0x49,0x49,0x49,
  0x49,0x49,0x49,0x49,0x49,0x49,0x49,0x49,
  0x49,0x49,0x49,0x49,0x49,0x49,0x49,0x49,
  0x49,0x49,0x49,0x49,0x49,0x49,0x49,0x49,
  0x49,0x49,0x49,0x49,0x49,0x49,0x49,0x49,
  0x00,0x00,0x49,0x00,0x00,0x00,0x00,0x49,

  0x49,0x49,0x49,0x49,0x49,0x49,0x49,0x49,
  0x49,0x49,0x49,0x49,0x49,0x49,0x49,0x49,
  0x49,0x49,0x49,0x49,0x49,0x49,0x49,0x49,
  0x49,0x49,0x49,0x49,0x49,0x49,0x49,0x49,
  0x49,0x49,0x49,0x49,0x49,0x49,0x49,0x49,
  0x49,0x49,0x49,0x49,0x49,0x49,0x49,0x49,
  0x49,0x49,0x49,0x49,0x49,0x49,0x49,0x49,
  0x49,0x49,0x49,0x49,0x00,0x00,0x00,0x49,

  0x49,0x49,0x49,0x49,0x49,0x49,0x49,0x49,
  0x49,0x49,0x49,0x49,0x49,0x49,0x49,0x49,
  0x49,0x49,0x49,0x49,0x49,0x49,0x49,0x49,
  0x49,0x49,0x49,0x49,0x49,0x49,0x49,0x49,
  0x49,0x00,0x00,0x00,0x00,0x49,0x49,0x49,
  0x49,0x00,0xFF,0xFF,0x00,0x49,0x49,0x49,
  0x49,0x00,0xFF,0x1F,0x00,0x49,0x49,0x49,
  0x49,0x00,0xFF,0x1F,0x00,0x00,0x49,0x49,

  0x49,0x49,0x49,0x49,0x49,0x49,0x49,0x49,
  0x49,0x49,0x49,0x49,0x49,0x49,0x49,0x49,
  0x49,0x49,0x49,0x49,0x49,0x49,0x49,0x49,
  0x49,0x49,0x49,0x49,0x49,0x49,0x49,0x49,
  0x49,0x49,0x49,0x49,0x49,0x49,0x49,0x49,
  0x49,0x49,0x49,0x49,0x49,0x49,0x49,0x49,
  0x49,0x49,0x49,0x49,0x49,0x49,0x49,0x49,
  0x49,0x49,0x00,0x00,0x00,0x00,0x00,0x49,

  0x49,0x49,0x49,0x00,0xFF,0x3F,0x3F,0x00,
  0x49,0x49,0x49,0x00,0xFF,0x3F,0x3F,0x00,
  0x49,0x49,0x49,0x00,0xFF,0x3F,0x3F,0x00,
  0x49,0x49,0x49,0x00,0xFF,0xFF,0xFF,0x00,
  0x49,0x49,0x49,0x00,0xFF,0x7F,0xBF,0x00,
  0x49,0x49,0x49,0x00,0xFF,0x3F,0x3F,0x00,
  0x49,0x49,0x49,0x00,0xFF,0x37,0x37,0x00,
  0x49,0x49,0x49,0x00,0xFF,0x2F,0x37,0x00,

  0x00,0x49,0x49,0x49,0x49,0x49,0x49,0x49,
  0x00,0x49,0x49,0x49,0x49,0x49,0x49,0x49,
  0x00,0x49,0x49,0x49,0x49,0x49,0x49,0x00,
  0x00,0x49,0x49,0x49,0x49,0x49,0x49,0x00,
  0x00,0x49,0x49,0x49,0x49,0x49,0x49,0x00,
  0x00,0x49,0x49,0x49,0x49,0x49,0x00,0x00,
  0x00,0x49,0x49,0x49,0x49,0x00,0xFF,0x37,
  0x00,0x49,0x49,0x49,0x49,0x00,0xFF,0x2F,

  0x49,0x00,0xFF,0xFF,0xFF,0xFF,0xFF,0x00,
  0x00,0xFF,0x77,0x2F,0x2F,0x2F,0x2F,0x1D,
  0xFF,0x3F,0x3F,0x3F,0x3F,0x3F,0x3F,0x3F,
  0xFF,0xFF,0xFF,0xFF,0xFF,0xFF,0xFF,0xFF,
  0xFF,0xFF,0x00,0x00,0x00,0xFF,0xBF,0xBF,
  0xFF,0x3F,0x00,0x00,0x00,0x00,0x00,0x3F,
  0x37,0x2F,0x00,0x00,0x49,0x00,0xFF,0x37,
  0x37,0x2F,0x00,0x00,0x49,0x00,0xFF,0x2F,

  0x49,0x49,0x49,0x49,0x49,0x00,0xFF,0xFF,
  0x00,0x49,0x49,0x49,0x00,0xFF,0x77,0x2F,
  0x3F,0x00,0x49,0x00,0xFF,0x3F,0x3F,0x3F,
  0xFF,0x00,0x49,0x00,0xFF,0xFF,0xFF,0xFF,
  0xBF,0x1B,0x00,0x00,0xFF,0xFF,0x00,0x00,
  0x3F,0x3F,0x1B,0x00,0xFF,0x3F,0x00,0x00,
  0x37,0x3F,0x00,0x37,0x37,0x2F,0x00,0x00,
  0x37,0x37,0x00,0x2F,0x37,0x2F,0x00,0x00,

  0xFF,0xFF,0xFF,0x00,0x49,0x49,0x49,0x49,
  0x2F,0x2F,0x2F,0x1D,0x00,0x49,0x49,0x49,
  0x3F,0x3F,0x3F,0x3F,0x3F,0x00,0x49,0x00,
  0xFF,0xFF,0xFF,0xFF,0xFF,0x00,0x49,0x00,
  0x00,0xFF,0xBF,0xBF,0xBF,0x1B,0x00,0x49,
  0x00,0x00,0x00,0x3F,0x3F,0x3F,0x1B,0x49,
  0x49,0x00,0xFF,0x37,0x37,0x3F,0x00,0x49,
  0x49,0x00,0xFF,0x2F,0x37,0x37,0x00,0x49,

  0x49,0x00,0x00,0x00,0xFF,0xFF,0x00,0x49,
  0x00,0xFF,0x5B,0xFF,0x2F,0x2F,0x13,0xA4,
  0xFF,0x7F,0x37,0x37,0x3F,0x3F,0x3F,0x37,
  0xFF,0xFF,0xFF,0xFF,0xFF,0xFF,0xFF,0xFF,
  0x49,0x00,0x7F,0xBF,0xBF,0xBF,0xBF,0x09,
  0x49,0x00,0x3F,0x3F,0x3F,0x3F,0x00,0x00,
  0x49,0x00,0x37,0x37,0x37,0x37,0x00,0x00,
  0x49,0x00,0x2F,0x37,0x37,0x37,0x00,0x00,

  0x00,0xFF,0xFF,0x49,0x49,0x49,0x49,0x49,
  0xFF,0xB7,0x1D,0xFE,0x00,0xFF,0xFF,0xFF,
  0x37,0x3F,0x3F,0x3F,0x00,0xA4,0x37,0x37,
  0xFF,0xFF,0xFF,0xFF,0x00,0x00,0xFF,0xFF,
  0xFF,0x7F,0xBF,0xFF,0x00,0x00,0x00,0xFF,
  0xFF,0x3F,0x12,0x00,0x00,0x00,0x00,0xFF,
  0xA4,0x1C,0x00,0x00,0x49,0x49,0x00,0xFF,
  0x00,0x00,0x49,0x49,0x49,0x49,0x00,0xFF,

  0x00,0xFF,0xFF,0xFF,0x49,0x49,0x49,0x00,
  0xFF,0x77,0x2F,0x13,0x49,0x00,0xA4,0xFF,
  0x37,0x3F,0x3F,0x1B,0x00,0x00,0x7F,0x37,
  0xFF,0xFF,0xFF,0x5B,0x00,0x00,0xFF,0xFF,
  0xBF,0xBF,0xBF,0x1B,0x00,0x00,0xBF,0xBF,
  0x3F,0x3F,0x3F,0x1B,0x00,0x00,0x7F,0x3F,
  0x37,0x37,0x37,0x13,0x00,0x00,0x7F,0x37,
  0x37,0x37,0x2F,0x13,0x00,0x00,0x77,0x2F,

  0xFF,0xFF,0x00,0xFF,0xFF,0xFF,0x00,0x49,
  0xB7,0x13,0x00,0xFF,0x2F,0x2F,0x2F,0x00,
  0x3F,0x1B,0x00,0xFF,0x3F,0x3F,0x3F,0x00,
  0xFF,0xFF,0x00,0x00,0xFF,0xFF,0xFF,0xFF,
  0xBF,0x5B,0x00,0x00,0xFF,0x7F,0xBF,0xBF,
  0x3F,0x1B,0x00,0x00,0xFF,0x3F,0x3F,0x3F,
  0x37,0x1B,0x00,0xFF,0x77,0x37,0x37,0x37,
  0x2F,0x13,0x00,0xFF,0x37,0x37,0x37,0x37,

  0x49,0x49,0x49,0x00,0xFF,0xFF,0xFF,0x00,
  0x49,0x49,0x00,0xFF,0xBF,0x2F,0x2F,0x00,
  0x00,0x49,0x00,0xFF,0x3F,0x3F,0x3F,0x00,
  0x00,0x49,0x5B,0xFF,0xFF,0xFF,0x00,0x00,
  0xBF,0x00,0xFF,0xBF,0xBF,0xFF,0x00,0x00,
  0x3F,0x00,0xBF,0x3F,0x3F,0xFF,0x00,0x00,
  0x37,0x37,0x37,0x37,0x37,0x37,0x37,0x00,
  0x2F,0x37,0x37,0x37,0x37,0x37,0x37,0x00,

  0x49,0x00,0xFF,0x1F,0x00,0x00,0x49,0x49,
  0x49,0x49,0x00,0x1D,0x00,0x00,0x49,0x00,
  0x00,0x49,0x49,0x00,0x00,0x00,0x00,0xFF,
  0x00,0x49,0x49,0x49,0x49,0x00,0xA4,0xFF,
  0x00,0x49,0x49,0x49,0x49,0x00,0xFF,0xBF,
  0x49,0x49,0x49,0x49,0x49,0x00,0xBF,0x3F,
  0x49,0x49,0x49,0x49,0x49,0x00,0x5C,0x37,
  0x49,0x49,0x49,0x49,0x49,0x49,0x00,0xFF,

  0x00,0x00,0xF6,0xFF,0xFF,0xFF,0xFF,0x00,
  0xFF,0xFF,0x37,0xFF,0x77,0x2F,0x2F,0x0A,
  0xFF,0x37,0x37,0x37,0x3F,0x3F,0x3F,0x3F,
  0xFF,0xFF,0xFF,0xFF,0xFF,0xFF,0xFF,0xFF,
  0xBF,0xBF,0xFF,0x37,0x37,0xBF,0xBF,0xFF,
  0x3F,0x3F,0x3F,0x3F,0x00,0x00,0x00,0x00,
  0x37,0x37,0x37,0x37,0x37,0x37,0x37,0x3F,
  0xFF,0x37,0x37,0x37,0x37,0x37,0x37,0x2F,

  0x49,0x49,0x49,0x49,0x49,0x49,0x49,0x49,
  0x00,0x49,0x49,0x49,0x49,0x49,0x49,0x49,
  0xFF,0x00,0x49,0x49,0x49,0x49,0x49,0x49,
  0xFF,0x00,0x49,0x49,0x49,0x49,0x49,0x49,
  0xFF,0x00,0x49,0x49,0x49,0x49,0x49,0x49,
  0xFF,0x00,0x49,0x49,0x49,0x49,0x49,0x49,
  0x00,0x49,0x49,0x49,0x49,0x49,0x49,0x49,
  0x1D,0x00,0x49,0x49,0x49,0x49,0x49,0x49,

  0x49,0x49,0x49,0x00,0xFF,0x2F,0x2F,0x00,
  0x49,0x49,0x49,0x00,0xFF,0x2F,0x2F,0x00,
  0x49,0x49,0x49,0x00,0xFF,0x27,0x27,0x00,
  0x49,0x49,0x49,0x00,0xFF,0x27,0x27,0x00,
  0x49,0x49,0x49,0x00,0xFF,0x1F,0x01,0x00,
  0x49,0x49,0x49,0x00,0xFF,0x00,0x00,0x00,
  0x49,0x49,0x49,0x49,0x00,0x00,0x00,0x00,
  0x49,0x49,0x49,0x49,0x00,0x00,0x49,0x49,

  0x00,0x49,0x49,0x49,0x49,0x00,0xFF,0x2F,
  0x00,0x49,0x49,0x49,0x49,0x49,0x00,0x26,
  0x00,0x49,0x49,0x49,0x49,0x49,0x49,0xFF,
  0x00,0x49,0x49,0x49,0x49,0x49,0x49,0xFF,
  0x00,0x49,0x49,0x49,0x49,0x49,0x49,0x49,
  0x00,0x49,0x49,0x49,0x49,0x49,0x49,0x49,
  0x49,0x49,0x49,0x49,0x49,0x49,0x49,0x49,
  0x49,0x49,0x49,0x49,0x49,0x49,0x49,0x49,

  0x2F,0x2F,0x00,0x00,0x49,0x00,0xFF,0x2F,
  0x2F,0x2F,0x77,0x13,0x00,0x00,0xFF,0x2F,
  0x27,0x27,0x27,0x27,0x2F,0xFF,0xFF,0x27,
  0x27,0x27,0x27,0x27,0x27,0x27,0x27,0x27,
  0x14,0x27,0x1F,0x1F,0x1F,0x15,0x14,0x00,
  0x49,0x00,0x1F,0x1F,0x1F,0x00,0x00,0x00,
  0x49,0x49,0x00,0x00,0x00,0x00,0x00,0x00,
  0x49,0x49,0x49,0x49,0x00,0x00,0x00,0x49,

  0x2F,0x37,0x00,0x2F,0x2F,0x2F,0x00,0x00,
  0x2F,0x2F,0x00,0x26,0x2F,0x2F,0x77,0x13,
  0x27,0x00,0x00,0xFF,0x27,0x27,0x27,0x27,
  0x00,0x00,0x00,0xFF,0x27,0x27,0x27,0x27,
  0x00,0x00,0x00,0x49,0x14,0x27,0x1F,0x1F,
  0x00,0x00,0x49,0x49,0x49,0x00,0x1F,0x1F,
  0x00,0x49,0x49,0x49,0x49,0x49,0x00,0x00,
  0x49,0x49,0x49,0x49,0x49,0x49,0x49,0x49,

  0x49,0x00,0xFF,0x2F,0x2F,0x37,0x00,0x49,
  0x00,0x00,0xFF,0x2F,0x2F,0x2F,0x00,0x49,
  0x2F,0xFF,0xFF,0x27,0x27,0x00,0x00,0x49,
  0x27,0x27,0x27,0x27,0x00,0x00,0x00,0x49,
  0x1F,0x15,0x14,0x00,0x00,0x00,0x00,0x49,
  0x1F,0x00,0x00,0x00,0x00,0x00,0x49,0x49,
  0x00,0x00,0x00,0x00,0x00,0x49,0x49,0x49,
  0x00,0x00,0x00,0x49,0x49,0x49,0x49,0x49,

  0x49,0x00,0x2F,0x2F,0x2F,0x37,0x00,0x00,
  0x49,0x00,0x27,0x2F,0x2F,0x2F,0x00,0x00,
  0x49,0x00,0x27,0x27,0x27,0x27,0x00,0x00,
  0x49,0x00,0x1F,0x27,0x27,0x27,0x00,0x00,
  0x49,0x00,0x27,0x1F,0x1F,0x1F,0x1F,0x00,
  0x49,0x49,0x00,0x27,0x1F,0x1F,0x27,0x00,
  0x49,0x49,0x49,0x00,0x00,0x00,0x00,0x00,
  0x49,0x49,0x49,0x49,0x49,0x00,0x00,0x00,

  0x49,0x49,0x49,0x49,0x49,0x49,0x00,0xFF,
  0x49,0x49,0x49,0x49,0x49,0x49,0x00,0xFF,
  0x49,0x49,0x49,0x49,0x49,0x49,0x00,0xFF,
  0x49,0x49,0x49,0x49,0x49,0x49,0x00,0xFF,
  0x49,0x49,0x49,0x49,0x49,0x49,0x49,0x00,
  0x49,0x49,0x49,0x49,0x49,0x49,0x49,0x49,
  0x00,0x49,0x49,0x49,0x49,0x49,0x49,0x49,
  0x49,0x49,0x49,0x49,0x49,0x49,0x49,0x49,
  //END STORED ON SD
  */

  0x2F,0x2F,0x2F,0x13,0x00,0x00,0x77,0x2F,
  0x2F,0x2F,0x2F,0x13,0x00,0x00,0x77,0x2F,
  0x27,0x27,0x27,0x27,0xFF,0xFF,0xB7,0x27,
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  0x21,0x59,0x11,0x08,0x00,0x00,0x00,0x92,


};

