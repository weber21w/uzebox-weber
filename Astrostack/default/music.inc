//-s0 -f60 -e1154 stormforce_title.mid stormforce_title.inc
const char title_song[] PROGMEM ={
0x00,0xc0,0x1e,0x00,0xc1,0x1f,0x00,0xc2,0x20,0x00,0xc3,0x00,0x00,0xb0,0x07,0x7f,0x00,0xb1,0x07,0x7f,0x00,0xb2,0x07,0x7f,0x00,0xb3,0x07,0x7f,0x00,0xff,0x06,0x01,
0x53,0x02,0x90,0x43,0x7f,0x00,0x91,0x48,0x7f,0x00,0x92,0x2e,0x5a,0x00,0x93,0x21,0x64,0x04,0x92,0x2f,0x5a,0x04,0x30,0x5a,0x08,0x93,0x21,0x64,0x08,0x90,0x41,0x7f,
0x00,0x91,0x46,0x7f,0x00,0x93,0x21,0x64,0x08,0x90,0x37,0x7f,0x00,0x93,0x21,0x64,0x08,0x90,0x3c,0x7f,0x00,0x93,0x21,0x64,0x08,0x90,0x30,0x7f,0x08,0x37,0x7f,0x00,
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0x21,0x64,0x08,0xff,0x2f,0x00 };



//-s0 -e1437 -f60 stormforce_main.mid stormforce_main.inc
const char main_song[] PROGMEM ={
0x00,0xc0,0x23,0x00,0xc1,0x24,0x00,0xc2,0x25,0x00,0xc3,0x00,0x00,0xb0,0x07,0x7f,0x00,0xb1,0x07,0x7f,0x00,0xb2,0x07,0x7f,0x00,0xb3,0x07,0x7f,0x00,0xff,0x06,0x01,
0x53,0x02,0x90,0x2a,0x7f,0x00,0x91,0x2f,0x7f,0x00,0x92,0x2f,0x5a,0x00,0x93,0x26,0x64,0x0a,0x90,0x25,0x7f,0x00,0x91,0x31,0x7f,0x00,0x92,0x31,0x5a,0x00,0x93,0x26,
0x64,0x0a,0x92,0x31,0x5a,0x0a,0x91,0x2f,0x7f,0x00,0x92,0x2f,0x5a,0x00,0x93,0x26,0x64,0x05,0x26,0x64,0x05,0x91,0x31,0x7f,0x00,0x92,0x31,0x5a,0x00,0x93,0x26,0x64,
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0x64,0x00,0xff,0x06,0x01,0x45,0x03,0xff,0x2f,0x00 };




