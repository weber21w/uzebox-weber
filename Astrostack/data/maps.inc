#define BFO NUM_GRID_TILES+NUM_BLOCK_TILES+RAM_TILES_COUNT

const char big_font_maps[] PROGMEM = {
0+BFO,1+BFO,//		'0'
19+BFO,20+BFO,

2+BFO,3+BFO,//		'1'
21+BFO,22+BFO,

4+BFO,5+BFO,//		'2'
23+BFO,24+BFO,

6+BFO,7+BFO,//		'3'
25+BFO,20+BFO,

8+BFO,9+BFO,//		'4'
26+BFO,27+BFO,

10+BFO,11+BFO,//	'5'
28+BFO,29+BFO,

12+BFO,11+BFO,//	'6'
30+BFO,29+BFO,

13+BFO,14+BFO,//	'7'
31+BFO,32+BFO,

15+BFO,16+BFO,//	'8'
33+BFO,34+BFO,

17+BFO,18+BFO,//	'9'
35+BFO,29+BFO,

12+BFO,18+BFO,//	'A'
49+BFO,50+BFO,

10+BFO,16+BFO,//	'B'
23+BFO,34+BFO,

36+BFO,37+BFO,//	'C'
51+BFO,52+BFO,

38+BFO,39+BFO,//	'D'
53+BFO,54+BFO,

10+BFO,40+BFO,//	'E'
23+BFO,55+BFO,

10+BFO,40+BFO,//	'F'
49+BFO,56+BFO,

41+BFO,42+BFO,//	'G'
57+BFO,58+BFO,

43+BFO,44+BFO,//	'H'
49+BFO,50+BFO,

45+BFO,46+BFO,//	'I'
59+BFO,60+BFO,

47+BFO,48+BFO,//	'J'
61+BFO,54+BFO,

62+BFO,63+BFO,//	'K'
72+BFO,73+BFO,

64+BFO,65+BFO,//	'L'
53+BFO,52+BFO,

66+BFO,67+BFO,//	'M'
74+BFO,75+BFO,

66+BFO,68+BFO,//	'N'
74+BFO,76+BFO,

36+BFO,39+BFO,//	'O'	
51+BFO,54+BFO,

10+BFO,5+BFO,//		'P'
49+BFO,77+BFO,

36+BFO,39+BFO,//	'Q'
78+BFO,79+BFO,

10+BFO,5+BFO,//		'R'
72+BFO,80+BFO,

17+BFO,69+BFO,//	'S'
81+BFO,29+BFO,

70+BFO,71+BFO,//	'T'
31+BFO,32+BFO,

64+BFO,48+BFO,//	'U'
51+BFO,54+BFO,

64+BFO,48+BFO,//	'V'
95+BFO,96+BFO,

82+BFO,48+BFO,//	'W'
97+BFO,98+BFO,

83+BFO,84+BFO,//	'X'
99+BFO,100+BFO,

85+BFO,86+BFO,//	'Y'
31+BFO,32+BFO,

87+BFO,88+BFO,//	'Z'
101+BFO,102+BFO,

89+BFO,3+BFO,//	'!'
103+BFO,104+BFO,

90+BFO,91+BFO,//	'['
105+BFO,106+BFO,

92+BFO,5+BFO,//		'?'
107+BFO,108+BFO,

93+BFO,94+BFO,//	']'
109+BFO,110+BFO,

};


const char title_map[] PROGMEM=
{22,10,
    0,  1,  2,  3,  4,  0,  1,  2,  5,  6,  2,  2,  7,  6,  2,  3,  4,  0,  1,
    2,  3,  4,
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   21, 13, 12
};

